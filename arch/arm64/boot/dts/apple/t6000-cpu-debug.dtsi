// SPDX-License-Identifier: GPL-2.0+ OR MIT
/* Explicit CPU register descriptors; no firmware debug sequences. */

/ {
	cpu_debug: debug-controller@210010000 {
		compatible = "apple,t6000-cpu-debug", "apple,cpu-debug";
		reg = <0x2 0x10010000 0x0 0x300c8>,
		      <0x2 0x10110000 0x0 0x300c8>,
		      <0x2 0x11010000 0x0 0x300c8>,
		      <0x2 0x11110000 0x0 0x300c8>,
		      <0x2 0x11210000 0x0 0x300c8>,
		      <0x2 0x11310000 0x0 0x300c8>,
		      <0x2 0x12010000 0x0 0x300c8>,
		      <0x2 0x12110000 0x0 0x300c8>,
		      <0x2 0x12210000 0x0 0x300c8>,
		      <0x2 0x12310000 0x0 0x300c8>;
		reg-names = "cpu0-coresight", "cpu1-coresight", "cpu2-coresight", "cpu3-coresight", "cpu4-coresight", "cpu5-coresight", "cpu6-coresight", "cpu7-coresight", "cpu8-coresight", "cpu9-coresight";
		apple,cpu-ids = /bits/ 64 <0x0 0x1 0x100 0x101 0x102 0x103 0x200 0x201 0x202 0x203>;
		status = "disabled";
	};
};
