// SPDX-License-Identifier: GPL-2.0+ OR MIT
/*
 * J713 APCIe calibration, converted from the ADT, for bringing ANS's PCIe block
 * back after a deep sleep. The J713 boot chain does not pass it on yet, so it is
 * described here until a bootloader fills it in. Each property is relative to
 * the window of its node named after it: axi2af, phy-block, phy-ip, cio3pll,
 * clkgen, and port0 and config for the port's.
 */

&pcie0 {
	apple,tunable-axi2af =
		<0x0 0x800000ff 0x8000001c>,
		<0x4 0x80ff00ff 0x800c000d>,
		<0x8 0x80ff00ff 0x80160003>,
		<0xc 0x80ff00ff 0x800c000d>,
		<0x10 0x80ff00ff 0x800c000d>,
		<0x14 0x80ff00ff 0x80010003>,
		<0x18 0x80ff00ff 0x80010003>,
		<0x1c 0x800000ff 0x8000000e>,
		<0x20 0x800000ff 0x80000024>,
		<0x24 0x80ff00ff 0x80200008>,
		<0x28 0x80ff00ff 0x80180010>,
		<0x2c 0x80ff00ff 0x80200008>,
		<0x30 0x80ff00ff 0x800c0004>,
		<0x34 0x80ff00ff 0x80080008>,
		<0x38 0x800000ff 0x80000016>,
		<0x3c 0x800000ff 0x8000000c>,
		<0x40 0x800000ff 0x8000000c>,
		<0x100 0xff 0xff>,
		<0x104 0xff0000 0x10000>,
		<0x108 0xffff0006 0x40000>,
		<0x304 0x3f3f0000 0x8080000>,
		<0x314 0x80000000 0x80000000>,
		<0x31c 0x80000000 0x80000000>,
		<0x324 0x80000000 0x80000000>,
		<0x348 0xffffffff 0xffff>,
		<0x34c 0xffffffff 0xffff>,
		<0x408 0xffff0020 0xd0020>,
		<0x948 0x7ff07ff 0x200000>,
		<0xa48 0x7ff07ff 0x80100>,
		<0xb48 0x7ff07ff 0x600060>,
		<0xe00 0xffffffff 0x7fffffff>,
		<0xe04 0x100 0x100>,
		<0x4008 0x1 0x1>,
		<0x400c 0x1 0x0>,
		<0x4014 0x1 0x0>,
		<0x4018 0x1 0x0>,
		<0x401c 0x1 0x1>,
		<0x4020 0xffff0000 0x0>,
		<0x4024 0xffff0000 0x0>,
		<0x4028 0xffff0000 0x0>,
		<0x402c 0xffff0000 0x0>,
		<0x4030 0xffff0000 0x0>,
		<0x4034 0xffff0000 0x0>,
		<0x10f8 0x1 0x1>,
		<0x11f8 0x1 0x1>,
		<0x12f8 0x1 0x1>,
		<0x13f8 0x1 0x1>,
		<0x14f8 0x1 0x1>,
		<0x10fc 0x1 0x1>,
		<0x11fc 0x1 0x1>,
		<0x12fc 0x1 0x1>,
		<0x13fc 0x1 0x1>,
		<0x14fc 0x1 0x1>,
		<0x20028 0xfe2f 0x0>,
		<0x2002c 0x7 0x0>,
		<0x20030 0x7f 0x0>,
		<0x20034 0xff 0x0>,
		<0x20058 0x10b 0x0>;

	apple,tunable-phy =
		<0x8000 0x4000000 0x0>,
		<0x20000 0x10000000 0x0>,
		<0x20010 0xffc00 0x10000>,
		<0x20014 0x3ff00000 0x4000000>,
		<0x24000 0x10000000 0x0>,
		<0x24010 0xffc00 0x10000>,
		<0x24014 0x3ff00000 0x4000000>,
		<0x28000 0x10000000 0x0>,
		<0x28010 0xffc00 0x10000>,
		<0x28014 0x3ff00000 0x4000000>;

	apple,tunable-phy-ip-pll =
		<0x38 0x10000000 0x0>,
		<0x90 0x1 0x1>,
		<0xa4 0x1 0x1>,
		<0x1000 0x3f0000 0x230000>,
		<0x102c 0x3fffffc 0x454444>,
		<0x1204 0x7c 0x54>,
		<0x501c 0x4 0x0>,
		<0x5080 0x3c00000 0x1400000>,
		<0x5088 0xf0000 0x60000>,
		<0x508c 0x3c00000 0x1400000>,
		<0x5094 0xf0000 0x60000>,
		<0x50a0 0xf0000 0x50000>,
		<0x50ac 0xf0000 0x50000>,
		<0x50b8 0xf0000 0x50000>,
		<0x5200 0xa 0xa>,
		<0x5224 0xc00 0x800>,
		<0x5230 0x1f 0x8>,
		<0x5240 0x7d8007f 0x4000049>,
		<0x52b0 0x8700000 0x300000>,
		<0x52e8 0x60000 0x40000>,
		<0x5300 0xffffff 0x78078>,
		<0x5320 0x6 0x2>,
		<0x608c 0x3c3c000 0x1818000>,
		<0x6224 0xc00 0x800>,
		<0x6228 0xf00 0xb00>,
		<0x6230 0x1f 0xf>,
		<0x624c 0x7f 0x5d>,
		<0x62b0 0x700000 0x300000>,
		<0x62e8 0x60000 0x40000>;

	apple,tunable-phy-ip-auspma =
		<0xa000 0xf 0xa>,
		<0xa008 0xf 0xa>,
		<0xa00c 0xf 0xa>,
		<0xa010 0xf 0xa>,
		<0xa014 0xf 0xa>,
		<0xa038 0xffff 0x271>,
		<0xa040 0x800 0x0>,
		<0xa04c 0x3fff 0xbff>,
		<0xa050 0x1 0x1>,
		<0xa068 0x7 0x1>,
		<0xa070 0xfff038e0 0x55b00820>,
		<0xa084 0xffffffff 0x3e8f4240>,
		<0xa088 0xfff 0xfff>,
		<0xa09c 0xfc00000 0x5400000>,
		<0xa0b8 0xff03e000 0xaa03e000>,
		<0xa0bc 0x60fff 0x40faa>,
		<0xa0c0 0x3ff80000 0x14500000>,
		<0xa0c4 0xffff 0x7777>,
		<0xa0e0 0x18000000 0x8000000>,
		<0xa0e8 0x1ff000 0x2000>,
		<0xa10c 0x3fffffff 0xf4240>,
		<0xa11c 0x40000 0x40000>,
		<0xa178 0x3f00000 0x300000>,
		<0xa1b4 0x3ff00 0x1500>,
		<0xa1bc 0x3ff00 0x1500>,
		<0xa1c4 0x1 0x1>,
		<0xa1cc 0x1 0x1>,
		<0xa1e8 0xf 0x0>,
		<0xa1b0 0xffffffff 0x98924>,
		<0xa1b8 0xffffffff 0x98924>,
		<0x12000 0xf 0xa>,
		<0x12008 0xf 0xa>,
		<0x1200c 0xf 0xa>,
		<0x12010 0xf 0xa>,
		<0x12014 0xf 0xa>,
		<0x12038 0xffff 0x271>,
		<0x12040 0x800 0x0>,
		<0x1204c 0x3fff 0xbff>,
		<0x12050 0x1 0x1>,
		<0x12068 0x7 0x1>,
		<0x12070 0xfff038e0 0x55b00820>,
		<0x12084 0xffffffff 0x3e8f4240>,
		<0x12088 0xfff 0xfff>,
		<0x1209c 0xfc00000 0x5400000>,
		<0x120b8 0xff03e000 0xaa03e000>,
		<0x120bc 0x60fff 0x40faa>,
		<0x120c0 0x3ff80000 0x14500000>,
		<0x120c4 0xffff 0x7777>,
		<0x120e0 0x18000000 0x8000000>,
		<0x120e8 0x1ff000 0x2000>,
		<0x1210c 0x3fffffff 0xf4240>,
		<0x1211c 0x40000 0x40000>,
		<0x12178 0x3f00000 0x300000>,
		<0x121b4 0x3ff00 0x1500>,
		<0x121bc 0x3ff00 0x1500>,
		<0x121c4 0x1 0x1>,
		<0x121cc 0x1 0x1>,
		<0x121e8 0xf 0x0>,
		<0x121b0 0xffffffff 0x98924>,
		<0x121b8 0xffffffff 0x98924>,
		<0x1a000 0xf 0xa>,
		<0x1a008 0xf 0xa>,
		<0x1a00c 0xf 0xa>,
		<0x1a010 0xf 0xa>,
		<0x1a014 0xf 0xa>,
		<0x1a038 0xffff 0x271>,
		<0x1a040 0x800 0x0>,
		<0x1a04c 0x3fff 0xbff>,
		<0x1a050 0x1 0x1>,
		<0x1a068 0x7 0x1>,
		<0x1a070 0xfff038e0 0x55b00820>,
		<0x1a084 0xffffffff 0x3e8f4240>,
		<0x1a088 0xfff 0xfff>,
		<0x1a09c 0xfc00000 0x5400000>,
		<0x1a0b8 0xff03e000 0xaa03e000>,
		<0x1a0bc 0x60fff 0x40faa>,
		<0x1a0c0 0x3ff80000 0x14500000>,
		<0x1a0c4 0xffff 0x7777>,
		<0x1a0e0 0x18000000 0x8000000>,
		<0x1a0e8 0x1ff000 0x2000>,
		<0x1a10c 0x3fffffff 0xf4240>,
		<0x1a11c 0x40000 0x40000>,
		<0x1a178 0x3f00000 0x300000>,
		<0x1a1b4 0x3ff00 0x1500>,
		<0x1a1bc 0x3ff00 0x1500>,
		<0x1a1c4 0x1 0x1>,
		<0x1a1cc 0x1 0x1>,
		<0x1a1e8 0xf 0x0>,
		<0x1a1b0 0xffffffff 0x98924>,
		<0x1a1b8 0xffffffff 0x98924>,
		<0xb02c 0x100000 0x100000>,
		<0xb070 0x30 0x20>,
		<0x1302c 0x100000 0x100000>,
		<0x13070 0x30 0x20>,
		<0x1b02c 0x100000 0x100000>,
		<0x1b070 0x30 0x20>,
		<0x9000 0x40000000 0x0>,
		<0x9008 0x10 0x0>,
		<0x903c 0x1800000 0x1800000>,
		<0x90d8 0x3fff 0x68d>,
		<0x90dc 0x3fff 0x408>,
		<0x91e0 0x8 0x8>,
		<0x9280 0xf00000 0xc00000>,
		<0x9280 0xff000f 0xc80001>,
		<0x9288 0x3 0x3>,
		<0x928c 0x3 0x3>,
		<0x11000 0x40000000 0x0>,
		<0x11008 0x10 0x0>,
		<0x1103c 0x1800000 0x1800000>,
		<0x110d8 0x3fff 0x68d>,
		<0x110dc 0x3fff 0x408>,
		<0x111e0 0x8 0x8>,
		<0x11280 0xf00000 0xc00000>,
		<0x11288 0x3 0x3>,
		<0x19000 0x40000000 0x0>,
		<0x19008 0x10 0x0>,
		<0x1903c 0x1800000 0x1800000>,
		<0x190d8 0x3fff 0x68d>,
		<0x190dc 0x3fff 0x408>,
		<0x191e0 0x8 0x8>,
		<0x19280 0xf00000 0xc00000>,
		<0x19288 0x3 0x3>,
		<0xd008 0xc 0xc>,
		<0xd014 0x7efc 0x408>,
		<0x15008 0xc 0xc>,
		<0x15014 0x7efc 0x408>,
		<0x1d008 0xc 0xc>,
		<0x1d014 0x7efc 0x408>,
		<0xc01c 0xe0 0xa0>,
		<0xc080 0x60000000 0x40000000>,
		<0xc08c 0x3f0000 0x3e0000>,
		<0xc0a0 0x1f80000 0x380000>,
		<0xc0ec 0x1 0x0>,
		<0x1401c 0xe0 0xa0>,
		<0x14080 0x60000000 0x40000000>,
		<0x1408c 0x3f0000 0x3e0000>,
		<0x140a0 0x1f80000 0x380000>,
		<0x140ec 0x1 0x0>,
		<0x1c01c 0xe0 0xa0>,
		<0x1c080 0x60000000 0x40000000>,
		<0x1c08c 0x3f0000 0x3e0000>,
		<0x1c0a0 0x1f80000 0x380000>,
		<0x1c0ec 0x1 0x0>,
		<0xe404 0x40000000 0x40000000>,
		<0x16404 0x40000000 0x40000000>,
		<0x1e404 0x40000000 0x40000000>;

	apple,tunable-cio3pll =
		<0x0 0xa0b 0xa01>,
		<0x24 0xc00 0x800>,
		<0x28 0xf00 0xb00>,
		<0x38 0x20 0x0>,
		<0x4c 0xff 0x96>,
		<0xe8 0xe0000 0x20000>,
		<0x100 0xffffff 0xb40b4>;

	apple,tunable-clkgen =
		<0x0 0x3e0 0x220>;

};

&port00 {
	apple,tunable-port =
		<0x140 0x1 0x1>;

	apple,tunable-rc =
		<0x78 0x7000 0x0>,
		<0x8c4 0x3000000 0x3000000>,
		<0xb80 0x7f0000 0x1f0000>;

	apple,tunable-rc-gen3 =
		<0x154 0xf0f 0x404>,
		<0x890 0x3000000 0x0>,
		<0x8a8 0xffff0f 0x1>;

	apple,tunable-rc-gen4 =
		<0x178 0xff 0x44>,
		<0x890 0x3000000 0x1000000>,
		<0x8a8 0xffff0f 0x1>;

};
