// SPDX-License-Identifier: GPL-2.0+ OR MIT
/*
 * MacBook Pro (16-inch PROLED XDR, M5 Max, 2026)
 *
 * target-type: K116c (Mac17,10)
 *
 * Preliminary: described from the ADT only, not yet booted on the hardware.
 *
 * Copyright The Asahi Linux Contributors
 */

#include "t6050-k114-k116.dtsi"

/ {
	compatible = "apple,k116c", "apple,t6050", "apple,arm-platform";
	model = "Apple MacBook Pro (16-inch PROLED XDR, M5 Max, 2026)";
};

&mtp_multitouch {
	firmware-name = "apple/tpmtfw-k116c.bin";
};

#define T6050_K116C
#include "t6050-peripherals.dtsi"
