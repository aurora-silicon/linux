// SPDX-License-Identifier: GPL-2.0+ OR MIT
/* Miscellaneous T8122 interfaces. */

&soc {
	pwm0: pwm@2a1040000 {
		compatible = "apple,t8122-pwm", "apple,pwm";
		reg = <0x2 0xa1040000 0 0x4000>;
		power-domains = <&ps_fpwm0>;
		interrupt-parent = <&aic>;
		interrupts = <AIC_IRQ 789 IRQ_TYPE_LEVEL_HIGH>;
	};
};
