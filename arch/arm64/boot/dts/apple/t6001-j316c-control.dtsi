// SPDX-License-Identifier: GPL-2.0+ OR MIT
/* Populated board control clients. Transport ownership is not transferred. */

&i2c4 {
	sd_card_control: sd-card-control@20 {
		compatible = "apple,t6000-sd-card-control", "apple,sd-card-control";
		reg = <0x20>;
		status = "disabled";
	};
};
