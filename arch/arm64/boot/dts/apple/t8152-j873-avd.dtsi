// SPDX-License-Identifier: GPL-2.0+ OR MIT
/* J873g: the Kopsia video decoder (described in t8152-peripherals.dtsi). */

&ps_avd {
	status = "okay";
};

&avd_dart {
	status = "okay";
};

&avd {
	status = "okay";
};
