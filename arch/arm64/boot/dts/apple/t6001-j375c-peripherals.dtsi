// SPDX-License-Identifier: GPL-2.0+ OR MIT
/* Additional T6001 J375c hardware resources. */

&{/soc} {
	atc3_dpin0: displayport@1301e50000 {
		compatible = "apple,t6000-dpin", "apple,dpin";
		reg = <0x13 0x01e50000 0x0 0x4000>;
		interrupt-parent = <&aic>;
		interrupts = <AIC_IRQ 0 1450 IRQ_TYPE_LEVEL_HIGH>;
	};

	atc3_dpin1: displayport@1301e58000 {
		compatible = "apple,t6000-dpin", "apple,dpin";
		reg = <0x13 0x01e58000 0x0 0x4000>;
		interrupt-parent = <&aic>;
		interrupts = <AIC_IRQ 0 1451 IRQ_TYPE_LEVEL_HIGH>;
	};
};
