// SPDX-License-Identifier: GPL-2.0+ OR MIT
/*
 * J713 ATC PHY CIO (USB4/Thunderbolt) calibration, converted from the ADT. The
 * J713 boot chain does not pass it on yet, so it is described here until a
 * bootloader fills it in. Each property is relative to the PHY bank it is
 * applied to. atcphy0's is unused until that PHY has its banks mapped.
 */

&atcphy0 {
	apple,tunable-cio-axi2af =
		<0x0 0x800000ff 0x8000001b>,
		<0x4 0x80ff00ff 0x800f000f>,
		<0x8 0x80ff00ff 0x801b0003>,
		<0xc 0x80ff00ff 0x800f000f>,
		<0x10 0x80ff00ff 0x800f000f>,
		<0x14 0x80ff00ff 0x800f000f>,
		<0x18 0x80ff00ff 0x80010003>,
		<0x1c 0x80ff00ff 0x80010003>,
		<0x20 0x800000ff 0x80000010>,
		<0x24 0x800000ff 0x8000002c>,
		<0x28 0x80ff00ff 0x80200008>,
		<0x2c 0x80ff00ff 0x80180010>,
		<0x30 0x80ff00ff 0x80200008>,
		<0x34 0x80ff00ff 0x80200008>,
		<0x38 0x80ff00ff 0x800c0004>,
		<0x3c 0x80ff00ff 0x80080008>,
		<0x40 0x800000ff 0x80000018>,
		<0x44 0x800000ff 0x8000000e>,
		<0x48 0x800000ff 0x8000000e>,
		<0x100 0xff 0xff>,
		<0x104 0xff0000 0x10000>,
		<0x108 0xffff0006 0x40000>,
		<0x304 0x3f3f0000 0x8080000>,
		<0x314 0x80000000 0x80000000>,
		<0x31c 0x80000000 0x80000000>,
		<0x324 0x80000000 0x80000000>,
		<0x32c 0x80000000 0x80000000>,
		<0x350 0xffffffff 0xffff>,
		<0x354 0xffffffff 0xffff>,
		<0x408 0xffff0020 0xf0020>,
		<0x948 0x7ff07ff 0x280000>,
		<0xa48 0x7ff07ff 0x400040>,
		<0xb48 0x7ff07ff 0x620050>,
		<0xc48 0x7ff07ff 0x4a004a>,
		<0xf00 0xffffffff 0x7fffffff>,
		<0xf04 0x100 0x100>,
		<0x4008 0x1 0x1>,
		<0x400c 0x1 0x0>,
		<0x4014 0x1 0x1>,
		<0x4018 0x1 0x0>,
		<0x401c 0x1 0x1>,
		<0x4020 0xffff0000 0x0>,
		<0x4024 0xffff0000 0x0>,
		<0x4028 0xffff0000 0x0>,
		<0x402c 0xffff0000 0x0>,
		<0x4030 0xffff0000 0x0>,
		<0x4034 0xffff0000 0x0>,
		<0x4038 0xffff0000 0x0>,
		<0x403c 0xffff0000 0x0>,
		<0x11f8 0x1 0x1>,
		<0x12f8 0x1 0x1>,
		<0x13f8 0x1 0x1>,
		<0x14f8 0x1 0x1>,
		<0x15f8 0x1 0x1>,
		<0x11fc 0x1 0x1>,
		<0x12fc 0x1 0x1>,
		<0x13fc 0x1 0x1>,
		<0x14fc 0x1 0x1>,
		<0x15fc 0x1 0x1>;
	apple,tunable-cio-lioa =
		<0x28 0xfe2f 0x0>,
		<0x2c 0x7 0x0>,
		<0x30 0x7f 0x0>,
		<0x34 0xff 0x0>,
		<0x58 0x10b 0x0>;
	apple,tunable-cio-fabric =
		<0x4 0x3f003f 0x200020>,
		<0xc 0xf1 0xa1>,
		<0x10 0x801f 0x4>,
		<0x18 0x3f003f 0x200020>,
		<0x20 0xf1 0xa1>,
		<0x24 0x801f 0x4>,
		<0x2c 0x7f007f 0x410041>,
		<0x34 0xf1 0x71>,
		<0x38 0x1 0x1>,
		<0x3c 0x1 0x1>,
		<0x40 0x801f 0x4>,
		<0x48 0x1f 0x10>,
		<0x50 0x801f 0x4>,
		<0x58 0x7f007f 0x450045>,
		<0x60 0xf1 0x51>,
		<0x64 0x801f 0x4>,
		<0x6c 0x3f 0x20>,
		<0x74 0x801f 0x4>,
		<0x7c 0x1 0x1>,
		<0x80 0x801f 0x4>,
		<0x88 0x1f001f 0x100010>,
		<0x8c 0xf1 0x11>,
		<0x90 0x1 0x1>,
		<0x94 0x1 0x1>,
		<0x98 0x801f 0x4>,
		<0xa0 0x1f001f 0x100010>,
		<0xa4 0xf1 0x11>,
		<0xa8 0x801f 0x4>,
		<0xb0 0xff 0xa0>,
		<0xb4 0x801f 0x4>,
		<0xbc 0x3f 0x20>,
		<0xc4 0x801f 0x4>,
		<0xcc 0x3f 0x20>,
		<0xd4 0x801f 0x4>,
		<0xdc 0x1f001f 0x100010>,
		<0xe4 0x1 0x1>,
		<0xe8 0x1 0x1>,
		<0xec 0x801f 0x4>,
		<0xf4 0xf 0x8>,
		<0xf8 0x801f 0x4>,
		<0x100 0x1 0x1>,
		<0x104 0x1 0x1>,
		<0x108 0x801f 0x4>,
		<0x110 0x1 0x1>,
		<0x114 0x1 0x1>,
		<0x118 0x801f 0x4>,
		<0x120 0x1 0x1>,
		<0x124 0x1 0x1>,
		<0x128 0x801f 0x4>,
		<0x130 0x1 0x1>,
		<0x134 0x1 0x1>,
		<0x138 0x801f 0x4>,
		<0x140 0xffffffff 0x1010101>,
		<0x144 0x801f 0x4>,
		<0x14c 0x801f 0x4>,
		<0x154 0xffffffff 0x1010101>,
		<0x158 0xffff 0x101>,
		<0x15c 0xffffffff 0x1010101>,
		<0x160 0x801f 0x4>,
		<0x168 0x801f 0x4>,
		<0x170 0x801f 0x4>,
		<0x178 0x1 0x1>,
		<0x17c 0x1 0x1>,
		<0x180 0x801f 0x4>,
		<0x188 0xffffffff 0x1010101>,
		<0x18c 0xffff 0x101>,
		<0x190 0x801f 0x4>,
		<0x198 0x1 0x1>,
		<0x19c 0x1 0x1>,
		<0x1a0 0x801f 0x4>,
		<0x1a8 0x801f 0x4>;
	apple,tunable-cio-config =
		<0x8 0x1 0x1>;
	apple,tunable-cio-common =
		<0x800 0x3f0000 0x230000>,
		<0x2224 0xc00 0x800>,
		<0x2230 0x1f 0xf>,
		<0x2240 0x18007f 0x49>,
		<0x22b0 0x8700000 0x300000>,
		<0x22e8 0x60001 0x40001>,
		<0x2338 0xf800000 0x7800000>,
		<0x2a00 0x888 0x888>,
		<0x2a08 0x1f0000 0x30000>,
		<0x2a24 0xc00 0x800>,
		<0x2a28 0xf00 0xb00>,
		<0x2a30 0x1f 0xf>,
		<0x2a4c 0x7ffe00 0x63ba00>,
		<0x2ab0 0x700000 0x300000>,
		<0x2ae8 0x60000 0x20000>,
		<0x2b00 0xfff 0xd8>,
		<0x2894 0x100 0x100>,
		<0x28a0 0x1ff 0x114>,
		<0x1030 0x8000 0x8000>,
		<0x4000 0xf00700 0xb00000>,
		<0x10c 0x40000 0x0>;
	apple,tunable-cio-lane0 =
		<0x90d8 0x3fff 0x68d>,
		<0x90dc 0x3fff 0x408>,
		<0x9108 0x70 0x30>,
		<0x9288 0xf0000f0 0xe000010>,
		<0xb02c 0x1f0000 0x180000>,
		<0xb030 0x7 0x7>,
		<0xb070 0x30 0x20>,
		<0xc01c 0xe0 0xa0>,
		<0xc0a0 0x1f80000 0x380000>,
		<0xc0a8 0xffffffff 0x1>,
		<0xc0ec 0x1 0x0>,
		<0xd04c 0x4000000 0x0>;
	apple,tunable-cio-lane0-eq =
		<0xa038 0xffff 0x3a9>,
		<0xa084 0xffffffff 0x1f47a120>,
		<0xa088 0xfff 0xfff>,
		<0xa09c 0xf000000 0x5000000>,
		<0xa0c4 0xffff 0x7777>,
		<0xa0e0 0x18000000 0x8000000>,
		<0xa0e8 0x1ff000 0x4000>,
		<0xa10c 0x3fffffff 0x7a120>,
		<0xa110 0x18001 0x8001>,
		<0xa1a4 0x1 0x0>,
		<0xa1b0 0xffffffff 0x9892924>,
		<0xa1b4 0x3ff00 0x5400>,
		<0xa1b8 0xffffffff 0x9892924>,
		<0xa1bc 0x3ff00 0x5400>,
		<0xa1c0 0x1 0x1>,
		<0xa1c4 0x1 0x1>,
		<0xa1cc 0x1 0x1>,
		<0xa1d4 0x1 0x1>,
		<0xa0b8 0xff03e000 0xaa03e000>,
		<0xa0bc 0x4060fff 0x4040faa>,
		<0xa0c0 0xf80000 0x500000>;
	apple,tunable-cio-lane1 =
		<0x100d8 0x3fff 0x68d>,
		<0x100dc 0x3fff 0x408>,
		<0x10108 0x70 0x30>,
		<0x10288 0xf0000f0 0xe000010>,
		<0x1202c 0x1f0000 0x180000>,
		<0x12030 0x7 0x7>,
		<0x12070 0x30 0x20>,
		<0x1301c 0xe0 0xa0>,
		<0x130a0 0x1f80000 0x380000>,
		<0x130a8 0xffffffff 0x1>,
		<0x130ec 0x1 0x0>,
		<0x1404c 0x4000000 0x0>;
	apple,tunable-cio-lane1-eq =
		<0x11038 0xffff 0x3a9>,
		<0x11084 0xffffffff 0x1f47a120>,
		<0x11088 0xfff 0xfff>,
		<0x1109c 0xf000000 0x5000000>,
		<0x110c4 0xffff 0x7777>,
		<0x110e0 0x18000000 0x8000000>,
		<0x110e8 0x1ff000 0x4000>,
		<0x1110c 0x3fffffff 0x7a120>,
		<0x11110 0x18001 0x8001>,
		<0x111a4 0x1 0x0>,
		<0x111b0 0xffffffff 0x9892924>,
		<0x111b4 0x3ff00 0x5400>,
		<0x111b8 0xffffffff 0x9892924>,
		<0x111bc 0x3ff00 0x5400>,
		<0x111c0 0x1 0x1>,
		<0x111c4 0x1 0x1>,
		<0x111cc 0x1 0x1>,
		<0x111d4 0x1 0x1>,
		<0x110b8 0xff03e000 0xaa03e000>,
		<0x110bc 0x4060fff 0x4040faa>,
		<0x110c0 0xf80000 0x500000>;
	apple,tunable-cio-post =
		<0xa04 0x7c 0x48>,
		<0x260c 0x3ff 0x200>;
};

&atcphy1 {
	apple,tunable-cio-axi2af =
		<0x0 0x800000ff 0x8000001b>,
		<0x4 0x80ff00ff 0x800f000f>,
		<0x8 0x80ff00ff 0x801b0003>,
		<0xc 0x80ff00ff 0x800f000f>,
		<0x10 0x80ff00ff 0x800f000f>,
		<0x14 0x80ff00ff 0x800f000f>,
		<0x18 0x80ff00ff 0x80010003>,
		<0x1c 0x80ff00ff 0x80010003>,
		<0x20 0x800000ff 0x80000010>,
		<0x24 0x800000ff 0x8000002c>,
		<0x28 0x80ff00ff 0x80200008>,
		<0x2c 0x80ff00ff 0x80180010>,
		<0x30 0x80ff00ff 0x80200008>,
		<0x34 0x80ff00ff 0x80200008>,
		<0x38 0x80ff00ff 0x800c0004>,
		<0x3c 0x80ff00ff 0x80080008>,
		<0x40 0x800000ff 0x80000018>,
		<0x44 0x800000ff 0x8000000e>,
		<0x48 0x800000ff 0x8000000e>,
		<0x100 0xff 0xff>,
		<0x104 0xff0000 0x10000>,
		<0x108 0xffff0006 0x40000>,
		<0x304 0x3f3f0000 0x8080000>,
		<0x314 0x80000000 0x80000000>,
		<0x31c 0x80000000 0x80000000>,
		<0x324 0x80000000 0x80000000>,
		<0x32c 0x80000000 0x80000000>,
		<0x350 0xffffffff 0xffff>,
		<0x354 0xffffffff 0xffff>,
		<0x408 0xffff0020 0xf0020>,
		<0x948 0x7ff07ff 0x280000>,
		<0xa48 0x7ff07ff 0x400040>,
		<0xb48 0x7ff07ff 0x620050>,
		<0xc48 0x7ff07ff 0x4a004a>,
		<0xf00 0xffffffff 0x7fffffff>,
		<0xf04 0x100 0x100>,
		<0x4008 0x1 0x1>,
		<0x400c 0x1 0x0>,
		<0x4014 0x1 0x1>,
		<0x4018 0x1 0x0>,
		<0x401c 0x1 0x1>,
		<0x4020 0xffff0000 0x0>,
		<0x4024 0xffff0000 0x0>,
		<0x4028 0xffff0000 0x0>,
		<0x402c 0xffff0000 0x0>,
		<0x4030 0xffff0000 0x0>,
		<0x4034 0xffff0000 0x0>,
		<0x4038 0xffff0000 0x0>,
		<0x403c 0xffff0000 0x0>,
		<0x11f8 0x1 0x1>,
		<0x12f8 0x1 0x1>,
		<0x13f8 0x1 0x1>,
		<0x14f8 0x1 0x1>,
		<0x15f8 0x1 0x1>,
		<0x11fc 0x1 0x1>,
		<0x12fc 0x1 0x1>,
		<0x13fc 0x1 0x1>,
		<0x14fc 0x1 0x1>,
		<0x15fc 0x1 0x1>;
	apple,tunable-cio-lioa =
		<0x28 0xfe2f 0x0>,
		<0x2c 0x7 0x0>,
		<0x30 0x7f 0x0>,
		<0x34 0xff 0x0>,
		<0x58 0x10b 0x0>;
	apple,tunable-cio-fabric =
		<0x4 0x3f003f 0x200020>,
		<0xc 0xf1 0xa1>,
		<0x10 0x801f 0x4>,
		<0x18 0x3f003f 0x200020>,
		<0x20 0xf1 0xa1>,
		<0x24 0x801f 0x4>,
		<0x2c 0x7f007f 0x410041>,
		<0x34 0xf1 0x71>,
		<0x38 0x1 0x1>,
		<0x3c 0x1 0x1>,
		<0x40 0x801f 0x4>,
		<0x48 0x1f 0x10>,
		<0x50 0x801f 0x4>,
		<0x58 0x7f007f 0x450045>,
		<0x60 0xf1 0x51>,
		<0x64 0x801f 0x4>,
		<0x6c 0x3f 0x20>,
		<0x74 0x801f 0x4>,
		<0x7c 0x1 0x1>,
		<0x80 0x801f 0x4>,
		<0x88 0x1f001f 0x100010>,
		<0x8c 0xf1 0x11>,
		<0x90 0x1 0x1>,
		<0x94 0x1 0x1>,
		<0x98 0x801f 0x4>,
		<0xa0 0x1f001f 0x100010>,
		<0xa4 0xf1 0x11>,
		<0xa8 0x801f 0x4>,
		<0xb0 0xff 0xa0>,
		<0xb4 0x801f 0x4>,
		<0xbc 0x3f 0x20>,
		<0xc4 0x801f 0x4>,
		<0xcc 0x3f 0x20>,
		<0xd4 0x801f 0x4>,
		<0xdc 0x1f001f 0x100010>,
		<0xe4 0x1 0x1>,
		<0xe8 0x1 0x1>,
		<0xec 0x801f 0x4>,
		<0xf4 0xf 0x8>,
		<0xf8 0x801f 0x4>,
		<0x100 0x1 0x1>,
		<0x104 0x1 0x1>,
		<0x108 0x801f 0x4>,
		<0x110 0x1 0x1>,
		<0x114 0x1 0x1>,
		<0x118 0x801f 0x4>,
		<0x120 0x1 0x1>,
		<0x124 0x1 0x1>,
		<0x128 0x801f 0x4>,
		<0x130 0x1 0x1>,
		<0x134 0x1 0x1>,
		<0x138 0x801f 0x4>,
		<0x140 0xffffffff 0x1010101>,
		<0x144 0x801f 0x4>,
		<0x14c 0x801f 0x4>,
		<0x154 0xffffffff 0x1010101>,
		<0x158 0xffff 0x101>,
		<0x15c 0xffffffff 0x1010101>,
		<0x160 0x801f 0x4>,
		<0x168 0x801f 0x4>,
		<0x170 0x801f 0x4>,
		<0x178 0x1 0x1>,
		<0x17c 0x1 0x1>,
		<0x180 0x801f 0x4>,
		<0x188 0xffffffff 0x1010101>,
		<0x18c 0xffff 0x101>,
		<0x190 0x801f 0x4>,
		<0x198 0x1 0x1>,
		<0x19c 0x1 0x1>,
		<0x1a0 0x801f 0x4>,
		<0x1a8 0x801f 0x4>;
	apple,tunable-cio-config =
		<0x8 0x1 0x1>;
	apple,tunable-cio-common =
		<0x800 0x3f0000 0x230000>,
		<0x2224 0xc00 0x800>,
		<0x2230 0x1f 0xf>,
		<0x2240 0x18007f 0x39>,
		<0x22b0 0x8700000 0x300000>,
		<0x22e8 0x60001 0x40001>,
		<0x2338 0xf800000 0x7800000>,
		<0x2a00 0x888 0x888>,
		<0x2a08 0x1f0000 0x30000>,
		<0x2a24 0xc00 0x800>,
		<0x2a28 0xf00 0xb00>,
		<0x2a30 0x1f 0xf>,
		<0x2a4c 0x7ffe00 0x33ba00>,
		<0x2ab0 0x700000 0x300000>,
		<0x2ae8 0x60000 0x20000>,
		<0x2b00 0xfff 0xd8>,
		<0x2894 0x100 0x100>,
		<0x28a0 0x1ff 0x114>,
		<0x1030 0x8000 0x8000>,
		<0x4000 0xf00700 0xb00000>,
		<0x10c 0x40000 0x0>;
	apple,tunable-cio-lane0 =
		<0x90d8 0x3fff 0x68d>,
		<0x90dc 0x3fff 0x408>,
		<0x9108 0x70 0x30>,
		<0x9288 0xf0000f0 0xe000010>,
		<0xb02c 0x1f0000 0x180000>,
		<0xb030 0x7 0x7>,
		<0xb070 0x30 0x20>,
		<0xc01c 0xe0 0xa0>,
		<0xc0a0 0x1f80000 0x380000>,
		<0xc0a8 0xffffffff 0x1>,
		<0xc0ec 0x1 0x0>,
		<0xd04c 0x4000000 0x0>;
	apple,tunable-cio-lane0-eq =
		<0xa038 0xffff 0x3a9>,
		<0xa084 0xffffffff 0x1f47a120>,
		<0xa088 0xfff 0xfff>,
		<0xa09c 0xf000000 0x5000000>,
		<0xa0c4 0xffff 0x7777>,
		<0xa0e0 0x18000000 0x8000000>,
		<0xa0e8 0x1ff000 0x4000>,
		<0xa10c 0x3fffffff 0x7a120>,
		<0xa110 0x18001 0x8001>,
		<0xa1a4 0x1 0x0>,
		<0xa1b0 0xffffffff 0x9892924>,
		<0xa1b4 0x3ff00 0x5400>,
		<0xa1b8 0xffffffff 0x9892924>,
		<0xa1bc 0x3ff00 0x5400>,
		<0xa1c0 0x1 0x1>,
		<0xa1c4 0x1 0x1>,
		<0xa1cc 0x1 0x1>,
		<0xa1d4 0x1 0x1>,
		<0xa0b8 0xff03e000 0xaa03e000>,
		<0xa0bc 0x4060fff 0x4040faa>,
		<0xa0c0 0xf80000 0x500000>;
	apple,tunable-cio-lane1 =
		<0x100d8 0x3fff 0x68d>,
		<0x100dc 0x3fff 0x408>,
		<0x10108 0x70 0x30>,
		<0x10288 0xf0000f0 0xe000010>,
		<0x1202c 0x1f0000 0x180000>,
		<0x12030 0x7 0x7>,
		<0x12070 0x30 0x20>,
		<0x1301c 0xe0 0xa0>,
		<0x130a0 0x1f80000 0x380000>,
		<0x130a8 0xffffffff 0x1>,
		<0x130ec 0x1 0x0>,
		<0x1404c 0x4000000 0x0>;
	apple,tunable-cio-lane1-eq =
		<0x11038 0xffff 0x3a9>,
		<0x11084 0xffffffff 0x1f47a120>,
		<0x11088 0xfff 0xfff>,
		<0x1109c 0xf000000 0x5000000>,
		<0x110c4 0xffff 0x7777>,
		<0x110e0 0x18000000 0x8000000>,
		<0x110e8 0x1ff000 0x4000>,
		<0x1110c 0x3fffffff 0x7a120>,
		<0x11110 0x18001 0x8001>,
		<0x111a4 0x1 0x0>,
		<0x111b0 0xffffffff 0x9892924>,
		<0x111b4 0x3ff00 0x5400>,
		<0x111b8 0xffffffff 0x9892924>,
		<0x111bc 0x3ff00 0x5400>,
		<0x111c0 0x1 0x1>,
		<0x111c4 0x1 0x1>,
		<0x111cc 0x1 0x1>,
		<0x111d4 0x1 0x1>,
		<0x110b8 0xff03e000 0xaa03e000>,
		<0x110bc 0x4060fff 0x4040faa>,
		<0x110c0 0xf80000 0x500000>;
	apple,tunable-cio-post =
		<0xa04 0x7c 0x3c>,
		<0x260c 0x3ff 0x200>;
};

