// SPDX-License-Identifier: GPL-2.0+ OR MIT
/*
 * The keyboard backlight of the T6050 MacBook Pros. Each board's ADT has it
 * as pwm0/kbd-backlight: channel 0 of fpwm0 at 25 kHz, a 40000 ns period.
 *
 * Copyright The Asahi Linux Contributors
 */

#include <dt-bindings/leds/common.h>

/ {
	led-controller {
		compatible = "pwm-leds";

		led-0 {
			pwms = <&fpwm0 0 40000>;
			label = "kbd_backlight";
			function = LED_FUNCTION_KBD_BACKLIGHT;
			color = <LED_COLOR_ID_WHITE>;
			max-brightness = <255>;
			default-state = "keep";
		};
	};
};

&fpwm0 {
	status = "okay";
};
