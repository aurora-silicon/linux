// SPDX-License-Identifier: GPL-2.0+ OR MIT
/*
 * USB3 tunables of the J773s back Type-C ports, from its ADT (macOS 26.6.2).
 * Every table is the J616s one except these PLL trims, which differ per port.
 */

#include "t6040-j616s-usb3.dtsi"

&atcphy0 {
	apple,tunable-auspll =
		<0x3224 0x00000c00 0x00000800>,
		<0x3230 0x0000001f 0x0000000f>,
		<0x3240 0x07d8007f 0x04000049>,
		<0x32b0 0x0b800000 0x01800000>,
		<0x32e8 0x00060001 0x00040001>,
		<0x3338 0x0f800000 0x07800000>;
	apple,tunable-cio4pll =
		<0x3a30 0x0000001f 0x0000000f>,
		<0x3a4c 0x0000fe7f 0x00004e1d>,
		<0x3ab0 0x00700000 0x00300000>,
		<0x3ae8 0x00060000 0x00020000>;
};

&atcphy1 {
	apple,tunable-aus40cmn-shm =
		<0xa04 0x0000007c 0x00000054>;
	apple,tunable-cio4pll =
		<0x3a30 0x0000001f 0x0000000f>,
		<0x3a4c 0x0000fe7f 0x00004e1e>,
		<0x3ab0 0x00700000 0x00300000>,
		<0x3ae8 0x00060000 0x00020000>;
};

&atcphy2 {
	apple,tunable-aus40cmn-shm =
		<0xa04 0x0000007c 0x00000048>;
	apple,tunable-cio4pll =
		<0x3a30 0x0000001f 0x0000000f>,
		<0x3a4c 0x0000fe7f 0x00004e1d>,
		<0x3ab0 0x00700000 0x00300000>,
		<0x3ae8 0x00060000 0x00020000>;
};
