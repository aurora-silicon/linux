// SPDX-License-Identifier: GPL-2.0+ OR MIT
/*
 * Mac Studio (M5 Max, 2026)
 *
 * target-type: J775c
 *
 * One T6050 die (t6050-max.dtsi). Nobody has booted Linux on this board
 * yet: beyond the SoC this file only adds the board's hardware inventory
 * (t6050-peripherals.dtsi), all of it disabled, from the board's ADT.
 *
 * Copyright The Asahi Linux Contributors
 */

/dts-v1/;

#include "t6050-max.dtsi"

/ {
	compatible = "apple,j775c", "apple,t6050", "apple,arm-platform";
	model = "Apple Mac Studio (M5 Max, 2026)";
	chassis-type = "desktop";

	chosen {
		#address-cells = <2>;
		#size-cells = <2>;
		ranges;
	};
};

/*
 * From this board's macOS 27.2 (26B123) Automatic energy-mode CLPC floor
 * residency under one CPU-bound thread: the top of the two DCS/fabric pairs
 * it alternates between, read as DCS 6 and fabric 3 (state order, not
 * verified). Low Power mode drops this floor and uses the SoC table instead.
 */
&clpc {
	apple,cpu-busy-floor = <6 3>;
};

/* PCIe port 0 is not described for this board yet */
&pcie0 {
	status = "disabled";
};

#define T6050_J775C
/* The M5 Max die-0 blocks (nub-spmi1, nub-spmi4) */
#include "t6050-soc-max.dtsi"
#include "t6050-peripherals.dtsi"
