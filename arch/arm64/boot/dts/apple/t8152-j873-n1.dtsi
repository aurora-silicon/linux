// SPDX-License-Identifier: GPL-2.0+ OR MIT
/*
 * J873g N1 on APCIE port 0: the J873g's own GPIO controller and port-0 DART
 * (the J873g tree does not include t8152.dtsi), then the shared apcie host
 * and port 0 from t8152-n1.dtsi.
 */

/ {
	soc {
		pinctrl_ap: pinctrl@31a000000 {
			compatible = "apple,t8152-pinctrl", "apple,t8103-pinctrl";
			reg = <0x3 0x1a000000 0x0 0x100000>;
			gpio-controller;
			#gpio-cells = <2>;
			gpio-ranges = <&pinctrl_ap 0 0 224>;
			apple,npins = <224>;
			interrupt-controller;
			#interrupt-cells = <2>;
			interrupts = <AIC_IRQ 433 IRQ_TYPE_LEVEL_HIGH>,
				     <AIC_IRQ 434 IRQ_TYPE_LEVEL_HIGH>,
				     <AIC_IRQ 435 IRQ_TYPE_LEVEL_HIGH>,
				     <AIC_IRQ 436 IRQ_TYPE_LEVEL_HIGH>,
				     <AIC_IRQ 437 IRQ_TYPE_LEVEL_HIGH>,
				     <AIC_IRQ 438 IRQ_TYPE_LEVEL_HIGH>,
				     <AIC_IRQ 439 IRQ_TYPE_LEVEL_HIGH>;
		};

		pcie0_dart: iommu@388000000 {
			compatible = "apple,t8152-dart", "apple,t8110-dart";
			reg = <0x3 0x88000000 0x0 0xc000>;
			#iommu-cells = <1>;
			interrupts = <AIC_IRQ 1572 IRQ_TYPE_LEVEL_HIGH>;
		};
	};
};

#include "t8152-n1.dtsi"
