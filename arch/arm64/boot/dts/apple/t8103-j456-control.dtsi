// SPDX-License-Identifier: GPL-2.0+ OR MIT
/* Populated board control clients. Transport ownership is not transferred. */

&spi4 {
	panel_controller: panel-timing-controller@0 {
		compatible = "parade,dp855";
		reg = <0>;
		status = "disabled";
	};
};
