// SPDX-License-Identifier: GPL-2.0+ OR MIT
/*
 * MacBook Pro (14-inch PROLED XDR, M5 Max, 2026)
 *
 * target-type: K114c (Mac17,11)
 *
 * Boots on the hardware; the SD card reader (PCIe port 1) is tested. The other
 * blocks are described from the ADT.
 *
 * Copyright The Asahi Linux Contributors
 */

/* Defined before the includes: t6050-max.dtsi guards the ATC2 router on it. */
#define T6050_K114C
/* The M5 Max die-0 blocks (nub-spmi1, nub-spmi4) */
#include "t6050-soc-max.dtsi"
/* ADT /arm-io/acio2: the right port's USB4/Thunderbolt router */
#define T6050_ATC2_USB4_ROUTER
/* The N1's firmware and this board's ADT board-id, for t6050-k114-k116.dtsi */
#define T6050_K_N1_FIRMWARE	"apple/centauri/k114c-ftab.bin"
#define T6050_K_BOARD_ID	0x04
#include "t6050-k114-k116.dtsi"

/ {
	compatible = "apple,k114c", "apple,t6050", "apple,arm-platform";
	model = "Apple MacBook Pro (14-inch PROLED XDR, M5 Max, 2026)";
};

&mtp_multitouch {
	firmware-name = "apple/tpmtfw-k114c.bin";
};

#include "t6050-peripherals.dtsi"

/* The 14-inch chassis: the Neural Engine, pins, the jack, the card and the AOP */
#include "t6050-k114.dtsi"

/* The GPU, handed over by the boot loader */
#include "t6050-k114-k116-gpu.dtsi"

/* The internal panel, handed over by the boot loader */
#include "t6050-k114-k116-display.dtsi"

/*
 * The 14.2-inch 3024x1986 panel's active area (254 dpi, the notch rows included), for the
 * DPI only (the ADT carries none)
 */
&panel {
	compatible = "apple,panel-k114", "apple,panel";
	width-mm = <302>;
	height-mm = <199>;
};

/* Touch ID: the SEP and the Mesa sensor, with this Mac's own calibration and root key */
#define T6050_TOUCHID_FIRMWARE	"apple/mesacal-k114c.bin", "apple/msrk-k114c.bin"
#include "t6050-touchid.dtsi"

/*
 * The USB-C ports ATC1 and ATC2, as on the other K boards (t6050-k114-k116-usb.dtsi), then the
 * 14-inch chassis' MagSafe 3 PD controller and the right port's USB4/Thunderbolt router
 * (t6050-k114-usb.dtsi).
 */
#include "t6050-k114-k116-usb.dtsi"
#include "t6050-k114-usb.dtsi"
