// SPDX-License-Identifier: GPL-2.0+ OR MIT
/* Explicit CPU register descriptors; no firmware debug sequences. */

/ {
	cpu_debug: debug-controller@210010000 {
		compatible = "apple,t8103-cpu-debug", "apple,cpu-debug";
		reg = <0x2 0x10010000 0x0 0x40000>,
		      <0x2 0x10040000 0x0 0x10000>,
		      <0x2 0x10110000 0x0 0x40000>,
		      <0x2 0x10140000 0x0 0x10000>,
		      <0x2 0x10210000 0x0 0x40000>,
		      <0x2 0x10240000 0x0 0x10000>,
		      <0x2 0x10310000 0x0 0x40000>,
		      <0x2 0x10340000 0x0 0x10000>,
		      <0x2 0x11010000 0x0 0x40000>,
		      <0x2 0x11040000 0x0 0x10000>,
		      <0x2 0x11110000 0x0 0x40000>,
		      <0x2 0x11140000 0x0 0x10000>,
		      <0x2 0x11210000 0x0 0x40000>,
		      <0x2 0x11240000 0x0 0x10000>,
		      <0x2 0x11310000 0x0 0x40000>,
		      <0x2 0x11340000 0x0 0x10000>;
		reg-names = "cpu0-coresight", "cpu0-uttdbg", "cpu1-coresight", "cpu1-uttdbg", "cpu2-coresight", "cpu2-uttdbg", "cpu3-coresight", "cpu3-uttdbg", "cpu4-coresight", "cpu4-uttdbg", "cpu5-coresight", "cpu5-uttdbg", "cpu6-coresight", "cpu6-uttdbg", "cpu7-coresight", "cpu7-uttdbg";
		apple,cpu-ids = /bits/ 64 <0x0 0x0 0x1 0x1 0x2 0x2 0x3 0x3 0x100 0x100 0x101 0x101 0x102 0x102 0x103 0x103>;
		status = "disabled";
	};
};
