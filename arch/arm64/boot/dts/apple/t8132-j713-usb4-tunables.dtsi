// SPDX-License-Identifier: GPL-2.0+ OR MIT
/*
 * J713 USB4 host router calibration and DROM, converted from the ADT the way
 * m1n1 does it. The J713 boot chain does not pass these on yet, so they are
 * described here until a bootloader fills them in. The DROM carries a fixed
 * placeholder router UUID; a bootloader derives a per-machine one.
 */

&usb4_0_acio {
	apple,tunable-rc =
		<0x0 0xfff0 0x5010>,
		<0x2c 0x4 0x0>,
		<0xac 0xffffffff 0x5ce75ce7>,
		<0x4004 0x7f007f 0x400040>,
		<0x4008 0x801f 0x4>,
		<0x4010 0x7f 0x40>,
		<0x4014 0x801f 0x4>,
		<0x401c 0x1f 0x10>,
		<0x4024 0x801f 0x4>,
		<0x402c 0x1f 0x10>,
		<0x4030 0x801f 0x4>,
		<0x4038 0xffffffff 0x1010101>,
		<0x403c 0xffff 0x101>,
		<0x4040 0x1 0x1>,
		<0x4044 0xffffffff 0x1010101>,
		<0x4048 0x1 0x1>,
		<0x404c 0x801f 0x4>,
		<0x8004 0x70007 0x40004>,
		<0x8008 0x801f 0x4>,
		<0x8010 0x70007 0x40004>,
		<0x8018 0x801f 0x4>,
		<0x8020 0x70007 0x40004>,
		<0x8028 0x801f 0x4>,
		<0x8030 0x801f 0x4>,
		<0x8038 0x801f 0x4>,
		<0x8040 0x801f 0x4>,
		<0x8048 0x801f 0x4>,
		<0x8050 0x801f 0x4>,
		<0x8058 0x801f 0x4>,
		<0x8060 0x801f 0x4>;
	apple,tunable-pcie-adapter =
		<0x1008 0x6 0x6>;
};

&usb4_0_nhi {
	apple,tunable-nhi =
		<0xf0004 0xf 0x8>,
		<0xf0008 0x801f 0x4>,
		<0xf0010 0xf 0x8>,
		<0xf0014 0x801f 0x4>,
		<0xf001c 0xf 0x8>,
		<0xf0020 0x801f 0x4>,
		<0xf0028 0xf 0x8>,
		<0xf002c 0x801f 0x4>,
		<0xf0034 0xf 0x8>,
		<0xf0038 0x801f 0x4>,
		<0xf0040 0xf 0x8>,
		<0xf0044 0x801f 0x4>,
		<0xf004c 0xf 0x8>,
		<0xf0050 0x801f 0x4>,
		<0xf0058 0xf 0x8>,
		<0xf005c 0x801f 0x4>,
		<0xf0064 0xf 0x8>,
		<0xf0068 0x801f 0x4>,
		<0xf0070 0xf 0x8>,
		<0xf0074 0x801f 0x4>,
		<0xf007c 0xf 0x8>,
		<0xf0080 0x801f 0x4>,
		<0xf0088 0xf 0x8>,
		<0xf008c 0x801f 0x4>,
		<0xf0094 0x8007 0x1>,
		<0xec004 0x3f 0x30>,
		<0xec008 0x801f 0x4>,
		<0xec010 0x3f 0x30>,
		<0xec014 0x801f 0x4>,
		<0xec01c 0x3f 0x30>,
		<0xec020 0x801f 0x4>,
		<0xec028 0x3f 0x30>,
		<0xec02c 0x801f 0x4>,
		<0xec034 0x3f 0x30>,
		<0xec038 0x801f 0x4>,
		<0xec040 0x3f 0x30>,
		<0xec044 0x801f 0x4>,
		<0xec04c 0x3f 0x30>,
		<0xec050 0x801f 0x4>,
		<0xec058 0x3f 0x30>,
		<0xec05c 0x801f 0x4>,
		<0xec064 0x3f 0x30>,
		<0xec068 0x801f 0x4>,
		<0xec070 0x3f 0x30>,
		<0xec074 0x801f 0x4>,
		<0xec07c 0x3f 0x30>,
		<0xec080 0x801f 0x4>,
		<0xec088 0x3f 0x30>,
		<0xec08c 0x801f 0x4>,
		<0xec094 0xffffffff 0x1010101>,
		<0xec098 0xffffffff 0x1010101>,
		<0xec09c 0xffffffff 0x1010101>,
		<0xec0a0 0xffffffff 0x1010101>,
		<0xec0a4 0xffffffff 0x1010101>,
		<0xec0a8 0xffffffff 0x1010101>,
		<0xec0ac 0x1 0x1>,
		<0xec0b0 0x8007 0x1>,
		<0xe8004 0xf 0x8>,
		<0xe8008 0x801f 0x4>,
		<0xe8010 0xf 0x8>,
		<0xe8014 0x801f 0x4>,
		<0xe801c 0xf 0x8>,
		<0xe8020 0x801f 0x4>,
		<0xe8028 0xf 0x8>,
		<0xe802c 0x801f 0x4>,
		<0xe8034 0xf 0x8>,
		<0xe8038 0x801f 0x4>,
		<0xe8040 0xf 0x8>,
		<0xe8044 0x801f 0x4>,
		<0xe804c 0xf 0x8>,
		<0xe8050 0x801f 0x4>,
		<0xe8058 0xf 0x8>,
		<0xe805c 0x801f 0x4>,
		<0xe8064 0xf 0x8>,
		<0xe8068 0x801f 0x4>,
		<0xe8070 0xf 0x8>,
		<0xe8074 0x801f 0x4>,
		<0xe807c 0xf 0x8>,
		<0xe8080 0x801f 0x4>,
		<0xe8088 0xf 0x8>,
		<0xe808c 0x801f 0x4>,
		<0xe8094 0x8007 0x1>,
		<0xf4004 0x1f 0x1f>,
		<0xf4008 0x801f 0x4>,
		<0xf4010 0x1f 0x1f>,
		<0xf4014 0x801f 0x4>,
		<0xf401c 0x1f 0x1f>,
		<0xf4020 0x801f 0x4>,
		<0xf4028 0x1f 0x1f>,
		<0xf402c 0x801f 0x4>,
		<0xf4034 0x1f 0x1f>,
		<0xf4038 0x801f 0x4>,
		<0xf4040 0x1f 0x1f>,
		<0xf4044 0x801f 0x4>,
		<0xf404c 0x1f 0x1f>,
		<0xf4050 0x801f 0x4>,
		<0xf4058 0x1f 0x1f>,
		<0xf405c 0x801f 0x4>,
		<0xf4064 0x1f 0x1f>,
		<0xf4068 0x801f 0x4>,
		<0xf4070 0x1f 0x1f>,
		<0xf4074 0x801f 0x4>,
		<0xf407c 0x1f 0x1f>,
		<0xf4080 0x801f 0x4>,
		<0xf4088 0x1f 0x1f>,
		<0xf408c 0x801f 0x4>,
		<0xf4094 0x1f 0x1f>,
		<0xf4098 0x801f 0x4>,
		<0xf40a0 0xffffffff 0x1010101>,
		<0xf40a4 0xffffffff 0x1010101>,
		<0xf40a8 0xffffffff 0x1010101>,
		<0xf40ac 0xffffffff 0x1010101>,
		<0xf40b0 0xffffffff 0x1010101>,
		<0xf40b4 0xffffffff 0x1010101>,
		<0xf40b8 0xffff 0x101>,
		<0xf40bc 0x1 0x1>,
		<0xf40c0 0x8007 0x1>,
		<0xf8004 0x1f 0x10>,
		<0xf8008 0x801f 0x4>,
		<0xf8010 0x3f 0x30>,
		<0xf8014 0x801f 0x4>,
		<0xf801c 0x1f 0x10>,
		<0xf8020 0x801f 0x4>,
		<0xf8028 0x7f 0x60>,
		<0xf802c 0x801f 0x4>,
		<0xf8034 0x8007 0x1>,
		<0xfc004 0x7 0x4>,
		<0xfc008 0x8007 0x1>,
		<0xfc010 0x7 0x4>,
		<0xfc014 0x8007 0x1>,
		<0xfc01c 0x7 0x4>,
		<0xfc020 0x8007 0x1>,
		<0xfc028 0x7 0x4>,
		<0xfc02c 0x8007 0x1>,
		<0xfc034 0x7 0x4>,
		<0xfc038 0x8007 0x1>,
		<0xfc040 0x7 0x4>,
		<0xfc044 0x8007 0x1>,
		<0xfc04c 0x7 0x4>,
		<0xfc050 0x8007 0x1>,
		<0xfc058 0x7 0x4>,
		<0xfc05c 0x8007 0x1>,
		<0xfc064 0x7 0x4>,
		<0xfc068 0x8007 0x1>,
		<0xfc070 0x7 0x4>,
		<0xfc074 0x8007 0x1>,
		<0xfc07c 0x7 0x4>,
		<0xfc080 0x8007 0x1>,
		<0xfc088 0x7 0x4>,
		<0xfc08c 0x8007 0x1>,
		<0xfc094 0x7 0x4>,
		<0xfc098 0x8007 0x1>,
		<0xfc0a0 0x8007 0x1>,
		<0x4000 0x1000000f 0x10000002>,
		<0x4004 0x1000000f 0x10000002>,
		<0x4008 0x1000000f 0x10000002>,
		<0x400c 0x1000000f 0x10000002>,
		<0x4010 0x1000000f 0x10000002>,
		<0x4014 0x1000000f 0x10000002>,
		<0x4018 0x1000000f 0x10000002>,
		<0x401c 0x1000000f 0x10000002>,
		<0x4020 0x1000000f 0x10000002>,
		<0x4024 0x1000000f 0x10000002>,
		<0x4028 0x1000000f 0x10000002>,
		<0x402c 0x1000000f 0x10000002>,
		<0x4040 0x1000000f 0x2>,
		<0x4044 0x1000000f 0x2>,
		<0x4048 0x1000000f 0x2>,
		<0x404c 0x1000000f 0x2>,
		<0x4050 0x1000000f 0x2>,
		<0x4054 0x1000000f 0x2>,
		<0x4058 0x1000000f 0x2>,
		<0x405c 0x1000000f 0x2>,
		<0x4060 0x1000000f 0x2>,
		<0x4064 0x1000000f 0x2>,
		<0x4068 0x1000000f 0x2>,
		<0x406c 0x1000000f 0x2>,
		<0x4080 0x1000000f 0x10000002>,
		<0x4084 0x1000000f 0x10000002>,
		<0x4088 0x1000000f 0x10000002>,
		<0x408c 0x1000000f 0x10000002>,
		<0x4090 0x1000000f 0x10000002>,
		<0x4094 0x1000000f 0x10000002>,
		<0x4098 0x1000000f 0x10000002>,
		<0x409c 0x1000000f 0x10000002>,
		<0x40a0 0x1000000f 0x10000002>,
		<0x40a4 0x1000000f 0x10000002>,
		<0x40a8 0x1000000f 0x10000002>,
		<0x40ac 0x1000000f 0x10000002>,
		<0x40c0 0x1000000f 0x10000002>,
		<0x40c4 0x1000000f 0x10000002>,
		<0x40c8 0x1000000f 0x10000002>,
		<0x40cc 0x1000000f 0x10000002>,
		<0x40d0 0x1000000f 0x10000002>,
		<0x40d4 0x1000000f 0x10000002>,
		<0x40d8 0x1000000f 0x10000002>,
		<0x40dc 0x1000000f 0x10000002>,
		<0x40e0 0x1000000f 0x10000002>,
		<0x40e4 0x1000000f 0x10000002>,
		<0x40e8 0x1000000f 0x10000002>,
		<0x40ec 0x1000000f 0x10000002>,
		<0x4100 0x1000000f 0x2>,
		<0x4104 0x1000000f 0x2>,
		<0x4108 0x1000000f 0x2>,
		<0x410c 0x1000000f 0x2>,
		<0x4110 0x1000000f 0x2>,
		<0x4114 0x1000000f 0x2>,
		<0x4118 0x1000000f 0x2>,
		<0x411c 0x1000000f 0x2>,
		<0x4120 0x1000000f 0x2>,
		<0x4124 0x1000000f 0x2>,
		<0x4128 0x1000000f 0x2>,
		<0x412c 0x1000000f 0x2>,
		<0x4140 0x1000000f 0x10000002>,
		<0x4144 0x1000000f 0x10000002>,
		<0x4148 0x1000000f 0x10000002>,
		<0x414c 0x1000000f 0x10000002>,
		<0x4150 0x1000000f 0x10000002>,
		<0x4154 0x1000000f 0x10000002>,
		<0x4158 0x1000000f 0x10000002>,
		<0x415c 0x1000000f 0x10000002>,
		<0x4160 0x1000000f 0x10000002>,
		<0x4164 0x1000000f 0x10000002>,
		<0x4168 0x1000000f 0x10000002>,
		<0x416c 0x1000000f 0x10000002>,
		<0x43f0 0x1ffffff 0x1ffffff>;
	apple,thunderbolt-drom = [0a 20 67 38 9e 1c 16 a3 d4 5d 2d 12 e9 01 42 00
		01 00 0f 00 01 00 08 81 80 02 80 00 00 00 08 82
		90 01 80 00 00 00 03 83 20 02 84 05 85 09 01 00
		05 86 09 01 00 02 87 05 88 09 01 00 0d 01 41 70
		70 6c 65 20 49 6e 63 2e 00 06 02 69 4f 53 00 00];
};

&usb4_1_acio {
	apple,tunable-rc =
		<0x0 0xfff0 0x5010>,
		<0x2c 0x4 0x0>,
		<0xac 0xffffffff 0x5ce75ce7>,
		<0x4004 0x7f007f 0x400040>,
		<0x4008 0x801f 0x4>,
		<0x4010 0x7f 0x40>,
		<0x4014 0x801f 0x4>,
		<0x401c 0x1f 0x10>,
		<0x4024 0x801f 0x4>,
		<0x402c 0x1f 0x10>,
		<0x4030 0x801f 0x4>,
		<0x4038 0xffffffff 0x1010101>,
		<0x403c 0xffff 0x101>,
		<0x4040 0x1 0x1>,
		<0x4044 0xffffffff 0x1010101>,
		<0x4048 0x1 0x1>,
		<0x404c 0x801f 0x4>,
		<0x8004 0x70007 0x40004>,
		<0x8008 0x801f 0x4>,
		<0x8010 0x70007 0x40004>,
		<0x8018 0x801f 0x4>,
		<0x8020 0x70007 0x40004>,
		<0x8028 0x801f 0x4>,
		<0x8030 0x801f 0x4>,
		<0x8038 0x801f 0x4>,
		<0x8040 0x801f 0x4>,
		<0x8048 0x801f 0x4>,
		<0x8050 0x801f 0x4>,
		<0x8058 0x801f 0x4>,
		<0x8060 0x801f 0x4>;
	apple,tunable-pcie-adapter =
		<0x1008 0x6 0x6>;
};

&usb4_1_nhi {
	apple,tunable-nhi =
		<0xf0004 0xf 0x8>,
		<0xf0008 0x801f 0x4>,
		<0xf0010 0xf 0x8>,
		<0xf0014 0x801f 0x4>,
		<0xf001c 0xf 0x8>,
		<0xf0020 0x801f 0x4>,
		<0xf0028 0xf 0x8>,
		<0xf002c 0x801f 0x4>,
		<0xf0034 0xf 0x8>,
		<0xf0038 0x801f 0x4>,
		<0xf0040 0xf 0x8>,
		<0xf0044 0x801f 0x4>,
		<0xf004c 0xf 0x8>,
		<0xf0050 0x801f 0x4>,
		<0xf0058 0xf 0x8>,
		<0xf005c 0x801f 0x4>,
		<0xf0064 0xf 0x8>,
		<0xf0068 0x801f 0x4>,
		<0xf0070 0xf 0x8>,
		<0xf0074 0x801f 0x4>,
		<0xf007c 0xf 0x8>,
		<0xf0080 0x801f 0x4>,
		<0xf0088 0xf 0x8>,
		<0xf008c 0x801f 0x4>,
		<0xf0094 0x8007 0x1>,
		<0xec004 0x3f 0x30>,
		<0xec008 0x801f 0x4>,
		<0xec010 0x3f 0x30>,
		<0xec014 0x801f 0x4>,
		<0xec01c 0x3f 0x30>,
		<0xec020 0x801f 0x4>,
		<0xec028 0x3f 0x30>,
		<0xec02c 0x801f 0x4>,
		<0xec034 0x3f 0x30>,
		<0xec038 0x801f 0x4>,
		<0xec040 0x3f 0x30>,
		<0xec044 0x801f 0x4>,
		<0xec04c 0x3f 0x30>,
		<0xec050 0x801f 0x4>,
		<0xec058 0x3f 0x30>,
		<0xec05c 0x801f 0x4>,
		<0xec064 0x3f 0x30>,
		<0xec068 0x801f 0x4>,
		<0xec070 0x3f 0x30>,
		<0xec074 0x801f 0x4>,
		<0xec07c 0x3f 0x30>,
		<0xec080 0x801f 0x4>,
		<0xec088 0x3f 0x30>,
		<0xec08c 0x801f 0x4>,
		<0xec094 0xffffffff 0x1010101>,
		<0xec098 0xffffffff 0x1010101>,
		<0xec09c 0xffffffff 0x1010101>,
		<0xec0a0 0xffffffff 0x1010101>,
		<0xec0a4 0xffffffff 0x1010101>,
		<0xec0a8 0xffffffff 0x1010101>,
		<0xec0ac 0x1 0x1>,
		<0xec0b0 0x8007 0x1>,
		<0xe8004 0xf 0x8>,
		<0xe8008 0x801f 0x4>,
		<0xe8010 0xf 0x8>,
		<0xe8014 0x801f 0x4>,
		<0xe801c 0xf 0x8>,
		<0xe8020 0x801f 0x4>,
		<0xe8028 0xf 0x8>,
		<0xe802c 0x801f 0x4>,
		<0xe8034 0xf 0x8>,
		<0xe8038 0x801f 0x4>,
		<0xe8040 0xf 0x8>,
		<0xe8044 0x801f 0x4>,
		<0xe804c 0xf 0x8>,
		<0xe8050 0x801f 0x4>,
		<0xe8058 0xf 0x8>,
		<0xe805c 0x801f 0x4>,
		<0xe8064 0xf 0x8>,
		<0xe8068 0x801f 0x4>,
		<0xe8070 0xf 0x8>,
		<0xe8074 0x801f 0x4>,
		<0xe807c 0xf 0x8>,
		<0xe8080 0x801f 0x4>,
		<0xe8088 0xf 0x8>,
		<0xe808c 0x801f 0x4>,
		<0xe8094 0x8007 0x1>,
		<0xf4004 0x1f 0x1f>,
		<0xf4008 0x801f 0x4>,
		<0xf4010 0x1f 0x1f>,
		<0xf4014 0x801f 0x4>,
		<0xf401c 0x1f 0x1f>,
		<0xf4020 0x801f 0x4>,
		<0xf4028 0x1f 0x1f>,
		<0xf402c 0x801f 0x4>,
		<0xf4034 0x1f 0x1f>,
		<0xf4038 0x801f 0x4>,
		<0xf4040 0x1f 0x1f>,
		<0xf4044 0x801f 0x4>,
		<0xf404c 0x1f 0x1f>,
		<0xf4050 0x801f 0x4>,
		<0xf4058 0x1f 0x1f>,
		<0xf405c 0x801f 0x4>,
		<0xf4064 0x1f 0x1f>,
		<0xf4068 0x801f 0x4>,
		<0xf4070 0x1f 0x1f>,
		<0xf4074 0x801f 0x4>,
		<0xf407c 0x1f 0x1f>,
		<0xf4080 0x801f 0x4>,
		<0xf4088 0x1f 0x1f>,
		<0xf408c 0x801f 0x4>,
		<0xf4094 0x1f 0x1f>,
		<0xf4098 0x801f 0x4>,
		<0xf40a0 0xffffffff 0x1010101>,
		<0xf40a4 0xffffffff 0x1010101>,
		<0xf40a8 0xffffffff 0x1010101>,
		<0xf40ac 0xffffffff 0x1010101>,
		<0xf40b0 0xffffffff 0x1010101>,
		<0xf40b4 0xffffffff 0x1010101>,
		<0xf40b8 0xffff 0x101>,
		<0xf40bc 0x1 0x1>,
		<0xf40c0 0x8007 0x1>,
		<0xf8004 0x1f 0x10>,
		<0xf8008 0x801f 0x4>,
		<0xf8010 0x3f 0x30>,
		<0xf8014 0x801f 0x4>,
		<0xf801c 0x1f 0x10>,
		<0xf8020 0x801f 0x4>,
		<0xf8028 0x7f 0x60>,
		<0xf802c 0x801f 0x4>,
		<0xf8034 0x8007 0x1>,
		<0xfc004 0x7 0x4>,
		<0xfc008 0x8007 0x1>,
		<0xfc010 0x7 0x4>,
		<0xfc014 0x8007 0x1>,
		<0xfc01c 0x7 0x4>,
		<0xfc020 0x8007 0x1>,
		<0xfc028 0x7 0x4>,
		<0xfc02c 0x8007 0x1>,
		<0xfc034 0x7 0x4>,
		<0xfc038 0x8007 0x1>,
		<0xfc040 0x7 0x4>,
		<0xfc044 0x8007 0x1>,
		<0xfc04c 0x7 0x4>,
		<0xfc050 0x8007 0x1>,
		<0xfc058 0x7 0x4>,
		<0xfc05c 0x8007 0x1>,
		<0xfc064 0x7 0x4>,
		<0xfc068 0x8007 0x1>,
		<0xfc070 0x7 0x4>,
		<0xfc074 0x8007 0x1>,
		<0xfc07c 0x7 0x4>,
		<0xfc080 0x8007 0x1>,
		<0xfc088 0x7 0x4>,
		<0xfc08c 0x8007 0x1>,
		<0xfc094 0x7 0x4>,
		<0xfc098 0x8007 0x1>,
		<0xfc0a0 0x8007 0x1>,
		<0x4000 0x1000000f 0x10000002>,
		<0x4004 0x1000000f 0x10000002>,
		<0x4008 0x1000000f 0x10000002>,
		<0x400c 0x1000000f 0x10000002>,
		<0x4010 0x1000000f 0x10000002>,
		<0x4014 0x1000000f 0x10000002>,
		<0x4018 0x1000000f 0x10000002>,
		<0x401c 0x1000000f 0x10000002>,
		<0x4020 0x1000000f 0x10000002>,
		<0x4024 0x1000000f 0x10000002>,
		<0x4028 0x1000000f 0x10000002>,
		<0x402c 0x1000000f 0x10000002>,
		<0x4040 0x1000000f 0x2>,
		<0x4044 0x1000000f 0x2>,
		<0x4048 0x1000000f 0x2>,
		<0x404c 0x1000000f 0x2>,
		<0x4050 0x1000000f 0x2>,
		<0x4054 0x1000000f 0x2>,
		<0x4058 0x1000000f 0x2>,
		<0x405c 0x1000000f 0x2>,
		<0x4060 0x1000000f 0x2>,
		<0x4064 0x1000000f 0x2>,
		<0x4068 0x1000000f 0x2>,
		<0x406c 0x1000000f 0x2>,
		<0x4080 0x1000000f 0x10000002>,
		<0x4084 0x1000000f 0x10000002>,
		<0x4088 0x1000000f 0x10000002>,
		<0x408c 0x1000000f 0x10000002>,
		<0x4090 0x1000000f 0x10000002>,
		<0x4094 0x1000000f 0x10000002>,
		<0x4098 0x1000000f 0x10000002>,
		<0x409c 0x1000000f 0x10000002>,
		<0x40a0 0x1000000f 0x10000002>,
		<0x40a4 0x1000000f 0x10000002>,
		<0x40a8 0x1000000f 0x10000002>,
		<0x40ac 0x1000000f 0x10000002>,
		<0x40c0 0x1000000f 0x10000002>,
		<0x40c4 0x1000000f 0x10000002>,
		<0x40c8 0x1000000f 0x10000002>,
		<0x40cc 0x1000000f 0x10000002>,
		<0x40d0 0x1000000f 0x10000002>,
		<0x40d4 0x1000000f 0x10000002>,
		<0x40d8 0x1000000f 0x10000002>,
		<0x40dc 0x1000000f 0x10000002>,
		<0x40e0 0x1000000f 0x10000002>,
		<0x40e4 0x1000000f 0x10000002>,
		<0x40e8 0x1000000f 0x10000002>,
		<0x40ec 0x1000000f 0x10000002>,
		<0x4100 0x1000000f 0x2>,
		<0x4104 0x1000000f 0x2>,
		<0x4108 0x1000000f 0x2>,
		<0x410c 0x1000000f 0x2>,
		<0x4110 0x1000000f 0x2>,
		<0x4114 0x1000000f 0x2>,
		<0x4118 0x1000000f 0x2>,
		<0x411c 0x1000000f 0x2>,
		<0x4120 0x1000000f 0x2>,
		<0x4124 0x1000000f 0x2>,
		<0x4128 0x1000000f 0x2>,
		<0x412c 0x1000000f 0x2>,
		<0x4140 0x1000000f 0x10000002>,
		<0x4144 0x1000000f 0x10000002>,
		<0x4148 0x1000000f 0x10000002>,
		<0x414c 0x1000000f 0x10000002>,
		<0x4150 0x1000000f 0x10000002>,
		<0x4154 0x1000000f 0x10000002>,
		<0x4158 0x1000000f 0x10000002>,
		<0x415c 0x1000000f 0x10000002>,
		<0x4160 0x1000000f 0x10000002>,
		<0x4164 0x1000000f 0x10000002>,
		<0x4168 0x1000000f 0x10000002>,
		<0x416c 0x1000000f 0x10000002>,
		<0x43f0 0x1ffffff 0x1ffffff>;
	apple,thunderbolt-drom = [19 21 67 38 9e 1c 16 a3 d4 06 7e 74 db 01 42 00
		01 00 0f 00 01 00 08 81 81 02 81 00 00 00 08 82
		91 01 81 00 00 00 03 83 20 02 84 05 85 09 01 00
		05 86 09 01 00 02 87 05 88 09 01 00 0d 01 41 70
		70 6c 65 20 49 6e 63 2e 00 06 02 69 4f 53 00 00];
};

