// SPDX-License-Identifier: GPL-2.0+ OR MIT
/*
 * J813 PMP firmware properties: the ADT /arm-io/pmp/iop-pmp-nub values the
 * firmware queries by name at boot (pmp.rs serves apple,tunable-<name>).
 * Generated from the J813 ADT by tools/adtnub.py; raw ADT bytes.
 */

&pmp {
	apple,tunable-agx-dcs-bw-constraint = [00 00 00 00 00 00 00 00 07 00 00 00 00 00 00 00 00 00 00 00 07 00 00 00 00 00 00 00 00 00 00 00 07 00 00 00 00 00 00 00 00 00 00 00 07 00 00 00 00 00 00 00 00 00 00 00 07 00 00 00 00 00 00 00 00 00 00 00 07 00 00 00 00 00 00 00 00 00 00 00 07 00 00 00 00 00 00 00 00 00 00 00 07 00 00 00 00 00 00 00 00 00 00 00 07 00 00 00 00 00 00 00 00 00 00 00 07 00 00 00 00 00 00 00 00 00 00 00 07 00 00 00 00 00 00 00 00 00 00 00 07 00 00 00 00 00 00 00 00 00 00 00 07 00 00 00 00 00 00 00 00 00 00 00 07 00 00 00 00 00 00 00 00 00 00 00 07 00 00 00];
	apple,tunable-mc_quota_req_ptd_count = [08 00 00 00];
	apple,tunable-mc_cmd_ptd_count = [02 00 00 00];
	apple,tunable-ane-dcs-bw-dvfs-filter = [ff ff 1f 00];
	apple,tunable-sochot-sensors = [01 00 00 00 02 00 00 00 03 00 00 00 04 00 00 00 05 00 00 00 06 00 00 00 07 00 00 00 08 00 00 00 09 00 00 00 0a 00 00 00 0b 00 00 00 0c 00 00 00 0d 00 00 00 0e 00 00 00 0f 00 00 00 10 00 00 00 11 00 00 00 12 00 00 00 13 00 00 00 14 00 00 00 15 00 00 00 16 00 00 00 17 00 00 00 18 00 00 00];
	apple,tunable-soc-ni3-bw-threshold = [cc 0c 1d 00 00 00 00 00 00 00 00 00 00 00 00 00 e1 ba 26 00 01 00 00 00 cc 0c 1c 00 00 00 00 00 00 00 00 00 00 00 00 00 e1 ba 25 00 00 00 00 00 00 00 00 00 00 00 00 00 99 19 39 00 00 00 00 00 00 00 00 00 00 00 00 00 5c 8f 3d 00 00 00 00 00];
	apple,tunable-agx-af-rd-bw-threshold = [00 00 00 00 00 00 00 00 00 00 00 00 00 00 00 00 00 00 00 00 00 00 00 00 00 00 00 00 00 00 00 00 00 00 00 00 00 00 00 00 00 00 00 00 00 00 00 00 00 00 00 00 00 00 00 00 00 00 00 00 00 00 00 00 00 00 00 00 00 00 00 00 00 00 00 00 00 00 00 00 00 00 35 00 00 00 00 00 00 00 00 00 00 00 00 00 00 00 5a 00 00 00 00 00 00 00 34 00 00 00 00 00 00 00 89 00 00 00 00 00 00 00 59 00 00 00 00 00 00 00 93 00 00 00 00 00 00 00 88 00 00 00 00 00 00 00 00 00 00 00 00 00 00 00 92 00 00 00 00 00 00 00 3a 00 00 00 00 00 00 00 00 00 00 00 00 00 00 00 5a 00 00 00 00 00 00 00 39 00 06 00 00 00 00 00 89 00 00 00 00 00 00 00 59 00 06 00 00 00 00 00 93 00 00 00 00 00 00 00 88 00 06 00 00 00 00 00 00 00 00 00 00 00 00 00 92 00 06 00 00 00 00 00 2d 00 00 00 00 00 00 00 00 00 00 00 00 00 00 00 5a 00 00 00 00 00 00 00 2c 00 06 00 00 00 00 00 89 00 00 00 00 00 00 00 59 00 06 00 00 00 00 00 93 00 00 00 00 00 00 00 88 00 06 00 00 00 00 00 00 00 00 00 00 00 00 00 92 00 06 00 00 00 00 00 12 00 00 00 00 00 00 00 00 00 00 00 00 00 00 00 5a 00 00 00 00 00 00 00 11 00 06 00 00 00 00 00 89 00 00 00 00 00 00 00 59 00 06 00 00 00 00 00 93 00 00 00 00 00 00 00 88 00 06 00 00 00 00 00 00 00 00 00 00 00 00 00 92 00 06 00 00 00 00 00 0e 00 00 00 00 00 00 00 00 00 00 00 00 00 00 00 3c 00 00 00 00 00 00 00 0d 00 06 00 00 00 00 00 89 00 00 00 00 00 00 00 3b 00 06 00 00 00 00 00 93 00 00 00 00 00 00 00 88 00 06 00 00 00 00 00 00 00 00 00 00 00 00 00 92 00 06 00 00 00 00 00 04 00 00 00 00 00 00 00 00 00 00 00 00 00 00 00 33 00 00 00 00 00 00 00 03 00 06 00 00 00 00 00 7a 00 00 00 00 00 00 00 32 00 06 00 00 00 00 00 93 00 00 00 00 00 00 00 79 00 06 00 00 00 00 00 00 00 00 00 00 00 00 00 92 00 06 00 00 00 00 00 01 00 00 00 00 00 00 00 00 00 00 00 00 00 00 00 2c 00 00 00 00 00 00 00 00 00 06 00 00 00 00 00 5a 00 00 00 00 00 00 00 2b 00 06 00 00 00 00 00 8a 00 00 00 00 00 00 00 59 00 06 00 00 00 00 00 00 00 00 00 00 00 00 00 89 00 06 00 00 00 00 00 01 00 00 00 00 00 00 00 00 00 00 00 00 00 00 00 1e 00 00 00 00 00 00 00 00 00 06 00 00 00 00 00 3e 00 00 00 00 00 00 00 1d 00 06 00 00 00 00 00 6f 00 00 00 00 00 00 00 3d 00 06 00 00 00 00 00 00 00 00 00 00 00 00 00 6e 00 06 00 00 00 00 00 01 00 00 00 00 00 00 00 00 00 00 00 00 00 00 00 0a 00 00 00 00 00 00 00 00 00 06 00 00 00 00 00 34 00 00 00 00 00 00 00 09 00 06 00 00 00 00 00 5a 00 00 00 00 00 00 00 33 00 06 00 00 00 00 00 00 00 00 00 00 00 00 00 59 00 06 00 00 00 00 00 01 00 00 00 00 00 00 00 00 00 00 00 00 00 00 00 04 00 00 00 00 00 00 00 00 00 06 00 00 00 00 00 2c 00 00 00 00 00 00 00 03 00 06 00 00 00 00 00 41 00 00 00 00 00 00 00 2b 00 06 00 00 00 00 00 00 00 00 00 00 00 00 00 40 00 06 00 00 00 00 00 01 00 00 00 00 00 00 00 00 00 00 00 00 00 00 00 01 00 00 00 00 00 00 00 00 00 06 00 00 00 00 00 19 00 00 00 00 00 00 00 00 00 06 00 00 00 00 00 3c 00 00 00 00 00 00 00 18 00 06 00 00 00 00 00 00 00 00 00 00 00 00 00 3b 00 06 00 00 00 00 00 01 00 00 00 00 00 00 00 00 00 00 00 00 00 00 00 01 00 00 00 00 00 00 00 00 00 06 00 00 00 00 00 19 00 00 00 00 00 00 00 00 00 06 00 00 00 00 00 37 00 00 00 00 00 00 00 18 00 06 00 00 00 00 00 00 00 00 00 00 00 00 00 36 00 06 00 00 00 00 00 01 00 00 00 00 00 00 00 00 00 00 00 00 00 00 00 01 00 00 00 00 00 00 00 00 00 06 00 00 00 00 00 14 00 00 00 00 00 00 00 00 00 06 00 00 00 00 00 32 00 00 00 00 00 00 00 13 00 06 00 00 00 00 00 00 00 00 00 00 00 00 00 31 00 06 00 00 00 00 00 01 00 00 00 00 00 00 00 00 00 00 00 00 00 00 00 01 00 00 00 00 00 00 00 00 00 06 00 00 00 00 00 14 00 00 00 00 00 00 00 00 00 06 00 00 00 00 00 32 00 00 00 00 00 00 00 13 00 06 00 00 00 00 00 00 00 00 00 00 00 00 00 31 00 06 00 00 00];
	apple,tunable-ane-af-bw-dvfs-filter = [ff ff 1f 00];
	apple,tunable-ans-af-bw-threshold = [70 3d 0c 00 00 00 00 00 00 00 00 00 00 00 00 00 00 00 00 00 00 00 00 00 70 3d 0b 00 00 00 00 00 00 00 00 00 00 00 00 00 00 00 10 00 00 00 00 00 00 00 00 00 00 00 00 00 cc 0c 1c 00 00 00 00 00 00 00 00 00 00 00 00 00 cc 0c 1c 00 00 00 00 00];
	apple,tunable-ptd-range = [01 00 00 00 00 00 00 00 01 00 00 00 00 00 00 00 50 54 44 2d 4e 55 4c 4c 00 00 00 00 00 00 00 00 02 00 00 00 01 00 00 00 01 00 00 00 0b 00 00 00 50 4d 50 2d 53 54 41 54 55 53 00 00 00 00 00 00 03 00 00 00 02 00 00 00 04 00 00 00 00 00 00 00 44 56 46 53 2d 53 54 41 54 45 00 00 00 00 00 00 04 00 00 00 06 00 00 00 04 00 00 00 00 00 00 00 50 4d 50 54 4f 4f 4c 00 00 00 00 00 00 00 00 00 05 00 00 00 98 00 00 00 08 00 00 00 00 00 00 00 50 4d 53 2d 50 4d 47 52 2d 50 4b 54 00 00 00 00 06 00 00 00 a0 00 00 00 08 00 00 00 00 00 00 00 50 4d 53 2d 44 50 45 2d 50 4b 54 00 00 00 00 00 07 00 00 00 28 02 00 00 18 00 00 00 00 00 00 00 50 4d 53 2d 44 45 56 43 2d 50 4b 54 00 00 00 00 09 00 00 00 a8 00 00 00 80 01 00 00 00 00 00 00 53 4f 43 2d 44 45 56 2d 50 4b 54 00 00 00 00 00 0a 00 00 00 27 00 00 00 08 00 00 00 00 00 00 00 53 4f 43 2d 44 45 56 2d 50 53 2d 52 45 51 00 00 0b 00 00 00 2f 00 00 00 08 00 00 00 00 00 00 00 53 4f 43 2d 44 45 56 2d 50 53 2d 41 43 4b 00 00 0c 00 00 00 37 00 00 00 10 00 00 00 00 00 00 00 53 4f 43 2d 44 45 56 2d 44 56 46 53 00 00 00 00 0d 00 00 00 47 00 00 00 0a 00 00 00 00 00 00 00 53 4f 43 2d 44 45 56 2d 42 57 52 00 00 00 00 00 0e 00 00 00 13 00 00 00 0a 00 00 00 00 00 00 00 4d 43 2d 44 52 56 2d 54 4f 2d 43 54 52 4c 00 00 0f 00 00 00 51 00 00 00 01 00 00 00 00 00 00 00 44 56 46 53 2d 43 45 49 4c 00 00 00 00 00 00 00 14 00 00 00 0a 00 00 00 01 00 00 00 00 00 00 00 41 56 44 2d 4e 52 47 00 00 00 00 00 00 00 00 00 15 00 00 00 0b 00 00 00 01 00 00 00 00 00 00 00 53 4f 43 2d 41 4f 4e 2d 4e 52 47 00 00 00 00 00 16 00 00 00 0c 00 00 00 01 00 00 00 00 00 00 00 53 4f 43 2d 52 45 53 54 2d 4e 52 47 00 00 00 00 1e 00 00 00 1d 00 00 00 09 00 00 00 00 00 00 00 4d 43 2d 43 54 52 4c 2d 54 4f 2d 44 52 56 00 00 1f 00 00 00 0f 00 00 00 02 00 00 00 0c 00 00 00 46 41 53 54 2d 44 49 45 2d 43 45 00 00 00 00 00 20 00 00 00 52 00 00 00 07 00 00 00 0d 00 00 00 53 4d 43 2d 54 4f 2d 50 50 4d 00 00 00 00 00 00 21 00 00 00 0d 00 00 00 01 00 00 00 0a 00 00 00 4c 54 53 2d 56 4f 4c 54 2d 43 41 50 00 00 00 00 40 00 00 00 59 00 00 00 05 00 00 00 0e 00 00 00 50 50 4d 2d 54 4f 2d 53 4d 43 00 00 00 00 00 00 41 00 00 00 5e 00 00 00 05 00 00 00 0f 00 00 00 43 4c 50 43 2d 54 4f 2d 53 4d 43 00 00 00 00 00 43 00 00 00 11 00 00 00 02 00 00 00 00 00 00 00 46 41 53 54 2d 44 49 45 2d 54 4f 2d 53 4d 43 00 44 00 00 00 26 00 00 00 01 00 00 00 00 00 00 00 4d 45 4d 43 2d 54 4f 2d 53 4d 43 00 00 00 00 00 52 00 00 00 0e 00 00 00 01 00 00 00 00 00 00 00 4c 54 53 2d 54 4f 2d 47 46 58 00 00 00 00 00 00];
	apple,tunable-sram-index = [01 00 00 00];
	apple,tunable-no-shutdown = [01 00 00 00];
	apple,tunable-dvfs-domain = [01 00 00 00 08 00 00 00 00 00 00 00 44 43 53 00 00 00 00 00 00 00 00 00 00 00 00 00 02 00 00 00 05 00 00 00 00 00 00 00 53 4f 43 00 00 00 00 00 00 00 00 00 00 00 00 00 03 00 00 00 06 00 00 00 00 00 00 00 44 49 53 50 00 00 00 00 00 00 00 00 00 00 00 00];
	apple,tunable-dvfs-disp-min-state = [01 00 00 00];
	apple,tunable-fast-die-ctrl-ce-map = [01 00 00 00 00 00 00 00 00 00 00 00 01 00 00 00 00 00 00 00 00 00 00 00 00 00 00 00 45 41 43 43 00 00 00 00 00 00 00 00 00 00 00 00 02 00 00 00 00 00 00 00 01 00 00 00 02 00 00 00 03 00 00 00 00 00 00 00 00 00 00 00 50 41 43 43 5f 41 4e 45 00 00 00 00 00 00 00 00];
	apple,tunable-ane-dcs-bw-constraint = [00 00 00 00 00 00 00 00 07 00 00 00 00 00 00 00 00 00 00 00 07 00 00 00 00 00 00 00 00 00 00 00 07 00 00 00 00 00 00 00 00 00 00 00 07 00 00 00 00 00 00 00 00 00 00 00 07 00 00 00 00 00 00 00 00 00 00 00 07 00 00 00 00 00 00 00 00 00 00 00 07 00 00 00 00 00 00 00 00 00 00 00 07 00 00 00 00 00 00 00 00 00 00 00 07 00 00 00 00 00 00 00 00 00 00 00 07 00 00 00 00 00 00 00 00 00 00 00 07 00 00 00 00 00 00 00 00 00 00 00 07 00 00 00 00 00 00 00 00 00 00 00 07 00 00 00];
	apple,tunable-soc-ni2-bw-threshold = [cc 0c 1d 00 00 00 00 00 00 00 00 00 00 00 00 00 e1 ba 26 00 01 00 00 00 cc 0c 1c 00 00 00 00 00 00 00 00 00 00 00 00 00 e1 ba 25 00 00 00 00 00 00 00 00 00 00 00 00 00 99 19 39 00 00 00 00 00 00 00 00 00 00 00 00 00 5c 8f 3d 00 00 00 00 00];
	apple,tunable-agx-af-wr-bw-constraint = [00 00 00 00 00 00 00 00 04 00 00 00 00 00 00 00 00 00 00 00 04 00 00 00 00 00 00 00 00 00 00 00 04 00 00 00 00 00 00 00 00 00 00 00 04 00 00 00 00 00 00 00 00 00 00 00 04 00 00 00 00 00 00 00 00 00 00 00 04 00 00 00 00 00 00 00 00 00 00 00 04 00 00 00 00 00 00 00 00 00 00 00 04 00 00 00 00 00 00 00 00 00 00 00 04 00 00 00 00 00 00 00 00 00 00 00 04 00 00 00 00 00 00 00 00 00 00 00 04 00 00 00 00 00 00 00 00 00 00 00 04 00 00 00 00 00 00 00 00 00 00 00 04 00 00 00 00 00 00 00 00 00 00 00 04 00 00 00 00 00 00 00 00 00 00 00 04 00 00 00];
	apple,tunable-user-power-managed = [01 00 00 00];
	apple,tunable-ane-af-bw-threshold = [00 00 1d 00 00 00 00 00 00 00 00 00 00 00 00 00 00 00 f4 01 00 00 00 00 00 00 1c 00 00 00 00 00 00 00 f4 01 00 00 00 00 00 00 f3 01 00 00 00 00 00 00 f4 01 00 00 00 00 00 00 f3 01 00 00 00 00 00 00 00 00 00 00 00 00 00 00 f3 01 00 00 00 00 00 00 0a 00 00 00 00 00 00 00 00 00 00 00 00 00 00 00 f4 01 00 00 00 00 00 00 09 00 00 00 00 00 00 00 f4 01 00 00 00 00 00 00 f3 01 00 00 00 00 00 00 f4 01 00 00 00 00 00 00 f3 01 00 00 00 00 00 00 00 00 00 00 00 00 00 00 f3 01 00 00 00 00 00 00 07 00 00 00 00 00 00 00 00 00 00 00 00 00 00 00 f4 01 00 00 00 00 00 00 06 00 06 00 00 00 00 00 f4 01 00 00 00 00 00 00 f3 01 06 00 00 00 00 00 f4 01 00 00 00 00 00 00 f3 01 06 00 00 00 00 00 00 00 00 00 00 00 00 00 f3 01 06 00 00 00 00 00 01 00 00 00 00 00 00 00 00 00 00 00 00 00 00 00 16 00 00 00 00 00 00 00 00 00 06 00 00 00 00 00 41 00 00 00 00 00 00 00 15 00 06 00 00 00 00 00 f4 01 00 00 00 00 00 00 40 00 06 00 00 00 00 00 00 00 00 00 00 00 00 00 f3 01 06 00 00 00 00 00 01 00 00 00 00 00 00 00 00 00 00 00 00 00 00 00 13 00 00 00 00 00 00 00 00 00 06 00 00 00 00 00 3f 00 00 00 00 00 00 00 12 00 06 00 00 00 00 00 f4 01 00 00 00 00 00 00 3e 00 06 00 00 00 00 00 00 00 00 00 00 00 00 00 f3 01 06 00 00 00 00 00 01 00 00 00 00 00 00 00 00 00 00 00 00 00 00 00 0d 00 00 00 00 00 00 00 00 00 06 00 00 00 00 00 3a 00 00 00 00 00 00 00 0c 00 06 00 00 00 00 00 f4 01 00 00 00 00 00 00 39 00 06 00 00 00 00 00 00 00 00 00 00 00 00 00 f3 01 06 00 00 00 00 00 01 00 00 00 00 00 00 00 00 00 00 00 00 00 00 00 0d 00 00 00 00 00 00 00 00 00 06 00 00 00 00 00 3a 00 00 00 00 00 00 00 0c 00 06 00 00 00 00 00 f4 01 00 00 00 00 00 00 39 00 06 00 00 00 00 00 00 00 00 00 00 00 00 00 f3 01 06 00 00 00 00 00 01 00 00 00 00 00 00 00 00 00 00 00 00 00 00 00 04 00 00 00 00 00 00 00 00 00 06 00 00 00 00 00 32 00 00 00 00 00 00 00 03 00 06 00 00 00 00 00 f4 01 00 00 00 00 00 00 31 00 06 00 00 00 00 00 00 00 00 00 00 00 00 00 f3 01 06 00 00 00 00 00 01 00 00 00 00 00 00 00 00 00 00 00 00 00 00 00 04 00 00 00 00 00 00 00 00 00 06 00 00 00 00 00 1e 00 00 00 00 00 00 00 03 00 06 00 00 00 00 00 f4 01 00 00 00 00 00 00 1d 00 06 00 00 00 00 00 00 00 00 00 00 00 00 00 f3 01 06 00 00 00 00 00 01 00 00 00 00 00 00 00 00 00 00 00 00 00 00 00 01 00 00 00 00 00 00 00 00 00 06 00 00 00 00 00 0f 00 00 00 00 00 00 00 00 00 06 00 00 00 00 00 f4 01 00 00 00 00 00 00 0e 00 06 00 00 00 00 00 00 00 00 00 00 00 00 00 f3 01 06 00 00 00 00 00 01 00 00 00 00 00 00 00 00 00 00 00 00 00 00 00 01 00 00 00 00 00 00 00 00 00 06 00 00 00 00 00 09 00 00 00 00 00 00 00 00 00 06 00 00 00 00 00 f4 01 00 00 00 00 00 00 08 00 06 00 00 00 00 00 00 00 00 00 00 00 00 00 f3 01 06 00 00 00 00 00 01 00 00 00 00 00 00 00 00 00 00 00 00 00 00 00 01 00 00 00 00 00 00 00 00 00 06 00 00 00 00 00 03 00 00 00 00 00 00 00 00 00 06 00 00 00 00 00 f4 01 00 00 00 00 00 00 02 00 06 00 00 00 00 00 00 00 00 00 00 00 00 00 f3 01 06 00 00 00 00 00 01 00 00 00 00 00 00 00 00 00 00 00 00 00 00 00 01 00 00 00 00 00 00 00 00 00 06 00 00 00 00 00 03 00 00 00 00 00 00 00 00 00 06 00 00 00 00 00 f4 01 00 00 00 00 00 00 02 00 06 00 00 00 00 00 00 00 00 00 00 00 00 00 f3 01 06 00 00 00];
	apple,tunable-lts-voltage = [01 00 00 00 03 00 00 00 03 00 00 00 01 00 00 00 45 41 43 43 00 00 00 00 02 00 00 00 03 00 00 00 04 00 00 00 02 00 00 00 50 41 43 43 00 00 00 00 03 00 00 00 01 00 00 00 06 00 00 00 00 00 00 00 41 4e 45 00 00 00 00 00 04 00 00 00 03 00 00 00 05 00 00 00 04 00 00 00 41 47 58 00 00 00 00 00];
	apple,tunable-ane-dcs-bw-threshold = [a3 f0 13 00 01 00 00 00 00 00 00 00 00 00 00 00 66 e6 27 00 02 00 00 00 a3 f0 12 00 00 00 00 00 1e 05 3a 00 03 00 00 00 66 e6 26 00 00 00 00 00 0a 57 4a 00 04 00 00 00 1e 05 39 00 00 00 00 00 3d 0a 57 00 05 00 00 00 0a 57 49 00 00 00 00 00 3d 8a 65 00 06 00 00 00 3d 0a 56 00 00 00 00 00 5c 0f 74 00 07 00 00 00 3d 8a 64 00 00 00 00 00 00 00 00 00 00 00 00 00 5c 0f 73 00 00 00 00 00 a3 f0 13 00 01 00 00 00 00 00 00 00 00 00 00 00 66 e6 27 00 02 00 00 00 a3 f0 12 00 00 00 00 00 1e 05 3a 00 03 00 00 00 66 e6 26 00 00 00 00 00 0a 57 4a 00 04 00 00 00 1e 05 39 00 00 00 00 00 3d 0a 57 00 05 00 00 00 0a 57 49 00 00 00 00 00 3d 8a 65 00 06 00 00 00 3d 0a 56 00 00 00 00 00 5c 0f 74 00 07 00 00 00 3d 8a 64 00 00 00 00 00 00 00 00 00 00 00 00 00 5c 0f 73 00 00 00 00 00 a3 f0 13 00 00 00 00 00 00 00 00 00 00 00 00 00 66 e6 27 00 00 00 00 00 a3 f0 12 00 06 00 00 00 1e 05 3a 00 00 00 00 00 66 e6 26 00 06 00 00 00 0a 57 4a 00 00 00 00 00 1e 05 39 00 06 00 00 00 3d 0a 57 00 00 00 00 00 0a 57 49 00 06 00 00 00 3d 8a 65 00 00 00 00 00 3d 0a 56 00 06 00 00 00 5c 0f 74 00 00 00 00 00 3d 8a 64 00 06 00 00 00 00 00 00 00 00 00 00 00 5c 0f 73 00 06 00 00 00 00 00 0f 00 00 00 00 00 00 00 00 00 00 00 00 00 66 e6 27 00 00 00 00 00 00 00 0e 00 06 00 00 00 1e 05 3a 00 00 00 00 00 66 e6 26 00 06 00 00 00 0a 57 4a 00 00 00 00 00 1e 05 39 00 06 00 00 00 3d 0a 57 00 00 00 00 00 0a 57 49 00 06 00 00 00 3d 8a 65 00 00 00 00 00 3d 0a 56 00 06 00 00 00 5c 0f 74 00 00 00 00 00 3d 8a 64 00 06 00 00 00 00 00 00 00 00 00 00 00 5c 0f 73 00 06 00 00 00 00 00 0a 00 00 00 00 00 00 00 00 00 00 00 00 00 66 e6 27 00 00 00 00 00 00 00 09 00 06 00 00 00 1e 05 3a 00 00 00 00 00 66 e6 26 00 06 00 00 00 0a 57 4a 00 00 00 00 00 1e 05 39 00 06 00 00 00 3d 0a 57 00 00 00 00 00 0a 57 49 00 06 00 00 00 3d 8a 65 00 00 00 00 00 3d 0a 56 00 06 00 00 00 5c 0f 74 00 00 00 00 00 3d 8a 64 00 06 00 00 00 00 00 00 00 00 00 00 00 5c 0f 73 00 06 00 00 00 00 00 0a 00 00 00 00 00 00 00 00 00 00 00 00 00 66 e6 27 00 00 00 00 00 00 00 09 00 06 00 00 00 1e 05 3a 00 00 00 00 00 66 e6 26 00 06 00 00 00 0a 57 4a 00 00 00 00 00 1e 05 39 00 06 00 00 00 3d 0a 57 00 00 00 00 00 0a 57 49 00 06 00 00 00 3d 8a 65 00 00 00 00 00 3d 0a 56 00 06 00 00 00 5c 0f 74 00 00 00 00 00 3d 8a 64 00 06 00 00 00 00 00 00 00 00 00 00 00 5c 0f 73 00 06 00 00 00 00 00 01 00 00 00 00 00 00 00 00 00 00 00 00 00 00 00 0f 00 00 00 00 00 00 00 00 00 06 00 00 00 1e 05 3a 00 00 00 00 00 00 00 0e 00 06 00 00 00 0a 57 4a 00 00 00 00 00 1e 05 39 00 06 00 00 00 3d 0a 57 00 00 00 00 00 0a 57 49 00 06 00 00 00 3d 8a 65 00 00 00 00 00 3d 0a 56 00 06 00 00 00 5c 0f 74 00 00 00 00 00 3d 8a 64 00 06 00 00 00 00 00 00 00 00 00 00 00 5c 0f 73 00 06 00 00 00 00 00 01 00 00 00 00 00 00 00 00 00 00 00 00 00 00 00 0f 00 00 00 00 00 00 00 00 00 06 00 00 00 1e 05 3a 00 00 00 00 00 00 00 0e 00 06 00 00 00 0a 57 4a 00 00 00 00 00 1e 05 39 00 06 00 00 00 3d 0a 57 00 00 00 00 00 0a 57 49 00 06 00 00 00 3d 8a 65 00 00 00 00 00 3d 0a 56 00 06 00 00 00 5c 0f 74 00 00 00 00 00 3d 8a 64 00 06 00 00 00 00 00 00 00 00 00 00 00 5c 0f 73 00 06 00 00 00 00 00 01 00 00 00 00 00 00 00 00 00 00 00 00 00 00 00 05 00 00 00 00 00 00 00 00 00 06 00 00 00 00 00 2a 00 00 00 00 00 00 00 04 00 06 00 00 00 0a 57 4a 00 00 00 00 00 00 00 29 00 06 00 00 00 3d 0a 57 00 00 00 00 00 0a 57 49 00 06 00 00 00 3d 8a 65 00 00 00 00 00 3d 0a 56 00 06 00 00 00 5c 0f 74 00 00 00 00 00 3d 8a 64 00 06 00 00 00 00 00 00 00 00 00 00 00 5c 0f 73 00 06 00 00 00 00 00 01 00 00 00 00 00 00 00 00 00 00 00 00 00 00 00 01 00 00 00 00 00 00 00 00 00 06 00 00 00 00 00 2a 00 00 00 00 00 00 00 00 00 06 00 00 00 0a 57 4a 00 00 00 00 00 00 00 29 00 06 00 00 00 3d 0a 57 00 00 00 00 00 0a 57 49 00 06 00 00 00 3d 8a 65 00 00 00 00 00 3d 0a 56 00 06 00 00 00 5c 0f 74 00 00 00 00 00 3d 8a 64 00 06 00 00 00 00 00 00 00 00 00 00 00 5c 0f 73 00 06 00 00 00 00 00 01 00 00 00 00 00 00 00 00 00 00 00 00 00 00 00 01 00 00 00 00 00 00 00 00 00 06 00 00 00 00 00 15 00 00 00 00 00 00 00 00 00 06 00 00 00 0a 57 4a 00 00 00 00 00 00 00 14 00 06 00 00 00 3d 0a 57 00 00 00 00 00 0a 57 49 00 06 00 00 00 3d 8a 65 00 00 00 00 00 3d 0a 56 00 06 00 00 00 5c 0f 74 00 00 00 00 00 3d 8a 64 00 06 00 00 00 00 00 00 00 00 00 00 00 5c 0f 73 00 06 00 00 00 00 00 01 00 00 00 00 00 00 00 00 00 00 00 00 00 00 00 01 00 00 00 00 00 00 00 00 00 06 00 00 00 00 00 01 00 00 00 00 00 00 00 00 00 06 00 00 00 00 00 2a 00 00 00 00 00 00 00 00 00 06 00 00 00 3d 0a 57 00 00 00 00 00 00 00 29 00 06 00 00 00 3d 8a 65 00 00 00 00 00 3d 0a 56 00 06 00 00 00 5c 0f 74 00 00 00 00 00 3d 8a 64 00 06 00 00 00 00 00 00 00 00 00 00 00 5c 0f 73 00 06 00 00 00 00 00 01 00 00 00 00 00 00 00 00 00 00 00 00 00 00 00 01 00 00 00 00 00 00 00 00 00 06 00 00 00 00 00 01 00 00 00 00 00 00 00 00 00 06 00 00 00 00 00 2a 00 00 00 00 00 00 00 00 00 06 00 00 00 3d 0a 57 00 00 00 00 00 00 00 29 00 06 00 00 00 3d 8a 65 00 00 00 00 00 3d 0a 56 00 06 00 00 00 5c 0f 74 00 00 00 00 00 3d 8a 64 00 06 00 00 00 00 00 00 00 00 00 00 00 5c 0f 73 00 06 00 00 00];
	apple,tunable-bwr-catch-up-factor = [00 00 01 00];
	apple,tunable-controller = [01 00 00 00 1f 00 00 00 43 00 00 00 00 00 00 00 00 00 00 00 44 49 45 2d 54 45 4d 50 00 00 00 00 00 00 00 00 00 00 00 00 00 00 00 00 00 00 00 00 00 00 00 00 02 00 00 00 00 00 00 00 00 00 00 00 00 00 00 00 00 00 00 00 44 43 53 2d 42 57 00 00 00 00 00 00 00 00 00 00 00 00 00 00 00 00 00 00 00 00 00 00 00 00 00 00 03 00 00 00 00 00 00 00 00 00 00 00 00 00 00 00 00 00 00 00 41 46 49 2d 54 4f 50 2d 42 57 00 00 00 00 00 00 00 00 00 00 00 00 00 00 00 00 00 00 00 00 00 00 04 00 00 00 00 00 00 00 00 00 00 00 00 00 00 00 00 00 00 00 53 4f 43 2d 4e 49 30 2d 42 57 00 00 00 00 00 00 00 00 00 00 00 00 00 00 00 00 00 00 00 00 00 00 05 00 00 00 00 00 00 00 00 00 00 00 00 00 00 00 00 00 00 00 53 4f 43 2d 4e 49 31 2d 42 57 00 00 00 00 00 00 00 00 00 00 00 00 00 00 00 00 00 00 00 00 00 00 06 00 00 00 00 00 00 00 00 00 00 00 00 00 00 00 00 00 00 00 53 4f 43 2d 4e 49 32 2d 42 57 00 00 00 00 00 00 00 00 00 00 00 00 00 00 00 00 00 00 00 00 00 00 07 00 00 00 00 00 00 00 00 00 00 00 00 00 00 00 00 00 00 00 53 4f 43 2d 4e 49 33 2d 42 57 00 00 00 00 00 00 00 00 00 00 00 00 00 00 00 00 00 00 00 00 00 00 08 00 00 00 00 00 00 00 00 00 00 00 00 00 00 00 00 00 00 00 53 4f 43 2d 4e 49 34 2d 42 57 00 00 00 00 00 00 00 00 00 00 00 00 00 00 00 00 00 00 00 00 00 00 09 00 00 00 00 00 00 00 00 00 00 00 00 00 00 00 00 00 00 00 53 4f 43 2d 4e 49 35 2d 42 57 00 00 00 00 00 00 00 00 00 00 00 00 00 00 00 00 00 00 00 00 00 00 0a 00 00 00 00 00 00 00 00 00 00 00 00 00 00 00 00 00 00 00 41 47 58 2d 41 46 2d 52 44 2d 42 57 00 00 00 00 00 00 00 00 00 00 00 00 00 00 00 00 00 00 00 00 0b 00 00 00 00 00 00 00 00 00 00 00 00 00 00 00 00 00 00 00 41 47 58 2d 41 46 2d 57 52 2d 42 57 00 00 00 00 00 00 00 00 00 00 00 00 00 00 00 00 00 00 00 00 0c 00 00 00 00 00 00 00 00 00 00 00 00 00 00 00 00 00 00 00 41 47 58 2d 44 43 53 2d 42 57 00 00 00 00 00 00 00 00 00 00 00 00 00 00 00 00 00 00 00 00 00 00 0d 00 00 00 00 00 00 00 00 00 00 00 00 00 00 00 00 00 00 00 41 4e 45 2d 41 46 2d 42 57 00 00 00 00 00 00 00 00 00 00 00 00 00 00 00 00 00 00 00 00 00 00 00 0e 00 00 00 00 00 00 00 00 00 00 00 00 00 00 00 00 00 00 00 41 4e 45 2d 44 43 53 2d 42 57 00 00 00 00 00 00 00 00 00 00 00 00 00 00 00 00 00 00 00 00 00 00 0f 00 00 00 00 00 00 00 00 00 00 00 00 00 00 00 00 00 00 00 41 4e 53 2d 41 46 2d 42 57 00 00 00 00 00 00 00 00 00 00 00 00 00 00 00 00 00 00 00 00 00 00 00 10 00 00 00 0e 00 00 00 1e 00 00 00 00 00 00 00 00 00 00 00 4d 45 4d 2d 43 41 43 48 45 00 00 00 00 00 00 00 00 00 00 00 00 00 00 00 00 00 00 00 00 00 00 00 11 00 00 00 52 00 00 00 21 00 00 00 00 00 00 00 00 00 00 00 4c 49 46 45 54 49 4d 45 2d 53 45 52 56 4f 00 00 00 00 00 00 00 00 00 00 00 00 00 00 00 00 00 00];
	apple,tunable-soc-device-ps-group = [00 fc ff 1f 00 00 00 00];
	apple,tunable-agx-dcs-bw-threshold = [00 00 00 00 00 00 00 00 00 00 00 00 00 00 00 00 00 00 00 00 00 00 00 00 00 00 00 00 00 00 00 00 00 00 00 00 00 00 00 00 00 00 00 00 00 00 00 00 00 00 00 00 00 00 00 00 00 00 00 00 00 00 00 00 00 00 00 00 00 00 00 00 00 00 00 00 00 00 00 00 00 00 00 00 00 00 00 00 00 00 00 00 00 00 00 00 00 00 00 00 00 00 00 00 00 00 00 00 00 00 00 00 00 00 00 00 00 00 00 00 00 00 00 00 00 00 00 00 00 00 13 00 00 00 00 00 00 00 00 00 00 00 00 00 00 00 27 00 00 00 00 00 00 00 12 00 00 00 00 00 00 00 39 00 00 00 00 00 00 00 26 00 00 00 00 00 00 00 e8 03 00 00 00 00 00 00 38 00 00 00 00 00 00 00 e8 03 00 00 00 00 00 00 e7 03 00 00 00 00 00 00 e8 03 00 00 00 00 00 00 e7 03 00 00 00 00 00 00 e8 03 00 00 00 00 00 00 e7 03 00 00 00 00 00 00 00 00 00 00 00 00 00 00 e7 03 00 00 00 00 00 00 11 00 00 00 00 00 00 00 00 00 00 00 00 00 00 00 27 00 00 00 00 00 00 00 10 00 06 00 00 00 00 00 39 00 00 00 00 00 00 00 26 00 06 00 00 00 00 00 4a 00 00 00 00 00 00 00 38 00 06 00 00 00 00 00 e8 03 00 00 00 00 00 00 49 00 06 00 00 00 00 00 e8 03 00 00 00 00 00 00 e7 03 06 00 00 00 00 00 e8 03 00 00 00 00 00 00 e7 03 06 00 00 00 00 00 00 00 00 00 00 00 00 00 e7 03 06 00 00 00 00 00 0c 00 00 00 00 00 00 00 00 00 00 00 00 00 00 00 27 00 00 00 00 00 00 00 0b 00 06 00 00 00 00 00 39 00 00 00 00 00 00 00 26 00 06 00 00 00 00 00 47 00 00 00 00 00 00 00 38 00 06 00 00 00 00 00 e8 03 00 00 00 00 00 00 46 00 06 00 00 00 00 00 e8 03 00 00 00 00 00 00 e7 03 06 00 00 00 00 00 e8 03 00 00 00 00 00 00 e7 03 06 00 00 00 00 00 00 00 00 00 00 00 00 00 e7 03 06 00 00 00 00 00 01 00 00 00 00 00 00 00 00 00 00 00 00 00 00 00 22 00 00 00 00 00 00 00 00 00 06 00 00 00 00 00 37 00 00 00 00 00 00 00 21 00 06 00 00 00 00 00 47 00 00 00 00 00 00 00 36 00 06 00 00 00 00 00 e8 03 00 00 00 00 00 00 46 00 06 00 00 00 00 00 e8 03 00 00 00 00 00 00 e7 03 06 00 00 00 00 00 e8 03 00 00 00 00 00 00 e7 03 06 00 00 00 00 00 00 00 00 00 00 00 00 00 e7 03 06 00 00 00 00 00 01 00 00 00 00 00 00 00 00 00 00 00 00 00 00 00 15 00 00 00 00 00 00 00 00 00 06 00 00 00 00 00 1f 00 00 00 00 00 00 00 14 00 06 00 00 00 00 00 47 00 00 00 00 00 00 00 1e 00 06 00 00 00 00 00 57 00 00 00 00 00 00 00 46 00 06 00 00 00 00 00 e8 03 00 00 00 00 00 00 56 00 06 00 00 00 00 00 e8 03 00 00 00 00 00 00 e7 03 06 00 00 00 00 00 00 00 00 00 00 00 00 00 e7 03 06 00 00 00 00 00 01 00 00 00 00 00 00 00 00 00 00 00 00 00 00 00 08 00 00 00 00 00 00 00 00 00 06 00 00 00 00 00 0e 00 00 00 00 00 00 00 07 00 06 00 00 00 00 00 32 00 00 00 00 00 00 00 0d 00 06 00 00 00 00 00 57 00 00 00 00 00 00 00 31 00 06 00 00 00 00 00 65 00 00 00 00 00 00 00 56 00 06 00 00 00 00 00 e8 03 00 00 00 00 00 00 64 00 06 00 00 00 00 00 00 00 00 00 00 00 00 00 e7 03 06 00 00 00 00 00 01 00 00 00 00 00 00 00 00 00 00 00 00 00 00 00 01 00 00 00 00 00 00 00 00 00 06 00 00 00 00 00 04 00 00 00 00 00 00 00 00 00 06 00 00 00 00 00 17 00 00 00 00 00 00 00 03 00 06 00 00 00 00 00 43 00 00 00 00 00 00 00 16 00 06 00 00 00 00 00 65 00 00 00 00 00 00 00 42 00 06 00 00 00 00 00 74 00 00 00 00 00 00 00 64 00 06 00 00 00 00 00 00 00 00 00 00 00 00 00 73 00 06 00 00 00 00 00 01 00 00 00 00 00 00 00 00 00 00 00 00 00 00 00 01 00 00 00 00 00 00 00 00 00 06 00 00 00 00 00 01 00 00 00 00 00 00 00 00 00 06 00 00 00 00 00 04 00 00 00 00 00 00 00 00 00 06 00 00 00 00 00 2d 00 00 00 00 00 00 00 03 00 06 00 00 00 00 00 50 00 00 00 00 00 00 00 2c 00 06 00 00 00 00 00 74 00 00 00 00 00 00 00 4f 00 06 00 00 00 00 00 00 00 00 00 00 00 00 00 73 00 06 00 00 00 00 00 01 00 00 00 00 00 00 00 00 00 00 00 00 00 00 00 01 00 00 00 00 00 00 00 00 00 06 00 00 00 00 00 01 00 00 00 00 00 00 00 00 00 06 00 00 00 00 00 04 00 00 00 00 00 00 00 00 00 06 00 00 00 00 00 10 00 00 00 00 00 00 00 03 00 06 00 00 00 00 00 3c 00 00 00 00 00 00 00 0f 00 06 00 00 00 00 00 74 00 00 00 00 00 00 00 3b 00 06 00 00 00 00 00 00 00 00 00 00 00 00 00 73 00 06 00 00 00 00 00 01 00 00 00 00 00 00 00 00 00 00 00 00 00 00 00 01 00 00 00 00 00 00 00 00 00 06 00 00 00 00 00 01 00 00 00 00 00 00 00 00 00 06 00 00 00 00 00 01 00 00 00 00 00 00 00 00 00 06 00 00 00 00 00 05 00 00 00 00 00 00 00 00 00 06 00 00 00 00 00 14 00 00 00 00 00 00 00 04 00 06 00 00 00 00 00 1e 00 00 00 00 00 00 00 13 00 06 00 00 00 00 00 00 00 00 00 00 00 00 00 1d 00 06 00 00 00 00 00 01 00 00 00 00 00 00 00 00 00 00 00 00 00 00 00 01 00 00 00 00 00 00 00 00 00 06 00 00 00 00 00 01 00 00 00 00 00 00 00 00 00 06 00 00 00 00 00 01 00 00 00 00 00 00 00 00 00 06 00 00 00 00 00 01 00 00 00 00 00 00 00 00 00 06 00 00 00 00 00 0a 00 00 00 00 00 00 00 00 00 06 00 00 00 00 00 14 00 00 00 00 00 00 00 09 00 06 00 00 00 00 00 00 00 00 00 00 00 00 00 13 00 06 00 00 00 00 00 01 00 00 00 00 00 00 00 00 00 00 00 00 00 00 00 01 00 00 00 00 00 00 00 00 00 06 00 00 00 00 00 01 00 00 00 00 00 00 00 00 00 06 00 00 00 00 00 01 00 00 00 00 00 00 00 00 00 06 00 00 00 00 00 01 00 00 00 00 00 00 00 00 00 06 00 00 00 00 00 01 00 00 00 00 00 00 00 00 00 06 00 00 00 00 00 0a 00 00 00 00 00 00 00 00 00 06 00 00 00 00 00 00 00 00 00 00 00 00 00 09 00 06 00 00 00 00 00 01 00 00 00 00 00 00 00 00 00 00 00 00 00 00 00 01 00 00 00 00 00 00 00 00 00 06 00 00 00 00 00 01 00 00 00 00 00 00 00 00 00 06 00 00 00 00 00 01 00 00 00 00 00 00 00 00 00 06 00 00 00 00 00 01 00 00 00 00 00 00 00 00 00 06 00 00 00 00 00 01 00 00 00 00 00 00 00 00 00 06 00 00 00 00 00 01 00 00 00 00 00 00 00 00 00 06 00 00 00 00 00 00 00 00 00 00 00 00 00 00 00 06 00 00 00 00 00 01 00 00 00 00 00 00 00 00 00 00 00 00 00 00 00 01 00 00 00 00 00 00 00 00 00 06 00 00 00 00 00 01 00 00 00 00 00 00 00 00 00 06 00 00 00 00 00 01 00 00 00 00 00 00 00 00 00 06 00 00 00 00 00 01 00 00 00 00 00 00 00 00 00 06 00 00 00 00 00 01 00 00 00 00 00 00 00 00 00 06 00 00 00 00 00 01 00 00 00 00 00 00 00 00 00 06 00 00 00 00 00 00 00 00 00 00 00 00 00 00 00 06 00 00 00];
	apple,tunable-soc-ni1-bw-threshold = [cc 0c 1d 00 00 00 00 00 00 00 00 00 00 00 00 00 e1 ba 26 00 01 00 00 00 cc 0c 1c 00 00 00 00 00 00 00 00 00 00 00 00 00 e1 ba 25 00 00 00 00 00 00 00 00 00 00 00 00 00 99 19 39 00 00 00 00 00 00 00 00 00 00 00 00 00 5c 8f 3d 00 00 00 00 00];
	apple,tunable-mc_quota_rsp_ptd_count = [08 00 00 00];
	apple,tunable-lts-ctrl-ts = [00 00 05 00];
	apple,tunable-temp-sensor = [01 00 00 00 08 00 00 00 06 00 00 00 00 00 00 00 00 00 00 00 00 00 00 00 00 80 04 00 00 80 04 00 6e 00 00 00 7d 00 00 00 54 61 30 30 30 69 00 00 00 00 00 00 00 00 00 00 02 00 00 00 08 00 00 00 06 00 00 00 00 00 00 00 01 00 00 00 00 00 00 00 33 b3 04 00 00 80 04 00 6e 00 00 00 7d 00 00 00 54 61 30 30 31 69 00 00 00 00 00 00 00 00 00 00 03 00 00 00 08 00 00 00 06 00 00 00 00 00 00 00 02 00 00 00 00 00 00 00 66 e6 03 00 00 80 04 00 6e 00 00 00 7d 00 00 00 54 61 30 30 32 69 00 00 00 00 00 00 00 00 00 00 04 00 00 00 08 00 00 00 06 00 00 00 00 00 00 00 05 00 00 00 00 00 00 00 00 80 05 00 00 80 04 00 6e 00 00 00 7d 00 00 00 54 61 30 30 35 69 00 00 00 00 00 00 00 00 00 00 05 00 00 00 08 00 00 00 06 00 00 00 00 00 00 00 06 00 00 00 00 00 00 00 66 e6 04 00 00 80 04 00 6e 00 00 00 7d 00 00 00 54 61 30 30 36 69 00 00 00 00 00 00 00 00 00 00 06 00 00 00 08 00 00 00 06 00 00 00 00 00 00 00 07 00 00 00 00 00 00 00 cc 4c 05 00 00 80 04 00 6e 00 00 00 7d 00 00 00 54 61 30 30 37 69 00 00 00 00 00 00 00 00 00 00 07 00 00 00 08 00 00 00 04 00 00 00 00 00 00 00 00 00 00 00 00 00 00 00 00 00 07 00 00 80 04 00 6e 00 00 00 7d 00 00 00 54 70 30 30 30 69 00 00 00 00 00 00 00 00 00 00 08 00 00 00 08 00 00 00 04 00 00 00 00 00 00 00 01 00 00 00 00 00 00 00 00 40 04 00 00 80 04 00 6e 00 00 00 7d 00 00 00 54 70 30 30 31 69 00 00 00 00 00 00 00 00 00 00 09 00 00 00 08 00 00 00 04 00 00 00 00 00 00 00 02 00 00 00 00 00 00 00 00 00 07 00 00 80 04 00 6e 00 00 00 7d 00 00 00 54 70 30 30 33 69 00 00 00 00 00 00 00 00 00 00 0a 00 00 00 08 00 00 00 04 00 00 00 00 00 00 00 03 00 00 00 00 00 00 00 00 40 04 00 00 80 04 00 6e 00 00 00 7d 00 00 00 54 70 30 30 34 69 00 00 00 00 00 00 00 00 00 00 0b 00 00 00 08 00 00 00 04 00 00 00 01 00 00 00 03 00 00 00 00 00 00 00 00 00 01 00 00 80 06 00 6e 00 00 00 7d 00 00 00 54 70 30 30 6c 69 00 00 00 00 00 00 00 00 00 00 0c 00 00 00 08 00 00 00 04 00 00 00 01 00 00 00 04 00 00 00 00 00 00 00 00 00 01 00 00 80 06 00 6e 00 00 00 7d 00 00 00 54 70 30 30 6d 69 00 00 00 00 00 00 00 00 00 00 0d 00 00 00 08 00 00 00 04 00 00 00 01 00 00 00 05 00 00 00 00 00 00 00 33 33 03 00 00 80 06 00 6e 00 00 00 7d 00 00 00 54 70 30 30 6e 69 00 00 00 00 00 00 00 00 00 00 0e 00 00 00 08 00 00 00 04 00 00 00 01 00 00 00 06 00 00 00 00 00 00 00 66 e6 02 00 00 80 06 00 6e 00 00 00 7d 00 00 00 54 70 30 30 6f 69 00 00 00 00 00 00 00 00 00 00 0f 00 00 00 08 00 00 00 04 00 00 00 01 00 00 00 07 00 00 00 00 00 00 00 99 99 02 00 00 80 06 00 6e 00 00 00 7d 00 00 00 54 70 30 30 70 69 00 00 00 00 00 00 00 00 00 00 10 00 00 00 08 00 00 00 04 00 00 00 01 00 00 00 09 00 00 00 00 00 00 00 33 33 02 00 00 80 06 00 6e 00 00 00 7d 00 00 00 54 70 30 30 72 69 00 00 00 00 00 00 00 00 00 00 11 00 00 00 08 00 00 00 04 00 00 00 02 00 00 00 00 00 00 00 00 00 00 00 00 00 07 00 00 80 04 00 6e 00 00 00 7d 00 00 00 54 70 30 30 39 69 00 00 00 00 00 00 00 00 00 00 12 00 00 00 08 00 00 00 04 00 00 00 02 00 00 00 01 00 00 00 00 00 00 00 00 40 04 00 00 80 04 00 6e 00 00 00 7d 00 00 00 54 70 30 30 61 69 00 00 00 00 00 00 00 00 00 00 13 00 00 00 08 00 00 00 04 00 00 00 02 00 00 00 02 00 00 00 00 00 00 00 00 00 07 00 00 80 04 00 6e 00 00 00 7d 00 00 00 54 70 30 30 36 69 00 00 00 00 00 00 00 00 00 00 14 00 00 00 08 00 00 00 04 00 00 00 02 00 00 00 03 00 00 00 00 00 00 00 00 40 04 00 00 80 04 00 6e 00 00 00 7d 00 00 00 54 70 30 30 37 69 00 00 00 00 00 00 00 00 00 00 15 00 00 00 08 00 00 00 03 00 00 00 00 00 00 00 01 00 00 00 00 00 00 00 66 66 08 00 00 80 04 00 6e 00 00 00 7d 00 00 00 54 65 30 30 37 69 00 00 00 00 00 00 00 00 00 00 16 00 00 00 08 00 00 00 03 00 00 00 00 00 00 00 03 00 00 00 00 00 00 00 00 80 04 00 00 80 04 00 6e 00 00 00 7d 00 00 00 54 65 30 30 31 69 00 00 00 00 00 00 00 00 00 00 17 00 00 00 08 00 00 00 03 00 00 00 00 00 00 00 04 00 00 00 00 00 00 00 99 99 04 00 00 80 04 00 6e 00 00 00 7d 00 00 00 54 65 30 30 32 69 00 00 00 00 00 00 00 00 00 00 18 00 00 00 08 00 00 00 03 00 00 00 00 00 00 00 05 00 00 00 00 00 00 00 33 b3 04 00 00 80 04 00 6e 00 00 00 7d 00 00 00 54 65 30 30 33 69 00 00 00 00 00 00 00 00 00 00 19 00 00 00 01 00 00 00 05 00 00 00 00 00 00 00 00 00 00 00 00 00 00 00 00 00 00 00 00 00 00 00 6d 00 00 00 6d 00 00 00 4d 54 52 5f 54 4f 50 5f 41 47 58 00 00 00 00 00];
	apple,tunable-agx-af-wr-bw-dvfs-filter = [fe 7f 00 00];
	apple,tunable-dcs-bw-threshold = [a3 f0 13 00 01 00 00 00 00 00 00 00 00 00 00 00 66 e6 27 00 02 00 00 00 a3 f0 12 00 00 00 00 00 1e 05 3a 00 03 00 00 00 66 e6 26 00 00 00 00 00 0a 57 4a 00 04 00 00 00 1e 05 39 00 00 00 00 00 3d 0a 57 00 05 00 00 00 0a 57 49 00 00 00 00 00 3d 8a 65 00 06 00 00 00 3d 0a 56 00 00 00 00 00 5c 0f 74 00 07 00 00 00 3d 8a 64 00 00 00 00 00 00 00 00 00 00 00 00 00 5c 0f 73 00 00 00 00 00];
	apple,tunable-mc_cmd_ack_ptd_count = [01 00 00 00];
	apple,tunable-soc-ni0-bw-threshold = [cc 0c 1d 00 00 00 00 00 00 00 00 00 00 00 00 00 e1 ba 26 00 01 00 00 00 cc 0c 1c 00 00 00 00 00 00 00 00 00 00 00 00 00 e1 ba 25 00 00 00 00 00 00 00 00 00 00 00 00 00 99 19 39 00 00 00 00 00 00 00 00 00 00 00 00 00 5c 8f 3d 00 00 00 00 00];
	apple,tunable-fast-die-ctrl-loop = [01 00 00 00 00 00 00 00 00 00 00 00 66 06 00 00 47 41 00 00 00 00 6e 00 00 00 01 00 00 00 00 00 00 00 01 00 00 00 00 00 00 00 00 00 00 00 01 00 16 00 00 00 15 00 00 00 16 00 00 00 17 00 00 00 18 00 00 00 00 00 00 00 00 00 00 00 00 00 00 00 00 00 00 00 00 00 00 00 00 00 00 00 00 00 00 00 00 00 00 00 00 00 00 00 00 00 00 00 00 00 00 00 00 00 00 00 45 41 43 43 00 00 00 00 00 00 00 00 00 00 00 00 02 00 00 00 00 00 00 00 01 00 00 00 66 06 00 00 47 41 00 00 00 00 6e 00 00 00 01 00 00 00 00 00 00 00 01 00 00 00 00 00 00 00 00 00 00 00 01 00 16 00 00 00 07 00 00 00 08 00 00 00 09 00 00 00 0a 00 00 00 0b 00 00 00 0c 00 00 00 0d 00 00 00 0e 00 00 00 0f 00 00 00 10 00 00 00 11 00 00 00 12 00 00 00 13 00 00 00 14 00 00 00 00 00 00 00 00 00 00 00 50 41 43 43 00 00 00 00 00 00 00 00 00 00 00 00 03 00 00 00 00 00 00 00 02 00 00 00 66 06 00 00 47 41 00 00 00 00 6e 00 00 00 01 00 00 00 00 00 00 00 01 00 00 00 00 00 00 00 00 00 00 00 01 00 16 00 00 00 01 00 00 00 02 00 00 00 03 00 00 00 04 00 00 00 05 00 00 00 06 00 00 00 00 00 00 00 00 00 00 00 00 00 00 00 00 00 00 00 00 00 00 00 00 00 00 00 00 00 00 00 00 00 00 00 00 00 00 00 00 00 00 00 41 4e 45 00 00 00 00 00 00 00 00 00 00 00 00 00];
	apple,tunable-agx-dcs-bw-dvfs-filter = [fe 7f 00 00];
	apple,tunable-agx-af-rd-bw-dvfs-filter = [fe 7f 00 00];
	apple,tunable-firmware-name = [74 38 31 34 32 70 6d 70 00];
	apple,tunable-lts-clpc-voltage = [01 00 00 00 98 03 00 00 00 00 69 00 33 33 69 00 00 00 00 00 50 41 43 43 00 00 00 00];
	apple,tunable-soc-ni5-bw-threshold = [cc 0c 1d 00 00 00 00 00 00 00 00 00 00 00 00 00 e1 ba 26 00 01 00 00 00 cc 0c 1c 00 00 00 00 00 00 00 00 00 00 00 00 00 e1 ba 25 00 00 00 00 00 00 00 00 00 00 00 00 00 99 19 39 00 00 00 00 00 00 00 00 00 00 00 00 00 5c 8f 3d 00 00 00 00 00];
	apple,tunable-energy-counter = [01 00 00 00 01 00 00 00 05 00 00 00 01 00 00 00 41 47 58 00 00 00 00 00 00 00 00 00 00 00 00 00 02 00 00 00 01 00 00 00 05 00 00 00 02 00 00 00 41 47 58 2d 53 52 41 4d 00 00 00 00 00 00 00 00 03 00 00 00 01 00 00 00 06 00 00 00 01 00 00 00 41 4e 45 00 00 00 00 00 00 00 00 00 00 00 00 00 04 00 00 00 00 00 00 00 14 00 00 00 00 00 00 00 56 44 45 43 00 00 00 00 00 00 00 00 00 00 00 00 05 00 00 00 00 00 00 00 15 00 00 00 00 00 00 00 53 4f 43 5f 41 4f 4e 00 00 00 00 00 00 00 00 00];
	apple,tunable-lts-config = [01 00 00 00 3b 01 00 00 a6 72 0f 00 00 00 00 00 b5 d5 0f 00 6e 00 00 00 69 00 00 00 00 00 11 00 33 b3 00 00 b0 32 47 01 02 00 00 00 47 03 00 00 3b 61 00 00 00 00 00 00 f7 dd 0f 00 6e 00 00 00 69 00 00 00 00 00 11 00 33 b3 00 00 d7 43 ef 02];
	apple,tunable-agx-af-rd-bw-constraint = [00 00 00 00 00 00 00 00 04 00 00 00 00 00 00 00 00 00 00 00 04 00 00 00 00 00 00 00 00 00 00 00 04 00 00 00 00 00 00 00 00 00 00 00 04 00 00 00 00 00 00 00 00 00 00 00 04 00 00 00 00 00 00 00 00 00 00 00 04 00 00 00 00 00 00 00 00 00 00 00 04 00 00 00 00 00 00 00 00 00 00 00 04 00 00 00 00 00 00 00 00 00 00 00 04 00 00 00 00 00 00 00 00 00 00 00 04 00 00 00 00 00 00 00 00 00 00 00 04 00 00 00 00 00 00 00 00 00 00 00 04 00 00 00 00 00 00 00 00 00 00 00 04 00 00 00 00 00 00 00 00 00 00 00 04 00 00 00 00 00 00 00 00 00 00 00 04 00 00 00];
	apple,tunable-ane-af-bw-constraint = [00 00 00 00 00 00 00 00 04 00 00 00 00 00 00 00 00 00 00 00 04 00 00 00 00 00 00 00 00 00 00 00 04 00 00 00 00 00 00 00 00 00 00 00 04 00 00 00 00 00 00 00 00 00 00 00 04 00 00 00 00 00 00 00 00 00 00 00 04 00 00 00 00 00 00 00 00 00 00 00 04 00 00 00 00 00 00 00 00 00 00 00 04 00 00 00 00 00 00 00 00 00 00 00 04 00 00 00 00 00 00 00 00 00 00 00 04 00 00 00 00 00 00 00 00 00 00 00 04 00 00 00 00 00 00 00 00 00 00 00 04 00 00 00 00 00 00 00 00 00 00 00 04 00 00 00];
	apple,tunable-mcache-stream = [0e 00 00 00 04 00 00 00 01 00 00 00 0d 00 00 00 0d 00 00 00 38 00 00 00 38 00 00 00 02 00 00 00 00 00 00 00 00 00 00 00 04 00 00 00 00 00 00 00 11 00 00 00 04 00 00 00 01 00 00 00 0e 00 00 00 0e 00 00 00 3c 00 00 00 3c 00 00 00 02 00 00 00 00 00 00 00 00 00 00 00 04 00 00 00 01 00 00 00 1b 00 00 00 04 00 00 00 01 00 00 00 0e 00 00 00 0e 00 00 00 3d 00 00 00 3d 00 00 00 02 00 00 00 00 00 00 00 00 00 00 00 04 00 00 00 01 00 00 00 13 00 00 00 04 00 00 00 01 00 00 00 0f 00 00 00 0f 00 00 00 40 00 00 00 40 00 00 00 02 00 00 00 00 00 00 00 00 00 00 00 04 00 00 00 01 00 00 00 24 00 00 00 04 00 00 00 01 00 00 00 0f 00 00 00 0f 00 00 00 41 00 00 00 41 00 00 00 02 00 00 00 00 00 00 00 00 00 00 00 04 00 00 00 01 00 00 00 1c 00 00 00 04 00 00 00 01 00 00 00 0f 00 00 00 0f 00 00 00 42 00 00 00 42 00 00 00 02 00 00 00 00 00 00 00 00 00 00 00 04 00 00 00 01 00 00 00 1e 00 00 00 03 00 00 00 01 00 00 00 02 00 00 00 02 00 00 00 0c 00 00 00 0c 00 00 00 02 00 00 00 00 00 00 00 00 00 00 00 04 00 00 00 01 00 00 00 2b 00 00 00 03 00 00 00 01 00 00 00 02 00 00 00 02 00 00 00 0e 00 00 00 0e 00 00 00 02 00 00 00 00 00 00 00 00 00 00 00 04 00 00 00 01 00 00 00 05 00 00 00 01 00 00 00 01 00 00 00 07 00 00 00 07 00 00 00 20 00 00 00 20 00 00 00 02 00 00 00 00 00 00 00 00 00 00 00 04 00 00 00 01 00 00 00 06 00 00 00 02 00 00 00 01 00 00 00 08 00 00 00 08 00 00 00 24 00 00 00 24 00 00 00 02 00 00 00 00 00 00 00 00 00 00 00 04 00 00 00 00 00 00 00 0b 00 00 00 05 00 00 00 01 00 00 00 0b 00 00 00 0b 00 00 00 30 00 00 00 30 00 00 00 02 00 00 00 00 00 00 00 00 00 00 00 05 00 00 00 01 00 00 00 04 00 00 00 00 00 00 00 01 00 00 00 11 00 00 00 11 00 00 00 48 00 00 00 48 00 00 00 02 00 00 00 00 00 00 00 00 00 00 00 05 00 00 00 01 00 00 00 02 00 00 00 00 00 00 00 01 00 00 00 13 00 00 00 13 00 00 00 50 00 00 00 50 00 00 00 02 00 00 00 00 00 00 00 00 00 00 00 04 00 00 00 01 00 00 00 01 00 00 00 00 00 00 00 01 00 00 00 15 00 00 00 15 00 00 00 58 00 00 00 5a 00 00 00 02 00 00 00 00 00 00 00 00 00 00 00 04 00 00 00 01 00 00 00 10 00 00 00 04 00 00 00 01 00 00 00 1f 00 00 00 1f 00 00 00 80 00 00 00 bf 00 00 00 02 00 00 00 00 00 00 00 00 00 00 00 04 00 00 00 01 00 00 00 0f 00 00 00 04 00 00 00 02 00 00 00 10 00 00 00 10 00 00 00 44 00 00 00 44 00 00 00 03 00 00 00 00 00 00 00 00 00 00 00 04 00 00 00 01 00 00 00 20 00 00 00 03 00 00 00 02 00 00 00 03 00 00 00 06 00 00 00 10 00 00 00 1f 00 00 00 03 00 00 00 00 00 00 00 00 00 00 00 05 00 00 00 01 00 00 00 1f 00 00 00 03 00 00 00 02 00 00 00 1e 00 00 00 1e 00 00 00 7c 00 00 00 7c 00 00 00 03 00 00 00 00 00 00 00 00 00 00 00 04 00 00 00 01 00 00 00 12 00 00 00 05 00 00 00 02 00 00 00 09 00 00 00 09 00 00 00 28 00 00 00 28 00 00 00 03 00 00 00 00 00 00 00 00 00 00 00 04 00 00 00 01 00 00 00 0a 00 00 00 05 00 00 00 02 00 00 00 0c 00 00 00 0c 00 00 00 34 00 00 00 34 00 00 00 03 00 00 00 00 00 00 00 00 00 00 00 05 00 00 00 00 00 00 00 15 00 00 00 07 00 00 00 02 00 00 00 16 00 00 00 16 00 00 00 5d 00 00 00 5d 00 00 00 03 00 00 00 00 00 00 00 00 00 00 00 04 00 00 00 01 00 00 00 36 00 00 00 07 00 00 00 02 00 00 00 16 00 00 00 16 00 00 00 5e 00 00 00 5e 00 00 00 03 00 00 00 00 00 00 00 00 00 00 00 04 00 00 00 01 00 00 00 37 00 00 00 07 00 00 00 02 00 00 00 16 00 00 00 16 00 00 00 5f 00 00 00 5f 00 00 00 03 00 00 00 00 00 00 00 00 00 00 00 04 00 00 00 01 00 00 00 19 00 00 00 08 00 00 00 03 00 00 00 00 00 00 00 00 00 00 00 04 00 00 00 04 00 00 00 01 00 00 00 00 00 00 00 00 00 00 00 04 00 00 00 01 00 00 00 1a 00 00 00 08 00 00 00 03 00 00 00 00 00 00 00 00 00 00 00 05 00 00 00 05 00 00 00 01 00 00 00 00 00 00 00 00 00 00 00 04 00 00 00 01 00 00 00 29 00 00 00 08 00 00 00 03 00 00 00 00 00 00 00 00 00 00 00 06 00 00 00 06 00 00 00 01 00 00 00 00 00 00 00 00 00 00 00 04 00 00 00 01 00 00 00 2a 00 00 00 08 00 00 00 03 00 00 00 00 00 00 00 00 00 00 00 07 00 00 00 07 00 00 00 01 00 00 00 00 00 00 00 00 00 00 00 04 00 00 00 01 00 00 00 0d 00 00 00 0b 00 00 00 03 00 00 00 01 00 00 00 01 00 00 00 08 00 00 00 08 00 00 00 01 00 00 00 00 00 00 00 00 00 00 00 04 00 00 00 00 00 00 00 0c 00 00 00 0b 00 00 00 03 00 00 00 01 00 00 00 01 00 00 00 09 00 00 00 09 00 00 00 01 00 00 00 00 00 00 00 00 00 00 00 04 00 00 00 00 00 00 00 14 00 00 00 04 00 00 00 03 00 00 00 01 00 00 00 01 00 00 00 0a 00 00 00 0a 00 00 00 01 00 00 00 00 00 00 00 00 00 00 00 04 00 00 00 00 00 00 00 27 00 00 00 04 00 00 00 03 00 00 00 1d 00 00 00 1d 00 00 00 78 00 00 00 78 00 00 00 01 00 00 00 00 00 00 00 00 00 00 00 04 00 00 00 00 00 00 00 2c 00 00 00 03 00 00 00 03 00 00 00 18 00 00 00 18 00 00 00 64 00 00 00 64 00 00 00 01 00 00 00 00 00 00 00 00 00 00 00 04 00 00 00 00 00 00 00 2f 00 00 00 02 00 00 00 03 00 00 00 1a 00 00 00 1a 00 00 00 6c 00 00 00 6c 00 00 00 01 00 00 00 00 00 00 00 00 00 00 00 04 00 00 00 00 00 00 00 26 00 00 00 05 00 00 00 03 00 00 00 1c 00 00 00 1c 00 00 00 74 00 00 00 74 00 00 00 01 00 00 00 00 00 00 00 00 00 00 00 04 00 00 00 00 00 00 00 23 00 00 00 00 00 00 00 03 00 00 00 14 00 00 00 14 00 00 00 54 00 00 00 54 00 00 00 01 00 00 00 00 00 00 00 00 00 00 00 04 00 00 00 01 00 00 00 28 00 00 00 00 00 00 00 03 00 00 00 1b 00 00 00 1b 00 00 00 70 00 00 00 70 00 00 00 01 00 00 00 00 00 00 00 00 00 00 00 04 00 00 00 00 00 00 00 31 00 00 00 0f 00 00 00 03 00 00 00 17 00 00 00 17 00 00 00 60 00 00 00 60 00 00 00 01 00 00 00 00 00 00 00 00 00 00 00 04 00 00 00 00 00 00 00 30 00 00 00 0e 00 00 00 03 00 00 00 17 00 00 00 17 00 00 00 61 00 00 00 61 00 00 00 01 00 00 00 00 00 00 00 00 00 00 00 04 00 00 00 00 00 00 00 33 00 00 00 11 00 00 00 03 00 00 00 17 00 00 00 17 00 00 00 62 00 00 00 62 00 00 00 01 00 00 00 00 00 00 00 00 00 00 00 04 00 00 00 00 00 00 00 34 00 00 00 12 00 00 00 03 00 00 00 17 00 00 00 17 00 00 00 63 00 00 00 63 00 00 00 01 00 00 00 00 00 00 00 00 00 00 00 04 00 00 00 00 00 00 00 35 00 00 00 09 00 00 00 03 00 00 00 19 00 00 00 19 00 00 00 68 00 00 00 68 00 00 00 01 00 00 00 00 00 00 00 00 00 00 00 04 00 00 00 00 00 00 00 1d 00 00 00 09 00 00 00 03 00 00 00 19 00 00 00 19 00 00 00 69 00 00 00 6b 00 00 00 01 00 00 00 00 00 00 00 00 00 00 00 04 00 00 00 00 00 00 00 2d 00 00 00 0c 00 00 00 03 00 00 00 18 00 00 00 18 00 00 00 65 00 00 00 65 00 00 00 01 00 00 00 00 00 00 00 00 00 00 00 04 00 00 00 00 00 00 00 16 00 00 00 0b 00 00 00 03 00 00 00 ff ff 00 00 ff ff 00 00 00 00 00 00 00 00 00 00 01 00 00 00 00 00 00 00 00 00 00 00 04 00 00 00 00 00 00 00];
	apple,tunable-ptd-driver-version = [01 00 00 00];
	apple,tunable-afi-top-bw-threshold = [99 19 3a 00 00 00 00 00 00 00 00 00 00 00 00 00 51 78 4d 00 01 00 00 00 99 19 39 00 00 00 00 00 00 00 00 00 00 00 00 00 51 78 4c 00 00 00 00 00 00 00 00 00 00 00 00 00 33 33 73 00 00 00 00 00 00 00 00 00 00 00 00 00 b8 1e 7c 00 00 00 00 00];
	apple,tunable-region-size = [00 00 0d 00 00 00 00 00];
	apple,tunable-coredump-enable = [40 00 00 00];
	apple,tunable-soc-ni4-bw-threshold = [cc 0c 1d 00 00 00 00 00 00 00 00 00 00 00 00 00 e1 ba 26 00 01 00 00 00 cc 0c 1c 00 00 00 00 00 00 00 00 00 00 00 00 00 e1 ba 25 00 00 00 00 00 00 00 00 00 00 00 00 00 99 19 39 00 00 00 00 00 00 00 00 00 00 00 00 00 5c 8f 3d 00 00 00 00 00];
	apple,tunable-pm-ptd-ranges = [01 00 00 00 02 00 00 00 03 00 00 00 04 00 00 00 05 00 00 00 06 00 00 00 07 00 00 00 00 00 00 00 00 00 00 00 09 00 00 00 0a 00 00 00 0b 00 00 00 0c 00 00 00 0d 00 00 00 00 00 00 00 0f 00 00 00];
	apple,tunable-fast-die-ctrl-ts-avg-temp = [00 00 64 00];
	apple,tunable-lts-ctrl-loop = [02 00 00 00 00 00 00 00 00 00 00 00 01 00 00 00 00 00 00 00 01 00 00 00 02 00 00 00 01 00 00 00 07 00 00 00 08 00 00 00 09 00 00 00 0a 00 00 00 0b 00 00 00 0c 00 00 00 0d 00 00 00 0e 00 00 00 0f 00 00 00 10 00 00 00 11 00 00 00 12 00 00 00 13 00 00 00 14 00 00 00 00 00 00 00 00 00 00 00 50 41 43 43 00 00 00 00 00 00 00 00 00 00 00 00 03 00 00 00 00 00 00 00 01 00 00 00 02 00 00 00 00 00 00 00 00 00 00 00 04 00 00 00 00 00 00 00 19 00 00 00 00 00 00 00 00 00 00 00 00 00 00 00 00 00 00 00 00 00 00 00 00 00 00 00 00 00 00 00 00 00 00 00 00 00 00 00 00 00 00 00 00 00 00 00 00 00 00 00 00 00 00 00 00 00 00 00 00 00 00 00 47 50 55 00 00 00 00 00 00 00 00 00 00 00 00 00];
	apple,tunable-soc-device = [01 00 00 00 45 4e 4f 4e 01 00 00 00 00 00 00 00 00 00 00 00 00 00 00 00 01 00 00 00 00 00 00 00 00 00 00 00 00 00 00 00 00 00 00 00 00 00 00 00 00 00 00 00 00 00 00 00 00 00 00 00 00 00 00 00 00 00 00 00 00 00 00 00 00 00 00 00 00 00 00 00 00 00 00 00 00 00 00 00 00 00 00 00 00 00 00 00 00 00 00 00 00 00 00 00 00 00 00 00 00 00 00 00 00 00 00 00 44 43 53 00 00 00 00 00 02 00 00 00 45 4e 4f 4e 01 00 00 00 16 00 00 00 00 00 00 00 00 00 00 00 02 00 00 00 00 00 00 00 00 00 00 00 00 00 00 00 00 00 00 00 00 00 00 00 00 00 00 00 00 00 00 00 00 00 00 00 00 00 00 00 00 00 00 00 00 00 00 00 00 00 00 00 00 00 00 00 00 00 00 00 00 00 00 00 00 00 00 00 00 00 00 00 00 00 00 00 00 00 00 00 00 00 00 00 00 00 00 00 00 00 00 00 41 4d 43 43 00 00 00 00 17 00 00 00 45 4e 4f 4e 01 00 00 00 03 00 00 00 00 00 00 00 00 00 00 00 02 00 00 00 00 00 00 00 00 00 00 00 00 00 00 00 00 00 00 00 00 00 00 00 00 00 00 00 00 00 00 00 00 00 00 00 00 00 00 00 00 00 00 00 00 00 00 00 00 00 00 00 00 00 00 00 00 00 00 00 00 00 00 00 00 00 00 00 00 00 00 00 00 00 00 00 00 00 00 00 00 00 00 00 00 00 00 00 00 00 00 00 53 4f 43 2d 4e 49 30 00 18 00 00 00 45 4e 4f 4e 01 00 00 00 03 00 00 00 00 00 00 00 00 00 00 00 02 00 00 00 00 00 00 00 00 00 00 00 00 00 00 00 00 00 00 00 00 00 00 00 00 00 00 00 00 00 00 00 00 00 00 00 00 00 00 00 00 00 00 00 00 00 00 00 00 00 00 00 00 00 00 00 00 00 00 00 00 00 00 00 00 00 00 00 00 00 00 00 00 00 00 00 00 00 00 00 00 00 00 00 00 00 00 00 00 00 00 00 53 4f 43 2d 4e 49 31 00 19 00 00 00 45 4e 4f 4e 01 00 00 00 04 00 00 00 00 00 00 00 00 00 00 00 02 00 00 00 00 00 00 00 00 00 00 00 00 00 00 00 00 00 00 00 00 00 00 00 00 00 00 00 00 00 00 00 00 00 00 00 00 00 00 00 00 00 00 00 00 00 00 00 00 00 00 00 00 00 00 00 00 00 00 00 00 00 00 00 00 00 00 00 00 00 00 00 00 00 00 00 00 00 00 00 00 00 00 00 00 00 00 00 00 00 00 00 53 4f 43 2d 4e 49 32 00 1a 00 00 00 45 4e 4f 4e 01 00 00 00 04 00 00 00 00 00 00 00 00 00 00 00 02 00 00 00 00 00 00 00 00 00 00 00 00 00 00 00 00 00 00 00 00 00 00 00 00 00 00 00 00 00 00 00 00 00 00 00 00 00 00 00 00 00 00 00 00 00 00 00 00 00 00 00 00 00 00 00 00 00 00 00 00 00 00 00 00 00 00 00 00 00 00 00 00 00 00 00 00 00 00 00 00 00 00 00 00 00 00 00 00 00 00 00 53 4f 43 2d 4e 49 33 00 1b 00 00 00 45 4e 4f 4e 01 00 00 00 03 00 00 00 00 00 00 00 00 00 00 00 02 00 00 00 00 00 00 00 00 00 00 00 00 00 00 00 00 00 00 00 00 00 00 00 00 00 00 00 00 00 00 00 00 00 00 00 00 00 00 00 00 00 00 00 00 00 00 00 00 00 00 00 00 00 00 00 00 00 00 00 00 00 00 00 00 00 00 00 00 00 00 00 00 00 00 00 00 00 00 00 00 00 00 00 00 00 00 00 00 00 00 00 53 4f 43 2d 4e 49 34 00 1c 00 00 00 45 4e 4f 4e 01 00 00 00 03 00 00 00 00 00 00 00 00 00 00 00 02 00 00 00 00 00 00 00 00 00 00 00 00 00 00 00 00 00 00 00 00 00 00 00 00 00 00 00 00 00 00 00 00 00 00 00 00 00 00 00 00 00 00 00 00 00 00 00 00 00 00 00 00 00 00 00 00 00 00 00 00 00 00 00 00 00 00 00 00 00 00 00 00 00 00 00 00 00 00 00 00 00 00 00 00 00 00 00 00 00 00 00 53 4f 43 2d 4e 49 35 00 10 00 00 00 45 4e 4f 4e 01 00 00 00 00 00 00 00 15 00 00 00 00 00 00 00 02 00 00 00 00 00 00 00 00 00 00 00 00 00 00 00 00 00 00 00 00 00 00 00 00 00 00 00 00 00 00 00 00 00 00 00 00 00 00 00 00 00 00 00 00 00 00 00 00 00 00 00 00 00 00 00 00 00 00 00 00 00 00 00 00 00 00 00 00 00 00 00 00 00 00 00 00 00 00 00 00 00 00 00 00 00 00 00 00 00 00 00 53 4f 43 2d 41 4f 4e 00 11 00 00 00 45 4e 4f 4e 01 00 00 00 00 00 00 00 00 00 00 00 00 00 00 00 02 00 00 00 00 00 00 00 00 00 00 00 00 00 00 00 00 00 00 00 00 00 00 00 00 00 00 00 00 00 00 00 00 00 00 00 00 00 00 00 00 00 00 00 00 00 00 00 00 00 00 00 00 00 00 00 00 00 00 00 00 00 00 00 00 00 00 00 00 00 00 00 00 00 00 00 00 00 00 00 00 00 00 00 00 00 00 00 00 00 00 00 53 4f 43 2d 52 45 53 54 03 00 00 00 45 4e 4f 4e 03 00 00 00 01 00 00 00 00 00 00 00 00 00 00 00 00 00 00 00 02 00 00 00 00 00 00 00 00 00 00 00 00 00 00 00 02 00 00 00 00 00 00 00 00 00 00 00 00 00 00 00 00 00 00 00 00 00 00 00 00 00 00 00 00 00 00 00 00 00 00 00 00 00 00 00 00 00 00 00 00 00 00 00 00 00 00 00 00 00 00 00 00 00 00 00 00 00 00 00 00 00 00 00 00 00 00 00 45 41 43 43 30 00 00 00 04 00 00 00 45 4e 4f 4e 03 00 00 00 02 00 00 00 00 00 00 00 00 00 00 00 00 00 00 00 02 00 00 00 00 00 00 00 00 00 00 00 00 00 00 00 02 00 00 00 00 00 00 00 00 00 00 00 00 00 00 00 00 00 00 00 00 00 00 00 00 00 00 00 00 00 00 00 00 00 00 00 00 00 00 00 00 00 00 00 00 00 00 00 00 00 00 00 00 00 00 00 00 00 00 00 00 00 00 00 00 00 00 00 00 00 00 00 50 41 43 43 30 00 00 00 05 00 00 00 5f 58 46 47 03 00 00 00 02 00 00 00 00 00 00 00 00 00 00 00 00 00 00 00 02 00 00 00 00 00 00 00 00 00 00 00 00 00 00 00 02 00 00 00 00 00 00 00 00 00 00 00 00 00 00 00 00 00 00 00 00 00 00 00 00 00 00 00 00 00 00 00 00 00 00 00 00 00 00 00 00 00 00 00 00 00 00 00 00 00 00 00 00 00 00 00 00 00 00 00 00 00 00 00 00 00 00 00 00 00 00 00 41 47 58 00 00 00 00 00 06 00 00 00 45 4e 4f 4e 03 00 00 00 01 00 00 00 00 00 00 00 00 00 00 00 00 00 00 00 02 00 00 00 00 00 00 00 00 00 00 00 00 00 00 00 02 00 00 00 00 00 00 00 00 00 00 00 00 00 00 00 00 00 00 00 00 00 00 00 00 00 00 00 00 00 00 00 00 00 00 00 00 00 00 00 00 00 00 00 00 00 00 00 00 00 00 00 00 00 00 00 00 00 00 00 00 00 00 00 00 00 00 00 00 00 00 00 41 4e 45 30 00 00 00 00 07 00 00 00 45 4e 4f 4e 01 00 00 00 00 00 00 00 00 00 00 00 00 00 00 00 02 00 00 00 00 00 00 00 00 00 00 00 00 00 00 00 00 00 00 00 01 00 00 00 03 00 00 00 00 00 00 00 00 00 00 00 00 00 00 00 00 00 00 00 00 00 00 00 00 00 00 00 00 00 00 00 00 00 00 00 00 00 00 00 00 00 00 00 00 00 00 00 00 00 00 00 00 00 00 00 00 00 00 00 00 00 00 00 00 00 00 00 49 53 50 00 00 00 00 00 08 00 00 00 45 4e 4f 4e 0a 00 00 00 00 00 00 00 00 00 00 00 00 00 00 00 03 00 00 00 02 00 00 00 00 00 00 00 00 00 00 00 00 00 00 00 02 00 00 00 03 00 00 00 00 00 00 00 00 00 00 00 00 00 00 00 00 00 00 00 00 00 00 00 00 00 00 00 00 00 00 00 00 00 00 00 00 00 00 00 00 00 00 00 00 00 00 00 00 00 00 00 00 00 00 00 00 00 00 00 00 00 00 00 00 00 00 00 44 49 53 50 00 00 00 00 09 00 00 00 45 4e 4f 4e 0a 00 00 00 00 00 00 00 00 00 00 00 00 00 00 00 03 00 00 00 02 00 00 00 00 00 00 00 00 00 00 00 00 00 00 00 02 00 00 00 03 00 00 00 00 00 00 00 00 00 00 00 00 00 00 00 00 00 00 00 00 00 00 00 00 00 00 00 00 00 00 00 00 00 00 00 00 00 00 00 00 00 00 00 00 00 00 00 00 00 00 00 00 00 00 00 00 00 00 00 00 00 00 00 00 00 00 00 44 49 53 50 45 58 54 30 0a 00 00 00 45 4e 4f 4e 0a 00 00 00 00 00 00 00 00 00 00 00 00 00 00 00 03 00 00 00 02 00 00 00 00 00 00 00 00 00 00 00 00 00 00 00 02 00 00 00 03 00 00 00 00 00 00 00 00 00 00 00 00 00 00 00 00 00 00 00 00 00 00 00 00 00 00 00 00 00 00 00 00 00 00 00 00 00 00 00 00 00 00 00 00 00 00 00 00 00 00 00 00 00 00 00 00 00 00 00 00 00 00 00 00 00 00 00 44 49 53 50 45 58 54 31 0b 00 00 00 45 4e 4f 4e 01 00 00 00 00 00 00 00 00 00 00 00 00 00 00 00 02 00 00 00 00 00 00 00 00 00 00 00 00 00 00 00 00 00 00 00 02 00 00 00 00 00 00 00 00 00 00 00 00 00 00 00 00 00 00 00 00 00 00 00 00 00 00 00 00 00 00 00 00 00 00 00 00 00 00 00 00 00 00 00 00 00 00 00 00 00 00 00 00 00 00 00 00 00 00 00 00 00 00 00 00 00 00 00 00 00 00 00 41 56 45 00 00 00 00 00 0c 00 00 00 45 4e 4f 4e 01 00 00 00 00 00 00 00 14 00 00 00 00 00 00 00 02 00 00 00 00 00 00 00 00 00 00 00 00 00 00 00 00 00 00 00 02 00 00 00 00 00 00 00 00 00 00 00 00 00 00 00 00 00 00 00 00 00 00 00 00 00 00 00 00 00 00 00 00 00 00 00 00 00 00 00 00 00 00 00 00 00 00 00 00 00 00 00 00 00 00 00 00 00 00 00 00 00 00 00 00 00 00 00 00 00 00 00 41 56 44 00 00 00 00 00 0d 00 00 00 45 4e 4f 4e 01 00 00 00 00 00 00 00 00 00 00 00 00 00 00 00 02 00 00 00 00 00 00 00 00 00 00 00 00 00 00 00 00 00 00 00 02 00 00 00 00 00 00 00 00 00 00 00 00 00 00 00 00 00 00 00 00 00 00 00 00 00 00 00 00 00 00 00 00 00 00 00 00 00 00 00 00 00 00 00 00 00 00 00 00 00 00 00 00 00 00 00 00 00 00 00 00 00 00 00 00 00 00 00 00 00 00 00 4d 53 52 00 00 00 00 00 0e 00 00 00 45 4e 4f 4e 01 00 00 00 00 00 00 00 00 00 00 00 00 00 00 00 02 00 00 00 00 00 00 00 00 00 00 00 00 00 00 00 00 00 00 00 02 00 00 00 00 00 00 00 00 00 00 00 00 00 00 00 00 00 00 00 00 00 00 00 00 00 00 00 00 00 00 00 00 00 00 00 00 00 00 00 00 00 00 00 00 00 00 00 00 00 00 00 00 00 00 00 00 00 00 00 00 00 00 00 00 00 00 00 00 00 00 00 4a 50 45 47 00 00 00 00 0f 00 00 00 45 4e 4f 4e 01 00 00 00 00 00 00 00 00 00 00 00 00 00 00 00 02 00 00 00 00 00 00 00 00 00 00 00 00 00 00 00 00 00 00 00 02 00 00 00 03 00 00 00 00 00 00 00 00 00 00 00 00 00 00 00 00 00 00 00 00 00 00 00 00 00 00 00 00 00 00 00 00 00 00 00 00 00 00 00 00 00 00 00 00 00 00 00 00 00 00 00 00 00 00 00 00 00 00 00 00 00 00 00 00 00 00 00 53 43 4f 44 45 43 00 00 1d 00 00 00 5f 52 54 4c 00 00 00 00 00 00 00 00 00 00 00 00 00 00 00 00 00 00 00 00 00 00 00 00 00 00 00 00 00 00 00 00 00 00 00 00 02 00 00 00 00 00 00 00 00 00 00 00 00 00 00 00 00 00 00 00 00 00 00 00 00 00 00 00 00 00 00 00 00 00 00 00 00 00 00 00 00 00 00 00 00 00 00 00 00 00 00 00 00 00 00 00 00 00 00 00 00 00 00 00 00 00 00 00 00 00 00 00 4c 54 52 00 00 00 00 00 1e 00 00 00 45 4e 4f 4e 03 00 00 00 00 00 00 00 00 00 00 00 00 00 00 00 02 00 00 00 00 00 00 00 00 00 00 00 00 00 00 00 00 00 00 00 00 00 00 00 03 00 00 00 00 00 00 00 00 00 00 00 00 00 00 00 00 00 00 00 00 00 00 00 00 00 00 00 00 00 00 00 00 00 00 00 00 00 00 00 00 00 00 00 00 00 00 00 00 00 00 00 00 00 00 00 00 00 00 00 00 00 00 00 00 00 00 00 41 54 43 30 00 00 00 00 1f 00 00 00 45 4e 4f 4e 03 00 00 00 00 00 00 00 00 00 00 00 00 00 00 00 02 00 00 00 00 00 00 00 00 00 00 00 00 00 00 00 00 00 00 00 00 00 00 00 03 00 00 00 00 00 00 00 00 00 00 00 00 00 00 00 00 00 00 00 00 00 00 00 00 00 00 00 00 00 00 00 00 00 00 00 00 00 00 00 00 00 00 00 00 00 00 00 00 00 00 00 00 00 00 00 00 00 00 00 00 00 00 00 00 00 00 00 41 54 43 31 00 00 00 00 20 00 00 00 45 4e 4f 4e 03 00 00 00 00 00 00 00 00 00 00 00 00 00 00 00 02 00 00 00 00 00 00 00 00 00 00 00 00 00 00 00 00 00 00 00 00 00 00 00 03 00 00 00 00 00 00 00 00 00 00 00 00 00 00 00 00 00 00 00 00 00 00 00 00 00 00 00 00 00 00 00 00 00 00 00 00 00 00 00 00 00 00 00 00 00 00 00 00 00 00 00 00 00 00 00 00 00 00 00 00 00 00 00 00 00 00 00 41 54 43 32 00 00 00 00 21 00 00 00 45 4e 4f 4e 03 00 00 00 00 00 00 00 00 00 00 00 00 00 00 00 02 00 00 00 00 00 00 00 00 00 00 00 00 00 00 00 00 00 00 00 00 00 00 00 03 00 00 00 00 00 00 00 00 00 00 00 00 00 00 00 00 00 00 00 00 00 00 00 00 00 00 00 00 00 00 00 00 00 00 00 00 00 00 00 00 00 00 00 00 00 00 00 00 00 00 00 00 00 00 00 00 00 00 00 00 00 00 00 00 00 00 00 41 54 43 33 00 00 00 00 22 00 00 00 45 4e 4f 4e 01 00 00 00 00 00 00 00 00 00 00 00 00 00 00 00 02 00 00 00 00 00 00 00 00 00 00 00 00 00 00 00 00 00 00 00 02 00 00 00 00 00 00 00 00 00 00 00 00 00 00 00 00 00 00 00 00 00 00 00 00 00 00 00 00 00 00 00 00 00 00 00 00 00 00 00 00 00 00 00 00 00 00 00 00 00 00 00 00 00 00 00 00 00 00 00 00 00 00 00 00 00 00 00 00 00 00 00 41 4e 53 00 00 00 00 00 23 00 00 00 45 4e 4f 4e 00 00 00 00 00 00 00 00 00 00 00 00 00 00 00 00 02 00 00 00 00 00 00 00 00 00 00 00 00 00 00 00 00 00 00 00 00 00 00 00 00 00 00 00 00 00 00 00 00 00 00 00 00 00 00 00 00 00 00 00 00 00 00 00 00 00 00 00 00 00 00 00 00 00 00 00 00 00 00 00 00 00 00 00 00 00 00 00 00 00 00 00 00 00 00 00 00 00 00 00 00 00 00 00 00 00 00 00 50 43 49 45 00 00 00 00 24 00 00 00 45 4e 4f 4e 00 00 00 00 00 00 00 00 00 00 00 00 00 00 00 00 02 00 00 00 00 00 00 00 00 00 00 00 00 00 00 00 00 00 00 00 00 00 00 00 00 00 00 00 00 00 00 00 00 00 00 00 00 00 00 00 00 00 00 00 00 00 00 00 00 00 00 00 00 00 00 00 00 00 00 00 00 00 00 00 00 00 00 00 00 00 00 00 00 00 00 00 00 00 00 00 00 00 00 00 00 00 00 00 00 00 00 00 53 42 52 00 00 00 00 00 25 00 00 00 45 4e 4f 4e 00 00 00 00 00 00 00 00 00 00 00 00 00 00 00 00 02 00 00 00 00 00 00 00 00 00 00 00 00 00 00 00 00 00 00 00 00 00 00 00 00 00 00 00 00 00 00 00 00 00 00 00 00 00 00 00 00 00 00 00 00 00 00 00 00 00 00 00 00 00 00 00 00 00 00 00 00 00 00 00 00 00 00 00 00 00 00 00 00 00 00 00 00 00 00 00 00 00 00 00 00 00 00 00 00 00 00 00 53 45 50 00 00 00 00 00 26 00 00 00 45 4e 4f 4e 00 00 00 00 00 00 00 00 00 00 00 00 00 00 00 00 02 00 00 00 00 00 00 00 00 00 00 00 00 00 00 00 00 00 00 00 00 00 00 00 00 00 00 00 00 00 00 00 00 00 00 00 00 00 00 00 00 00 00 00 00 00 00 00 00 00 00 00 00 00 00 00 00 00 00 00 00 00 00 00 00 00 00 00 00 00 00 00 00 00 00 00 00 00 00 00 00 00 00 00 00 00 00 00 00 00 00 00 53 49 4f 00 00 00 00 00];
	apple,tunable-fast-die-ctrl-ts = [00 00 05 00];
	apple,tunable-region-base = [00 00 50 80 03 00 00 00];
	apple,tunable-agx-af-wr-bw-threshold = [00 00 00 00 00 00 00 00 00 00 00 00 00 00 00 00 00 00 00 00 00 00 00 00 00 00 00 00 00 00 00 00 00 00 00 00 00 00 00 00 00 00 00 00 00 00 00 00 00 00 00 00 00 00 00 00 00 00 00 00 00 00 00 00 00 00 00 00 00 00 00 00 00 00 00 00 00 00 00 00 00 00 35 00 00 00 00 00 00 00 00 00 00 00 00 00 00 00 5a 00 00 00 00 00 00 00 34 00 00 00 00 00 00 00 89 00 00 00 00 00 00 00 59 00 00 00 00 00 00 00 93 00 00 00 00 00 00 00 88 00 00 00 00 00 00 00 00 00 00 00 00 00 00 00 92 00 00 00 00 00 00 00 3a 00 00 00 00 00 00 00 00 00 00 00 00 00 00 00 5a 00 00 00 00 00 00 00 39 00 06 00 00 00 00 00 89 00 00 00 00 00 00 00 59 00 06 00 00 00 00 00 93 00 00 00 00 00 00 00 88 00 06 00 00 00 00 00 00 00 00 00 00 00 00 00 92 00 06 00 00 00 00 00 2d 00 00 00 00 00 00 00 00 00 00 00 00 00 00 00 5a 00 00 00 00 00 00 00 2c 00 06 00 00 00 00 00 89 00 00 00 00 00 00 00 59 00 06 00 00 00 00 00 93 00 00 00 00 00 00 00 88 00 06 00 00 00 00 00 00 00 00 00 00 00 00 00 92 00 06 00 00 00 00 00 12 00 00 00 00 00 00 00 00 00 00 00 00 00 00 00 5a 00 00 00 00 00 00 00 11 00 06 00 00 00 00 00 89 00 00 00 00 00 00 00 59 00 06 00 00 00 00 00 93 00 00 00 00 00 00 00 88 00 06 00 00 00 00 00 00 00 00 00 00 00 00 00 92 00 06 00 00 00 00 00 0e 00 00 00 00 00 00 00 00 00 00 00 00 00 00 00 3c 00 00 00 00 00 00 00 0d 00 06 00 00 00 00 00 89 00 00 00 00 00 00 00 3b 00 06 00 00 00 00 00 93 00 00 00 00 00 00 00 88 00 06 00 00 00 00 00 00 00 00 00 00 00 00 00 92 00 06 00 00 00 00 00 04 00 00 00 00 00 00 00 00 00 00 00 00 00 00 00 33 00 00 00 00 00 00 00 03 00 06 00 00 00 00 00 7a 00 00 00 00 00 00 00 32 00 06 00 00 00 00 00 93 00 00 00 00 00 00 00 79 00 06 00 00 00 00 00 00 00 00 00 00 00 00 00 92 00 06 00 00 00 00 00 01 00 00 00 00 00 00 00 00 00 00 00 00 00 00 00 2c 00 00 00 00 00 00 00 00 00 06 00 00 00 00 00 5a 00 00 00 00 00 00 00 2b 00 06 00 00 00 00 00 8a 00 00 00 00 00 00 00 59 00 06 00 00 00 00 00 00 00 00 00 00 00 00 00 89 00 06 00 00 00 00 00 01 00 00 00 00 00 00 00 00 00 00 00 00 00 00 00 1e 00 00 00 00 00 00 00 00 00 06 00 00 00 00 00 3e 00 00 00 00 00 00 00 1d 00 06 00 00 00 00 00 6f 00 00 00 00 00 00 00 3d 00 06 00 00 00 00 00 00 00 00 00 00 00 00 00 6e 00 06 00 00 00 00 00 01 00 00 00 00 00 00 00 00 00 00 00 00 00 00 00 0a 00 00 00 00 00 00 00 00 00 06 00 00 00 00 00 34 00 00 00 00 00 00 00 09 00 06 00 00 00 00 00 5a 00 00 00 00 00 00 00 33 00 06 00 00 00 00 00 00 00 00 00 00 00 00 00 59 00 06 00 00 00 00 00 01 00 00 00 00 00 00 00 00 00 00 00 00 00 00 00 04 00 00 00 00 00 00 00 00 00 06 00 00 00 00 00 2c 00 00 00 00 00 00 00 03 00 06 00 00 00 00 00 41 00 00 00 00 00 00 00 2b 00 06 00 00 00 00 00 00 00 00 00 00 00 00 00 40 00 06 00 00 00 00 00 01 00 00 00 00 00 00 00 00 00 00 00 00 00 00 00 01 00 00 00 00 00 00 00 00 00 06 00 00 00 00 00 19 00 00 00 00 00 00 00 00 00 06 00 00 00 00 00 3c 00 00 00 00 00 00 00 18 00 06 00 00 00 00 00 00 00 00 00 00 00 00 00 3b 00 06 00 00 00 00 00 01 00 00 00 00 00 00 00 00 00 00 00 00 00 00 00 01 00 00 00 00 00 00 00 00 00 06 00 00 00 00 00 19 00 00 00 00 00 00 00 00 00 06 00 00 00 00 00 37 00 00 00 00 00 00 00 18 00 06 00 00 00 00 00 00 00 00 00 00 00 00 00 36 00 06 00 00 00 00 00 01 00 00 00 00 00 00 00 00 00 00 00 00 00 00 00 01 00 00 00 00 00 00 00 00 00 06 00 00 00 00 00 14 00 00 00 00 00 00 00 00 00 06 00 00 00 00 00 32 00 00 00 00 00 00 00 13 00 06 00 00 00 00 00 00 00 00 00 00 00 00 00 31 00 06 00 00 00 00 00 01 00 00 00 00 00 00 00 00 00 00 00 00 00 00 00 01 00 00 00 00 00 00 00 00 00 06 00 00 00 00 00 14 00 00 00 00 00 00 00 00 00 06 00 00 00 00 00 32 00 00 00 00 00 00 00 13 00 06 00 00 00 00 00 00 00 00 00 00 00 00 00 31 00 06 00 00 00];
	apple,tunable-uuid = [30 41 37 44 41 39 43 33 2d 45 37 46 36 2d 33 31 35 31 2d 41 43 44 45 2d 44 41 30 31 37 42 45 42 45 36 34 35 00];
	apple,tunable-segment-names = [5f 5f 54 45 58 54 3b 5f 5f 44 41 54 41 00];
	apple,tunable-segment-ranges = [00 00 50 80 03 00 00 00 00 00 00 01 00 00 00 00 00 00 50 80 03 00 00 00 00 c0 03 00 03 00 00 00 00 c0 53 80 03 00 00 00 00 c0 03 01 00 00 00 00 00 c0 53 80 03 00 00 00 00 e0 06 00 06 00 00 00];
	apple,tunable-pre-loaded = [01 00 00 00];
};
