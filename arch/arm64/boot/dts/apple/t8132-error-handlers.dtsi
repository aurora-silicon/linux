// SPDX-License-Identifier: GPL-2.0+ OR MIT
/* T8132 platform error and event-log resources. Firmware policy is not copied. */

&soc {
	soc_errors: error-handler@3a8e00000 {
		compatible = "apple,t8132-error-handler", "apple,soc-error-handler";
		reg = <0x3 0xa8e00000 0x0 0x40000>,
		      <0x3 0xa8a00000 0x0 0x8000>,
		      <0x3 0x80000000 0x0 0x7c000>,
		      <0x3 0x80700000 0x0 0xcc000>,
		      <0x3 0x882c8000 0x0 0x4000>,
		      <0x3 0x803d0000 0x0 0x4000>,
		      <0x3 0x82000000 0x0 0x1000000>,
		      <0x2 0x20000000 0x0 0x2000000>,
		      <0x2 0x22000000 0x0 0x2000000>,
		      <0x2 0x60000000 0x0 0x4000>,
		      <0x2 0x61000000 0x0 0x4000>,
		      <0x2 0x62000000 0x0 0x4000>,
		      <0x2 0x63000000 0x0 0x4000>,
		      <0x2 0x64000000 0x0 0x4000>,
		      <0x2 0x65000000 0x0 0x4000>,
		      <0x2 0x66000000 0x0 0x4000>,
		      <0x2 0x67000000 0x0 0x4000>,
		      <0x2 0x4f000000 0x0 0x1000000>,
		      <0x2 0x69000000 0x0 0x20000>,
		      <0x2 0x68032000 0x0 0x1000>,
		      <0x2 0x68432000 0x0 0x1000>,
		      <0x2 0x68832000 0x0 0x1000>,
		      <0x2 0x68c32000 0x0 0x1000>;
		interrupt-parent = <&aic>;
		interrupts = <AIC_IRQ 398 IRQ_TYPE_LEVEL_HIGH>,
		             <AIC_IRQ 407 IRQ_TYPE_LEVEL_HIGH>,
		             <AIC_IRQ 397 IRQ_TYPE_LEVEL_HIGH>,
		             <AIC_IRQ 404 IRQ_TYPE_LEVEL_HIGH>,
		             <AIC_IRQ 400 IRQ_TYPE_LEVEL_HIGH>,
		             <AIC_IRQ 401 IRQ_TYPE_LEVEL_HIGH>,
		             <AIC_IRQ 402 IRQ_TYPE_LEVEL_HIGH>,
		             <AIC_IRQ 405 IRQ_TYPE_LEVEL_HIGH>,
		             <AIC_IRQ 403 IRQ_TYPE_LEVEL_HIGH>,
		             <AIC_IRQ 945 IRQ_TYPE_LEVEL_HIGH>,
		             <AIC_IRQ 320 IRQ_TYPE_LEVEL_HIGH>,
		             <AIC_IRQ 322 IRQ_TYPE_LEVEL_HIGH>,
		             <AIC_IRQ 324 IRQ_TYPE_LEVEL_HIGH>,
		             <AIC_IRQ 327 IRQ_TYPE_LEVEL_HIGH>,
		             <AIC_IRQ 330 IRQ_TYPE_LEVEL_HIGH>,
		             <AIC_IRQ 333 IRQ_TYPE_LEVEL_HIGH>,
		             <AIC_IRQ 336 IRQ_TYPE_LEVEL_HIGH>,
		             <AIC_IRQ 339 IRQ_TYPE_LEVEL_HIGH>,
		             <AIC_IRQ 342 IRQ_TYPE_LEVEL_HIGH>,
		             <AIC_IRQ 345 IRQ_TYPE_LEVEL_HIGH>,
		             <AIC_IRQ 133 IRQ_TYPE_LEVEL_HIGH>,
		             <AIC_IRQ 134 IRQ_TYPE_LEVEL_HIGH>,
		             <AIC_IRQ 135 IRQ_TYPE_LEVEL_HIGH>,
		             <AIC_IRQ 136 IRQ_TYPE_LEVEL_HIGH>,
		             <AIC_IRQ 137 IRQ_TYPE_LEVEL_HIGH>,
		             <AIC_IRQ 138 IRQ_TYPE_LEVEL_HIGH>,
		             <AIC_IRQ 139 IRQ_TYPE_LEVEL_HIGH>,
		             <AIC_IRQ 140 IRQ_TYPE_LEVEL_HIGH>,
		             <AIC_IRQ 1083 IRQ_TYPE_LEVEL_HIGH>,
		             <AIC_IRQ 145 IRQ_TYPE_LEVEL_HIGH>,
		             <AIC_IRQ 141 IRQ_TYPE_LEVEL_HIGH>,
		             <AIC_IRQ 142 IRQ_TYPE_LEVEL_HIGH>,
		             <AIC_IRQ 143 IRQ_TYPE_LEVEL_HIGH>,
		             <AIC_IRQ 144 IRQ_TYPE_LEVEL_HIGH>;
		status = "disabled";
	};

	soc_events: event-log-handler@380700000 {
		compatible = "apple,t8132-event-log", "apple,soc-event-log";
		reg = <0x3 0x80700000 0x0 0xcc000>,
		      <0x3 0x88280000 0x0 0x80000>,
		      <0x3 0x80000000 0x0 0x70000>,
		      <0x3 0x88200000 0x0 0x7c000>,
		      <0x3 0x80280000 0x0 0x80000>,
		      <0x3 0x80280000 0x0 0x8000>,
		      <0x5 0x01878000 0x0 0x4000>,
		      <0x5 0x01868000 0x0 0x8000>,
		      <0x3 0x80340000 0x0 0xc000>,
		      <0x3 0x80350000 0x0 0xc000>,
		      <0x3 0x80208000 0x0 0x4000>,
		      <0x3 0x80208400 0x0 0x4000>,
		      <0x3 0x8020a400 0x0 0x4000>,
		      <0x3 0x8020a600 0x0 0x4000>,
		      <0x3 0x8020a700 0x0 0x4000>,
		      <0x3 0x8020a800 0x0 0x4000>,
		      <0x3 0x8020aa00 0x0 0x4000>,
		      <0x3 0x8020ab00 0x0 0x4000>,
		      <0x3 0x8020ac00 0x0 0x4000>,
		      <0x3 0x8020ae00 0x0 0x4000>,
		      <0x3 0x8020af00 0x0 0x4000>,
		      <0x3 0x8020b000 0x0 0x4000>,
		      <0x3 0x8020b200 0x0 0x4000>,
		      <0x3 0x8020b300 0x0 0x4000>,
		      <0x3 0x8020b400 0x0 0x4000>,
		      <0x3 0x8020b600 0x0 0x4000>,
		      <0x3 0x8020b700 0x0 0x4000>,
		      <0x3 0x8020b800 0x0 0x4000>,
		      <0x3 0x8020ba00 0x0 0x4000>,
		      <0x3 0x8020bb00 0x0 0x4000>,
		      <0x3 0x8020bc00 0x0 0x4000>,
		      <0x3 0x8020be00 0x0 0x4000>,
		      <0x3 0x8020bf00 0x0 0x4000>,
		      <0x3 0x8020c000 0x0 0x4000>,
		      <0x3 0x8020c200 0x0 0x4000>,
		      <0x3 0x8020c300 0x0 0x4000>,
		      <0x3 0x8020c400 0x0 0x4000>,
		      <0x3 0x8020c600 0x0 0x4000>,
		      <0x3 0x8020c700 0x0 0x4000>,
		      <0x3 0x8020c800 0x0 0x4000>,
		      <0x3 0x8020ca00 0x0 0x4000>,
		      <0x3 0x8020cb00 0x0 0x4000>,
		      <0x3 0x8020cc00 0x0 0x4000>,
		      <0x3 0x8020ce00 0x0 0x4000>,
		      <0x3 0x8020d000 0x0 0x4000>,
		      <0x3 0x8020d200 0x0 0x4000>,
		      <0x3 0x8020d400 0x0 0x4000>,
		      <0x3 0x8020d600 0x0 0x4000>,
		      <0x3 0x8020d800 0x0 0x4000>,
		      <0x3 0x8020da00 0x0 0x4000>,
		      <0x3 0x82800000 0x0 0xbc000>,
		      <0x3 0x82900000 0x0 0x4000>,
		      <0x3 0x00e1c000 0x0 0x4000>,
		      <0x3 0x00e1f800 0x0 0x4000>,
		      <0x3 0x00e28000 0x0 0x4000>;
		interrupt-parent = <&aic>;
		interrupts = <AIC_IRQ 256 IRQ_TYPE_LEVEL_HIGH>,
		             <AIC_IRQ 257 IRQ_TYPE_LEVEL_HIGH>,
		             <AIC_IRQ 301 IRQ_TYPE_LEVEL_HIGH>,
		             <AIC_IRQ 316 IRQ_TYPE_LEVEL_HIGH>,
		             <AIC_IRQ 22 IRQ_TYPE_LEVEL_HIGH>,
		             <AIC_IRQ 23 IRQ_TYPE_LEVEL_HIGH>,
		             <AIC_IRQ 612 IRQ_TYPE_LEVEL_HIGH>,
		             <AIC_IRQ 604 IRQ_TYPE_LEVEL_HIGH>,
		             <AIC_IRQ 266 IRQ_TYPE_LEVEL_HIGH>,
		             <AIC_IRQ 268 IRQ_TYPE_LEVEL_HIGH>,
		             <AIC_IRQ 77 IRQ_TYPE_LEVEL_HIGH>,
		             <AIC_IRQ 932 IRQ_TYPE_LEVEL_HIGH>;
		status = "disabled";
	};

};
