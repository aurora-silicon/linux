// SPDX-License-Identifier: GPL-2.0+ OR MIT
/*
 * K114c (M5 Max, G17C) GPU, for the boot loader's GPU handoff. Everything here
 * stays disabled: the loader checks the ADT and the live GPU firmware build,
 * fills the GPU reservations, then enables the power states, both mailboxes and
 * the GPU, the GPU last. A loader that refuses leaves the GPU off.
 *
 * Same layout as t6050-j714s-gpu-panel.dtsi; the GPU is G17C and, in the ADT,
 * sgx and both GPU ASCs are the same as on the M5 Pro.
 */

#include "t6050-gpu-g17s.dtsi"

/*
 * The G17 firmware stays live across suspend-to-idle, as the G16's does on T8132: keep
 * GFX on in the noirq phase instead of gating it under the running firmware.
 */
&ps_gfx {
	apple,sleep-retained;
};
