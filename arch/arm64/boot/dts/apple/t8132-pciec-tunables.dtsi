// SPDX-License-Identifier: GPL-2.0+ OR MIT
/*
 * T8132 PCIe-C (USB4 PCIe tunnel) calibration, converted from the ADT
 * apciec0/1 tunables, which match on the J713, J715 and J773g.
 *
 * Copyright The Asahi Linux Contributors
 */

&usb4_0_pcie {
	apple,tunable-debug =
		<0x1000 0x1 0x0>;
	apple,tunable-fabric =
		<0x4 0x3f003f 0x200020>,
		<0x8 0x1 0x1>,
		<0xc 0x1 0x1>,
		<0x10 0x801f 0x4>,
		<0x18 0x1ff 0x1c0>,
		<0x1c 0x1 0x1>,
		<0x20 0x801f 0x4>,
		<0x28 0x1f 0x10>,
		<0x2c 0x801f 0x4>,
		<0x34 0x3f 0x20>,
		<0x38 0x801f 0x4>,
		<0x40 0x3f 0x20>,
		<0x44 0x801f 0x4>,
		<0x4c 0x10001 0x10001>,
		<0x50 0x1 0x1>,
		<0x54 0x1 0x1>,
		<0x58 0x801f 0x4>,
		<0x60 0x7f007f 0x450045>,
		<0x64 0x801f 0x4>,
		<0x6c 0x1f001f 0x100010>,
		<0x70 0xf1 0x1>,
		<0x74 0x801f 0x4>,
		<0x7c 0x801f 0x4>,
		<0x84 0x1 0x1>,
		<0x88 0x1 0x1>,
		<0x8c 0x801f 0x4>,
		<0x94 0x1 0x1>,
		<0x98 0x801f 0x4>,
		<0xa0 0x1 0x1>,
		<0xa4 0x801f 0x4>,
		<0xac 0x1 0x1>,
		<0xb0 0x1 0x1>,
		<0xb4 0x801f 0x4>,
		<0xbc 0x801f 0x4>,
		<0xc4 0x801f 0x4>;
	apple,tunable-rc =
		<0x78 0x7000 0x0>,
		<0x718 0x7c000 0x0>,
		<0x814 0xffffffff 0x2000f060>,
		<0x8bc 0x1 0x0>;
};

&usb4_0_pcie_port {
	apple,tunable =
		<0x140 0x1 0x1>;
};

&usb4_1_pcie {
	apple,tunable-debug =
		<0x1000 0x1 0x0>;
	apple,tunable-fabric =
		<0x4 0x3f003f 0x200020>,
		<0x8 0x1 0x1>,
		<0xc 0x1 0x1>,
		<0x10 0x801f 0x4>,
		<0x18 0x1ff 0x1c0>,
		<0x1c 0x1 0x1>,
		<0x20 0x801f 0x4>,
		<0x28 0x1f 0x10>,
		<0x2c 0x801f 0x4>,
		<0x34 0x3f 0x20>,
		<0x38 0x801f 0x4>,
		<0x40 0x3f 0x20>,
		<0x44 0x801f 0x4>,
		<0x4c 0x10001 0x10001>,
		<0x50 0x1 0x1>,
		<0x54 0x1 0x1>,
		<0x58 0x801f 0x4>,
		<0x60 0x7f007f 0x450045>,
		<0x64 0x801f 0x4>,
		<0x6c 0x1f001f 0x100010>,
		<0x70 0xf1 0x1>,
		<0x74 0x801f 0x4>,
		<0x7c 0x801f 0x4>,
		<0x84 0x1 0x1>,
		<0x88 0x1 0x1>,
		<0x8c 0x801f 0x4>,
		<0x94 0x1 0x1>,
		<0x98 0x801f 0x4>,
		<0xa0 0x1 0x1>,
		<0xa4 0x801f 0x4>,
		<0xac 0x1 0x1>,
		<0xb0 0x1 0x1>,
		<0xb4 0x801f 0x4>,
		<0xbc 0x801f 0x4>,
		<0xc4 0x801f 0x4>;
	apple,tunable-rc =
		<0x78 0x7000 0x0>,
		<0x718 0x7c000 0x0>,
		<0x814 0xffffffff 0x2000f060>,
		<0x8bc 0x1 0x0>;
};

&usb4_1_pcie_port {
	apple,tunable =
		<0x140 0x1 0x1>;
};

