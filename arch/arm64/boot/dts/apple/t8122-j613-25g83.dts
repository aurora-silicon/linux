// SPDX-License-Identifier: GPL-2.0+ OR MIT
/* J613 with the exact 25G83 firmware profile. */
#include "t8122-j613.dts"
#include "t8122-j613-dcp-25g83.dtsi"
#include "t8122-j613-qspi.dtsi"

/*
 * Bind the MTP by its SoC compatible only: U-Boot's generic helper starts
 * and quiesces it, after which the 25G83 MTP firmware data-aborts.
 */
&mtp {
	compatible = "apple,t8122-mtp", "apple,t8122-rtk-helper-asc4", "apple,mtp";
};

/* The 25G83 MTP_SYS uses GPIO-mediated AFE power sequencing. */
&mtp_mt {
	apple,power-method = <2>;
};
