// SPDX-License-Identifier: GPL-2.0+ OR MIT
/*
 * The Neural Engine is described for every T6050 board in t6050-ane.dtsi.
 * This name is kept for board files that still include it.
 */

#include "t6050-ane.dtsi"
