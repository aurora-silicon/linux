// SPDX-License-Identifier: GPL-2.0+ OR MIT

#include "t6050-isp.dtsi"

&isp0 {
	apple,dart-vm-size = /bits/ 64 <0xde000000>;
	sensor-presets {
		preset0 {
			apple,config-index = <5>;
			apple,input-size = <1920 2160>;
			apple,output-size = <1920 1080>;
			apple,crop = <0 0 1920 1080>;
		};
	};
};
