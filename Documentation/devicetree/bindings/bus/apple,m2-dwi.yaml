## Documentation/devicetree/bindings/display/apple,display-engine.yaml
```yaml
# SPDX-License-Identifier: (GPL-2.0-only OR BSD-2-Clause)
%YAML 1.2
---
$id: "http://devicetree.org/schemas/display/apple,display-engine.yaml#"

$schema: "http://devicetree.org/meta-schemas/core.yaml#"

title: "Apple display engine hardware resources"

maintainers:
  - "Ryan Murray <81541646+RyanTheTide@users.noreply.github.com>"

description: "T6050 native resource description. Firmware ownership, backend support and enables require separate qualification. This variant remains disabled and contains no programming sequences or firmware data."

select:
  anyOf:
    -
      properties:
        compatible:
          contains:
            enum:
              - "apple,display-engine"
              - "apple,t6050-display-engine"
      required:
        - "compatible"
    -
      properties:
        compatible:
          items:
            -
              const: "apple,t6050-display-engine"
            -
              const: "apple,display-engine"
      required:
        - "compatible"

properties:
  compatible: true
  status: true
  reg: true
  interrupts: true
  iommus: true
  clocks: true
  power-domains: true
  resets: true

additionalProperties: true

allOf:
  - if:
      anyOf:
        -
          properties:
            compatible:
              items:
                -
                  const: "apple,t6050-display-engine"
                -
                  const: "apple,display-engine"
            status:
              const: "disabled"
          required:
            - "compatible"
            - "status"
    then:
      oneOf:
        -
          description: "T6050 native resource description. Firmware ownership, backend support and enables require separate qualification. This variant remains disabled and contains no programming sequences or firmware data."
          properties:
            compatible:
              items:
                -
                  const: "apple,t6050-display-engine"
                -
                  const: "apple,display-engine"
            status:
              const: "disabled"
            reg:
              minItems: 5
              maxItems: 5
              description: "Native register apertures in hardware-interface order, including shared auxiliary views."
            interrupts:
              minItems: 11
              maxItems: 13
            iommus:
              minItems: 2
              maxItems: 2
            clocks:
              maxItems: 2
          required:
            - "compatible"
            - "reg"
            - "status"
            - "interrupts"
            - "iommus"
            - "clocks"
          additionalProperties: false
    else:
      properties:
        compatible:
          items:
            -
              const: "apple,t6050-display-engine"
            -
              const: "apple,display-engine"
        status:
          const: "disabled"
        reg:
          minItems: 5
          maxItems: 5
          description: "Native register apertures in hardware-interface order, including shared auxiliary views."
        interrupts:
          minItems: 11
          maxItems: 13
        iommus:
          minItems: 2
          maxItems: 2
        clocks:
          maxItems: 2
      required:
        - "compatible"
        - "reg"
        - "status"
        - "interrupts"
        - "iommus"
        - "clocks"
      additionalProperties: false
```

## Documentation/devicetree/bindings/display/apple,display-secure-proxy.yaml
```yaml
# SPDX-License-Identifier: (GPL-2.0-only OR BSD-2-Clause)
%YAML 1.2
---
$id: http://devicetree.org/schemas/display/apple,display-secure-proxy.yaml#
$schema: http://devicetree.org/meta-schemas/core.yaml#

title: Apple secure display proxy apertures

maintainers:
  - Ryan Murray <81541646+RyanTheTide@users.noreply.github.com>

description: |
  Secure display proxy register apertures. They are distinct from the
  non-secure display engine and remain owned by firmware.

properties:
  compatible:
    oneOf:
      - items:
          - const: apple,t8140-display-secure-proxy
          - const: apple,display-secure-proxy

  reg:
    minItems: 3
    maxItems: 3
    description: Register apertures in hardware-description order.

required:
  - compatible
  - reg

additionalProperties: false
```

## Documentation/devicetree/bindings/display/apple,display-subsystem.yaml
```yaml
# SPDX-License-Identifier: (GPL-2.0 OR BSD-2-Clause)
%YAML 1.2
---
$id: http://devicetree.org/schemas/display/apple,display-subsystem.yaml#
$schema: http://devicetree.org/meta-schemas/core.yaml#

title: Apple display subsystem

maintainers:
  - Ryan Murray <ryan@aurorasilicon.org>

description:
  Component master for one or more Apple display coprocessors. Each IOMMU
  entry describes a scanout DART stream owned by a DCP instance.

properties:
  compatible:
    oneOf:
      - enum:
          - apple,display-subsystem
          - apple,t8132-display-subsystem
      - const: apple,t8132-display-diagnostics
        deprecated: true
      - items:
          - const: apple,t8140-display-subsystem
          - const: apple,display-subsystem
      - items:
          - const: apple,t8132-display-subsystem
          - const: apple,t8132-display-diagnostics
        description: Compatibility with kernels predating the common M4 display backend.

  iommus:
    minItems: 1
    maxItems: 8

  memory-region:
    minItems: 1
    maxItems: 64
    description: Reserved memory retaining the inherited display mappings.

  apple,j713-inherited-mappings:
    type: boolean
    description: The loader validated the inherited J713 SID0 scanout mapping.

required:
  - compatible
  - iommus

unevaluatedProperties: false
...
```

## Documentation/devicetree/bindings/display/apple,dp-in.yaml
```yaml
# SPDX-License-Identifier: (GPL-2.0-only OR BSD-2-Clause)
%YAML 1.2
---
$id: http://devicetree.org/schemas/display/apple,dp-in.yaml#
$schema: http://devicetree.org/meta-schemas/core.yaml#

title: Apple DisplayPort input adapter

maintainers:
  - Ryan Murray <81541646+RyanTheTide@users.noreply.github.com>

description: |
  Hardware resources of the Apple Silicon DisplayPort input adapter.
  The interface is described for discovery and must remain disabled until
  its ownership, initialization and shutdown are supported. Register windows
  are listed in hardware resource order; firmware configuration and tuning
  data are supplied by the boot firmware rather than this binding.

select:
  properties:
    compatible:
      contains:
        enum:
          - apple,t8122-dp-in
          - apple,t6030-dp-in
          - apple,t6031-dp-in
  required:
    - compatible

properties:
  compatible:
    items:
      - enum:
          - apple,t8122-dp-in
          - apple,t6030-dp-in
          - apple,t6031-dp-in
      - const: apple,dp-in

  reg:
    maxItems: 1

  interrupts:
    maxItems: 1

required:
  - compatible
  - reg
  - interrupts

additionalProperties: false
```
