## Documentation/devicetree/bindings/bus/apple,m2-dwi.yaml
```yaml
# SPDX-License-Identifier: (GPL-2.0-only OR BSD-2-Clause)
%YAML 1.2
---
$id: http://devicetree.org/schemas/bus/apple,m2-dwi.yaml#
$schema: http://devicetree.org/meta-schemas/core.yaml#

title: Apple M2 generation two-wire interface

maintainers:
  - Ryan Murray <81541646+RyanTheTide@users.noreply.github.com>

description: |
  Two-wire interface resources on M2 generation SoCs. The register apertures
  follow hardware resource order. Firmware configuration and tuning are
  supplied by the bootloader and are not part of this binding. Unqualified
  instances must remain disabled.

select:
  properties:
    compatible:
      contains:
        enum:
          - apple,t6020-dwi
          - apple,t6021-dwi
          - apple,t6022-dwi
          - apple,t8112-dwi
  required:
    - compatible

properties:
  compatible:
    items:
      - enum:
          - apple,t6020-dwi
          - apple,t6021-dwi
          - apple,t6022-dwi
          - apple,t8112-dwi
      - const: apple,dwi

  reg:
    maxItems: 1

  interrupts:
    maxItems: 1

  power-domains:
    maxItems: 1

required:
  - compatible
  - reg
  - interrupts
  - power-domains

additionalProperties: false
```

## Documentation/devicetree/bindings/bus/apple,t6032-dwi.yaml
```yaml
# SPDX-License-Identifier: (GPL-2.0-only OR BSD-2-Clause)
%YAML 1.2
---
$id: http://devicetree.org/schemas/bus/apple,t6032-dwi.yaml#
$schema: http://devicetree.org/meta-schemas/core.yaml#

title: Apple T6032 display two-wire interface

maintainers:
  - Ryan Murray <81541646+RyanTheTide@users.noreply.github.com>

description: |
  Hardware resources of the T6032 display two-wire interface. The package contains two
  peripheral dies. Register banks follow hardware resource order. The block
  remains disabled until its ownership and lifecycle are supported; firmware
  data and tuning are supplied separately by the boot firmware.

select:
  properties:
    compatible:
      contains:
        const: apple,t6032-dwi
  required:
    - compatible

properties:
  compatible:
    items:
      - const: apple,t6032-dwi
      - const: apple,dwi

  reg:
    minItems: 1
    maxItems: 1

  interrupts:
    minItems: 1
    maxItems: 1

  power-domains:
    minItems: 1
    maxItems: 1

required:
  - compatible
  - reg
  - interrupts
  - power-domains

additionalProperties: false
```

## Documentation/devicetree/bindings/bus/apple,t8132-dwi.yaml
```yaml
# SPDX-License-Identifier: (GPL-2.0-only OR BSD-2-Clause)
%YAML 1.2
---
$id: http://devicetree.org/schemas/bus/apple,t8132-dwi.yaml#
$schema: http://devicetree.org/meta-schemas/core.yaml#

title: Apple M4 base SoC two-wire display interface

maintainers:
  - Ryan Murray <81541646+RyanTheTide@users.noreply.github.com>

description: |
  Hardware resources of the M4 base SoC two-wire display interface.
  The interface is described for discovery and must remain disabled until
  its ownership, initialization and shutdown are supported. Register windows
  are listed in hardware resource order; firmware configuration and tuning
  data are supplied by the boot firmware rather than this binding.

select:
  properties:
    compatible:
      contains:
        enum:
          - apple,t8132-dwi
  required:
    - compatible

properties:
  compatible:
    items:
      - enum:
          - apple,t8132-dwi
      - const: apple,dwi

  reg:
    minItems: 1
    maxItems: 1

  interrupts:
    minItems: 1
    maxItems: 1

  power-domains:
    minItems: 1
    maxItems: 1

required:
  - compatible
  - reg
  - interrupts
  - power-domains

additionalProperties: false
```

## Documentation/devicetree/bindings/chosen/apple,dcp-rtkit-quiesced.yaml
```yaml
# SPDX-License-Identifier: (GPL-2.0 OR BSD-2-Clause)
%YAML 1.2
---
$id: http://devicetree.org/schemas/chosen/apple,dcp-rtkit-quiesced.yaml#
$schema: http://devicetree.org/meta-schemas/core.yaml#

title: Apple DCP RTKit loader hand-off

maintainers:
  - Ryan Murray <ryan@aurorasilicon.org>

description:
  The loader records whether it handed a running display coprocessor to
  the kernel. It omits this property on a chainload.

select:
  properties:
    $nodename:
      const: chosen
  required:
    - $nodename

properties:
  $nodename:
    const: chosen

  apple,dcp-rtkit-quiesced:
    $ref: /schemas/types.yaml#/definitions/uint32
    enum: [0, 1]
    description:
      One if the DCP core was running at hand-off, zero if it was not.
      The name reflects the loader's RTKit hand-off state, not a request
      for Linux to quiesce the coprocessor.

additionalProperties: true
...
```

## Documentation/devicetree/bindings/chosen/aura,hibernate.yaml
```yaml
# SPDX-License-Identifier: (GPL-2.0-only OR BSD-2-Clause)
%YAML 1.2
---
$id: http://devicetree.org/schemas/chosen/aura,hibernate.yaml#
$schema: http://devicetree.org/meta-schemas/core.yaml#

title: Memory layout a boot object keeps the same on every boot

maintainers:
  - František Balázsy <frantisekbalazsy@gmail.com>

description: |
  A hibernation image puts every saved page back into the frame it was taken
  from, so the boot that resumes an image has to give the kernel the same RAM,
  and keep the same ranges from it, as the boot that wrote the image. On Apple
  silicon the boot firmware loads the boot object at an address that changes
  from boot to boot, and what the boot object keeps alive after the hand-off
  moves with it. A boot object that instead keeps everything from the start of
  RAM up to a fixed end from the kernel, at the same addresses on every boot,
  says so with aura,hibernate-layout. Without it the kernel neither hibernates
  nor resumes.

  The boot firmware still places some firmware segments anew on every boot,
  inside that range, and a kernel restored from an image holds the device tree
  of the boot that wrote the image. The boot object therefore puts the device
  tree of every boot at one address inside the range, given in
  aura,hibernate-dt. The image does not contain that memory, so the restored
  kernel reads there what the resuming boot placed.

  The properties are named after aura, the boot loader that defined them and
  whose released versions publish them.

select:
  properties:
    $nodename:
      const: chosen
  required:
    - $nodename

properties:
  $nodename:
    const: chosen

  aura,hibernate-layout:
    $ref: /schemas/types.yaml#/definitions/uint64-array
    description:
      The range of RAM that is kept from the kernel and laid out the same on
      every boot.
    items:
      - description: Physical address of the start of RAM.
      - description: Physical address of the end of the range, exclusive.

  aura,hibernate-dt:
    $ref: /schemas/types.yaml#/definitions/uint64
    description:
      Physical address, inside the range of aura,hibernate-layout, of the
      device tree the kernel is started with. The kernel reads at most 2 MiB
      there.

dependencies:
  aura,hibernate-dt: [ 'aura,hibernate-layout' ]

additionalProperties: true
...
```

## Documentation/devicetree/bindings/chosen/aurora,ctxr-exec-window.yaml
```yaml
# SPDX-License-Identifier: (GPL-2.0 OR BSD-2-Clause)
%YAML 1.2
---
$id: http://devicetree.org/schemas/chosen/aurora,ctxr-exec-window.yaml#
$schema: http://devicetree.org/meta-schemas/core.yaml#

title: Executable window for a kernel running behind a CTXR

maintainers:
  - Diljit Singh <hey@djdev.me>

description:
  On Apple silicon from the M4 generation on, the boot firmware arms a code
  text execute range on the secondary CPUs, so privileged code there can only
  be fetched from one physical window. The bootloader tells the kernel where
  that window is, and the kernel keeps all of its executable code inside it.
  See Documentation/arch/arm64/ctxr-execmem.rst.

select:
  properties:
    $nodename:
      const: chosen
  required:
    - $nodename

properties:
  $nodename:
    const: chosen

  aurora,ctxr-exec-window:
    $ref: /schemas/types.yaml#/definitions/uint64-array
    description: The physical window the kernel's executable code has to stay in.
    items:
      - description:
          Physical base of the window, not zero and aligned to the kernel's
          page size.
      - description:
          Size of the window in bytes, not zero and aligned to the kernel's
          page size.

additionalProperties: true
...
```

## Documentation/devicetree/bindings/chosen/aurora,s2r-mailbox.yaml
```yaml
# SPDX-License-Identifier: (GPL-2.0-only OR BSD-2-Clause)
%YAML 1.2
---
$id: http://devicetree.org/schemas/chosen/aurora,s2r-mailbox.yaml#
$schema: http://devicetree.org/meta-schemas/core.yaml#

title: Return path of a boot object that owns the CPU reset vectors

maintainers:
  - František Balázsy <frantisekbalazsy@gmail.com>

description: |
  On Apple silicon the boot firmware locks every CPU's reset vector to the
  boot object it started. A CPU that comes back from a power-off, and every
  CPU after a suspend to RAM, therefore restarts in the boot object, not in the
  kernel. A boot object that sends such a CPU back to the kernel says so with
  this property: a secondary CPU returns through its spin-table release
  address, and the boot CPU of a resume jumps, at EL2 with the MMU off, to the
  address the kernel left in the mailbox. Its presence also tells the kernel
  that its spin-table CPUs may leave the kernel and come back.

  The mailbox is four 64-bit words in the CPU's byte order:
    0: the magic value 0x3152325341525541 ("AURAS2R1"), written by the boot
       object before the kernel starts
    1: the MPIDR of the only CPU that may take the resume address
    2: the resume address, set by the kernel before it suspends and cleared
       by the boot object when a CPU takes it
    3: how many times the resume address was taken

select:
  properties:
    $nodename:
      const: chosen
  required:
    - $nodename

properties:
  $nodename:
    const: chosen

  aurora,s2r-mailbox:
    $ref: /schemas/types.yaml#/definitions/uint64
    description:
      Physical address of the mailbox, inside the boot object's own memory,
      which the kernel does not use.

additionalProperties: true
...
```

## Documentation/devicetree/bindings/clock/apple,nco-service.yaml
```yaml
# SPDX-License-Identifier: (GPL-2.0-only OR BSD-2-Clause)
%YAML 1.2
---
$id: http://devicetree.org/schemas/clock/apple,nco-service.yaml#
$schema: http://devicetree.org/meta-schemas/core.yaml#

title: Apple firmware NCO clock service

maintainers:
  - Ryan Murray <81541646+RyanTheTide@users.noreply.github.com>

description: |
  Firmware-managed numerically controlled oscillator service. Unlike the
  directly programmed NCO binding, no AP register window is published.
  The input selectors identify clocks in the PMGR clock namespace.

properties:
  compatible:
    oneOf:
      - items:
          - const: apple,t8140-nco-service
          - const: apple,nco-service

  clocks:
    minItems: 4
    maxItems: 4

required:
  - compatible
  - clocks

additionalProperties: false
```

## Documentation/devicetree/bindings/clock/apple,pmgr-clocks.yaml
```yaml
# SPDX-License-Identifier: (GPL-2.0-only OR BSD-2-Clause)
%YAML 1.2
---
$id: http://devicetree.org/schemas/clock/apple,pmgr-clocks.yaml#
$schema: http://devicetree.org/meta-schemas/core.yaml#

title: Apple PMGR peripheral clock selectors

maintainers:
  - Ryan Murray <81541646+RyanTheTide@users.noreply.github.com>

description: |
  Peripheral input clocks managed by the SoC power manager. The clock
  specifier is the SoC clock selector from the hardware description. It is
  separate from a PMGR device/power-gate ID. Rates may change with performance
  state and must not be represented as fixed clocks sampled at one boot.
  The provider remains disabled until a generation-specific clock driver
  can resolve selectors and coordinate ownership with firmware.
  Selectors are scoped by the referenced PMGR; a dual-die platform has
  one provider per die.

select:
  properties:
    compatible:
      contains:
        enum:
          - apple,t6000-pmgr-clocks
          - apple,t6032-pmgr-clocks
          - apple,t6041-pmgr-clocks
          - apple,t6050-pmgr-clocks
          - apple,t8103-pmgr-clocks
          - apple,t8132-pmgr-clocks
          - apple,t8140-pmgr-clocks
          - apple,t8142-pmgr-clocks
  required:
    - compatible

properties:
  compatible: true

  apple,pmgr:
    $ref: /schemas/types.yaml#/definitions/phandle
    description: Shared hardware resource metadata.

allOf:
  - if:
      properties:
        compatible:
          contains:
            enum:
              - apple,t8132-pmgr-clocks
      required:
        - compatible
    then:
      properties:
        compatible:
          items:
            - const: apple,t8132-pmgr-clocks
            - const: apple,pmgr-clocks

        '#clock-cells':
          const: 1

      required:
        - compatible
        - '#clock-cells'
    else:
      allOf:
        - if:
            properties:
              compatible:
                contains:
                  enum:
                    - apple,t6032-pmgr-clocks
            required:
              - compatible
          then:
            properties:
              compatible:
                items:
                  - const: apple,t6032-pmgr-clocks
                  - const: apple,pmgr-clocks

              '#clock-cells':
                const: 1

            required:
              - compatible
              - '#clock-cells'
          else:
            properties:
              compatible:
                items:
                  - enum:
                      - apple,t6000-pmgr-clocks
                      - apple,t6041-pmgr-clocks
                      - apple,t6050-pmgr-clocks
                      - apple,t8103-pmgr-clocks
                      - apple,t8140-pmgr-clocks
                      - apple,t8142-pmgr-clocks
                  - const: apple,pmgr-clocks

              reg:
                description: PMGR control apertures in hardware-description order.
                minItems: 44
                maxItems: 63

              '#clock-cells':
                const: 1

              apple,pmgr:
                $ref: /schemas/types.yaml#/definitions/phandle
                description: Primary PMGR syscon. Additional control banks are described by reg.

            required:
              - reg
              - compatible
              - '#clock-cells'
              - apple,pmgr

            allOf:
              - if:
                  properties:
                    compatible:
                      contains:
                        const: apple,t8142-pmgr-clocks
                then:
                  properties:
                    reg:
                      minItems: 54
                      maxItems: 54
              - if:
                  properties:
                    compatible:
                      contains:
                        const: apple,t6041-pmgr-clocks
                then:
                  properties:
                    reg:
                      minItems: 63
                      maxItems: 63
              - if:
                  properties:
                    compatible:
                      contains:
                        const: apple,t6050-pmgr-clocks
                then:
                  properties:
                    reg:
                      minItems: 60
                      maxItems: 60
              - if:
                  properties:
                    compatible:
                      contains:
                        const: apple,t8140-pmgr-clocks
                then:
                  properties:
                    reg:
                      minItems: 44
                      maxItems: 44

            additionalProperties: false

unevaluatedProperties: false
```
