## Documentation/devicetree/bindings/clock/apple,t6032-pmgr-clocks.yaml
```yaml
# SPDX-License-Identifier: (GPL-2.0-only OR BSD-2-Clause)
%YAML 1.2
---
$id: http://devicetree.org/schemas/clock/apple,t6032-pmgr-clocks.yaml#
$schema: http://devicetree.org/meta-schemas/core.yaml#

title: Apple T6032 peripheral clock namespace

maintainers:
  - Ryan Murray <81541646+RyanTheTide@users.noreply.github.com>

description: |
  PMGR peripheral clock outputs identified by the hardware clock IDs.
  The provider describes the wiring without assuming fixed frequencies
  or programming sequences. It remains disabled until a clock driver can
  manage those outputs. The single clock specifier is the hardware clock ID, including its die selector.

select:
  properties:
    compatible:
      contains:
        const: apple,t6032-pmgr-clocks
  required:
    - compatible

properties:
  compatible:
    items:
      - const: apple,t6032-pmgr-clocks
      - const: apple,pmgr-clocks

  '#clock-cells':
    const: 1

required:
  - compatible
  - '#clock-cells'

additionalProperties: false
```

## Documentation/devicetree/bindings/clock/apple,t8132-pmgr-clocks.yaml
```yaml
# SPDX-License-Identifier: (GPL-2.0-only OR BSD-2-Clause)
%YAML 1.2
---
$id: http://devicetree.org/schemas/clock/apple,t8132-pmgr-clocks.yaml#
$schema: http://devicetree.org/meta-schemas/core.yaml#

title: Apple T8132 peripheral clock namespace

maintainers:
  - Ryan Murray <81541646+RyanTheTide@users.noreply.github.com>

description: |
  PMGR peripheral clock outputs identified by the hardware clock IDs.
  The provider describes the wiring without assuming fixed frequencies
  or programming sequences. It remains disabled until a clock driver can
  manage those outputs. The single clock specifier is the hardware clock ID.

select:
  properties:
    compatible:
      contains:
        const: apple,t8132-pmgr-clocks
  required:
    - compatible

properties:
  compatible:
    items:
      - const: apple,t8132-pmgr-clocks
      - const: apple,pmgr-clocks

  '#clock-cells':
    const: 1

required:
  - compatible
  - '#clock-cells'

additionalProperties: false
```

## Documentation/devicetree/bindings/cpu/apple,t8140-cpuidle.yaml
```yaml
# SPDX-License-Identifier: (GPL-2.0-only OR BSD-2-Clause)
%YAML 1.2
---
$id: http://devicetree.org/schemas/cpu/apple,t8140-cpuidle.yaml#
$schema: http://devicetree.org/meta-schemas/core.yaml#

title: Apple T6040, T8132 and T8140 CPU idle controller

maintainers:
  - Ryan Murray <ryan@aurorasilicon.org>

description:
  Selects the Apple CPU idle driver on T6040, T8132 and T8140 systems. On these
  SoCs the hardware decides when an idle core is power-gated after WFI;
  software cannot request core or cluster power-down, so WFI is the only
  idle state.

properties:
  $nodename:
    const: cpuidle

  compatible:
    enum:
      - apple,t6041-cpuidle
      - apple,t8132-cpuidle
      - apple,t8140-cpuidle

required:
  - compatible

additionalProperties: false

examples:
  - |
    cpuidle {
        compatible = "apple,t8140-cpuidle";
    };
```

## Documentation/devicetree/bindings/crypto/apple,aes-s8000.yaml
```yaml
# SPDX-License-Identifier: (GPL-2.0-only OR BSD-2-Clause)
%YAML 1.2
---
$id: http://devicetree.org/schemas/crypto/apple,aes-s8000.yaml#
$schema: http://devicetree.org/meta-schemas/core.yaml#

title: Apple S8000-family SIO AES engine

maintainers:
  - Ryan Murray <ryan@aurorasilicon.org>

description: |
  An AP-programmed AES engine behind the SIO DART, independent of the SIO
  coprocessor firmware. T6000 and T8112 have revision 3 hardware with two
  register apertures. T6041 and T8140 have revision 5 hardware with an
  additional DKEY-distribution aperture. Key-disable register layouts differ
  between SoCs and are selected by the SoC-specific compatible, including
  between the two revision 5 implementations.

  The key-disable aperture contains hardware-key lifecycle state, not key
  material. Diagnostic software must never write it. The DKEY aperture is
  described for completeness and is not needed for read-only diagnostics.

properties:
  compatible:
    items:
      - enum:
          - apple,t6000-aes
          - apple,t8112-aes
          - apple,t6041-aes
          - apple,t8140-aes
      - const: apple,aes-s8000

  reg:
    minItems: 2
    maxItems: 3

  reg-names:
    minItems: 2
    items:
      - const: engine
      - const: key-disable
      - const: dkey

  interrupts:
    maxItems: 1

  power-domains:
    maxItems: 1

  iommus:
    minItems: 1
    maxItems: 2
    description: SIO DART stream 1; T6000 uses both SIO DART instances.

allOf:
  - if:
      properties:
        compatible:
          contains:
            enum:
              - apple,t6000-aes
              - apple,t8112-aes
    then:
      properties:
        reg:
          maxItems: 2
        reg-names:
          maxItems: 2
    else:
      properties:
        reg:
          minItems: 3
        reg-names:
          minItems: 3
  - if:
      properties:
        compatible:
          contains:
            const: apple,t6000-aes
    then:
      properties:
        iommus:
          minItems: 2
    else:
      properties:
        iommus:
          maxItems: 1

required:
  - compatible
  - reg
  - reg-names
  - interrupts
  - power-domains
  - iommus

additionalProperties: false

examples:
  - |
    #include <dt-bindings/interrupt-controller/apple-aic.h>
    #include <dt-bindings/interrupt-controller/irq.h>

    soc {
        #address-cells = <2>;
        #size-cells = <2>;

        crypto@23500c000 {
            compatible = "apple,t8112-aes", "apple,aes-s8000";
            reg = <0x2 0x3500c000 0x0 0x4000>,
                  <0x2 0x3d2dc000 0x0 0x8000>;
            reg-names = "engine", "key-disable";
            interrupt-parent = <&aic>;
            interrupts = <AIC_IRQ 759 IRQ_TYPE_LEVEL_HIGH>;
            power-domains = <&ps_aes>;
            iommus = <&sio_dart 1>;
            status = "disabled";
        };
    };
  - |
    #include <dt-bindings/interrupt-controller/apple-aic.h>
    #include <dt-bindings/interrupt-controller/irq.h>

    soc {
        #address-cells = <2>;
        #size-cells = <2>;

        crypto@38500c000 {
            compatible = "apple,t8140-aes", "apple,aes-s8000";
            reg = <0x3 0x8500c000 0x0 0x4000>,
                  <0x3 0x082dc000 0x0 0x8000>,
                  <0x3 0x08078000 0x0 0x4000>;
            reg-names = "engine", "key-disable", "dkey";
            interrupt-parent = <&aic>;
            interrupts = <AIC_IRQ 1107 IRQ_TYPE_LEVEL_HIGH>;
            power-domains = <&ps_aes>;
            iommus = <&sio_dart 1>;
            status = "disabled";
        };
    };
```

## Documentation/devicetree/bindings/crypto/apple,aes.yaml
```yaml
# SPDX-License-Identifier: (GPL-2.0-only OR BSD-2-Clause)
%YAML 1.2
---
$id: http://devicetree.org/schemas/crypto/apple,aes.yaml#
$schema: http://devicetree.org/meta-schemas/core.yaml#

title: Apple AES engine

maintainers:
  - Ryan Murray <81541646+RyanTheTide@users.noreply.github.com>

description: |
  AES hardware attached to the SIO DART. The register banks are the
  engine, shared control and auxiliary control windows, in that order.

select:
  properties:
    compatible:
      contains:
        enum:
          - apple,t6000-aes
          - apple,t6020-aes
          - apple,t6021-aes
          - apple,t6022-aes
          - apple,t6030-aes
          - apple,t6031-aes
          - apple,t6032-aes
          - apple,t6041-aes
          - apple,t6050-aes
          - apple,t8103-aes
          - apple,t8112-aes
          - apple,t8122-aes
          - apple,t8132-aes
          - apple,t8140-aes
  required:
    - compatible

properties:
  compatible: true

allOf:
  - if:
      properties:
        compatible:
          contains:
            enum:
              - apple,t8132-aes
      required:
        - compatible
    then:
      properties:
        compatible:
          items:
            - enum:
                - apple,t8132-aes
            - const: apple,aes

        reg:
          minItems: 3
          maxItems: 3

        interrupts:
          maxItems: 1

        power-domains:
          maxItems: 1

        iommus:
          maxItems: 1

      required:
        - compatible
        - reg
        - interrupts
        - power-domains
        - iommus
    else:
      allOf:
        - if:
            properties:
              compatible:
                contains:
                  enum:
                    - apple,t6032-aes
            required:
              - compatible
          then:
            properties:
              compatible:
                items:
                  - const: apple,t6032-aes
                  - const: apple,aes

              reg:
                minItems: 2
                maxItems: 2

              interrupts:
                maxItems: 1

              power-domains:
                maxItems: 1

              iommus:
                maxItems: 1

            required:
              - compatible
              - reg
              - interrupts
              - power-domains
              - iommus
          else:
            properties:
              compatible:
                items:
                  - enum:
                      - apple,t6000-aes
                      - apple,t6020-aes
                      - apple,t6021-aes
                      - apple,t6022-aes
                      - apple,t6030-aes
                      - apple,t6031-aes
                      - apple,t6041-aes
                      - apple,t6050-aes
                      - apple,t8103-aes
                      - apple,t8112-aes
                      - apple,t8122-aes
                      - apple,t8140-aes
                  - const: apple,aes

              reg:
                minItems: 2
                maxItems: 3
                description: Engine and control banks, with an auxiliary bank on later variants.

              interrupts:
                maxItems: 1

              power-domains:
                maxItems: 1

              iommus:
                minItems: 1
                maxItems: 2

            required:
              - compatible
              - reg
              - interrupts
              - power-domains
              - iommus

            allOf:
              - if:
                  properties:
                    compatible:
                      contains:
                        enum:
                          - apple,t6000-aes
                          - apple,t6020-aes
                          - apple,t6021-aes
                          - apple,t6022-aes
                          - apple,t6030-aes
                          - apple,t6031-aes
                          - apple,t8103-aes
                          - apple,t8112-aes
                          - apple,t8122-aes
                then:
                  properties:
                    reg:
                      maxItems: 2
                else:
                  properties:
                    reg:
                      minItems: 3
              - if:
                  properties:
                    compatible:
                      contains:
                        const: apple,t6000-aes
                then:
                  properties:
                    iommus:
                      minItems: 2
                else:
                  properties:
                    iommus:
                      maxItems: 1

            additionalProperties: false

unevaluatedProperties: false
```

## Documentation/devicetree/bindings/crypto/apple,m2-aes.yaml
```yaml
# SPDX-License-Identifier: (GPL-2.0-only OR BSD-2-Clause)
%YAML 1.2
---
$id: http://devicetree.org/schemas/crypto/apple,m2-aes.yaml#
$schema: http://devicetree.org/meta-schemas/core.yaml#

title: Apple M2 generation AES engine

maintainers:
  - Ryan Murray <81541646+RyanTheTide@users.noreply.github.com>

description: |
  AES engine resources on M2 generation SoCs. The register apertures
  follow hardware resource order. Firmware configuration and tuning are
  supplied by the bootloader and are not part of this binding. Unqualified
  instances must remain disabled.

select:
  properties:
    compatible:
      contains:
        enum:
          - apple,t6020-aes
          - apple,t6021-aes
          - apple,t6022-aes
          - apple,t8112-aes
  required:
    - compatible

properties:
  compatible:
    items:
      - enum:
          - apple,t6020-aes
          - apple,t6021-aes
          - apple,t6022-aes
          - apple,t8112-aes
      - const: apple,aes

  reg:
    maxItems: 2

  interrupts:
    maxItems: 1

  iommus:
    maxItems: 1

  power-domains:
    maxItems: 1

required:
  - compatible
  - reg
  - interrupts
  - iommus
  - power-domains

additionalProperties: false
```

## Documentation/devicetree/bindings/crypto/apple,m3-aes.yaml
```yaml
# SPDX-License-Identifier: (GPL-2.0-only OR BSD-2-Clause)
%YAML 1.2
---
$id: http://devicetree.org/schemas/crypto/apple,m3-aes.yaml#
$schema: http://devicetree.org/meta-schemas/core.yaml#

title: Apple M3 family AES accelerator

maintainers:
  - Ryan Murray <81541646+RyanTheTide@users.noreply.github.com>

description: |
  Hardware resources of the M3 family AES accelerator.
  The interface is described for discovery and must remain disabled until
  its ownership, initialization and shutdown are supported. Register windows
  are listed in hardware resource order; firmware configuration and tuning
  data are supplied by the boot firmware rather than this binding.

select:
  properties:
    compatible:
      contains:
        enum:
          - apple,t8122-aes
          - apple,t6030-aes
          - apple,t6031-aes
  required:
    - compatible

properties:
  compatible:
    items:
      - enum:
          - apple,t8122-aes
          - apple,t6030-aes
          - apple,t6031-aes
      - const: apple,aes

  reg:
    minItems: 2
    maxItems: 2

  interrupts:
    minItems: 1
    maxItems: 1

  power-domains:
    minItems: 1
    maxItems: 1

required:
  - compatible
  - reg
  - interrupts
  - power-domains

additionalProperties: false
```

## Documentation/devicetree/bindings/crypto/apple,t6032-aes.yaml
```yaml
# SPDX-License-Identifier: (GPL-2.0-only OR BSD-2-Clause)
%YAML 1.2
---
$id: http://devicetree.org/schemas/crypto/apple,t6032-aes.yaml#
$schema: http://devicetree.org/meta-schemas/core.yaml#

title: Apple T6032 AES accelerator

maintainers:
  - Ryan Murray <81541646+RyanTheTide@users.noreply.github.com>

description: |
  Hardware resources of the T6032 AES accelerator. The package contains two
  peripheral dies. Register banks follow hardware resource order. The block
  remains disabled until its ownership and lifecycle are supported; firmware
  data and tuning are supplied separately by the boot firmware.

select:
  properties:
    compatible:
      contains:
        const: apple,t6032-aes
  required:
    - compatible

properties:
  compatible:
    items:
      - const: apple,t6032-aes
      - const: apple,aes

  reg:
    minItems: 2
    maxItems: 2

  interrupts:
    minItems: 1
    maxItems: 1

  power-domains:
    minItems: 1
    maxItems: 1

  iommus:
    minItems: 1
    maxItems: 1

required:
  - compatible
  - reg
  - interrupts
  - power-domains
  - iommus

additionalProperties: false
```
