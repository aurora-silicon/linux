## Documentation/devicetree/bindings/mfd/apple,smc.yaml
```yaml
# SPDX-License-Identifier: (GPL-2.0-only OR BSD-2-Clause)
%YAML 1.2
---
$id: http://devicetree.org/schemas/mfd/apple,smc.yaml#

$schema: http://devicetree.org/meta-schemas/core.yaml#

title: Apple Mac System Management Controller

maintainers:
  - Sven Peter <sven@kernel.org>

description:
  Apple Mac System Management Controller implements various functions
  such as GPIO, RTC, power, reboot.

select:
  anyOf:
    -
      properties:
        compatible:
          contains:
            enum:
              - apple,smc
              - apple,t6000-smc
              - apple,t6020-smc
              - apple,t6030-smc
              - apple,t6031-smc
              - apple,t6041-smc
              - apple,t8103-smc
              - apple,t8112-smc
              - apple,t8122-smc
              - apple,t8132-smc
              - apple,t8140-smc
              - apple,t8142-smc
              - apple,t8152-smc
      required:
        - compatible
    -
      properties:
        compatible:
          allOf:
            -
              contains:
                enum:
                  - apple,t8142-smc
            -
              contains:
                const: apple,smc
      required:
        - compatible
properties:
  compatible: true

  reg: true

  reg-names: true

  mboxes:
    maxItems: 1

  gpio:
    $ref: /schemas/gpio/apple,smc-gpio.yaml

  gpio-low:
    $ref: /schemas/gpio/apple,smc-gpio.yaml

  reboot:
    $ref: /schemas/power/reset/apple,smc-reboot.yaml

  rtc:
    $ref: /schemas/rtc/apple,smc-rtc.yaml

  hwmon:
    $ref: /schemas/hwmon/apple,smc-hwmon.yaml

# The root declares the union of property types for DTB decoding. The
# conditional variants below each retain their closed property contract.
additionalProperties: true

allOf:
  -
    if:
      anyOf:
        -
          properties:
            compatible:
              allOf:
                -
                  contains:
                    enum:
                      - apple,t8142-smc
                -
                  contains:
                    const: apple,smc
            status:
              const: disabled
          required:
            - compatible
            - status
          not:
            required:
              - mboxes
    then:
      oneOf:
        -
          type: object
          description: |
            Apple system management coprocessor. Initial resource description for an unsupported
            firmware/backend layout. Register, IRQ and DMA topology can be recorded before a driver
            exists. This form must stay disabled; it does not substitute for the enabled driver contract
            or supply firmware, calibration, programming sequences or unresolved providers.
          properties:
            compatible:
              items:
                -
                  enum:
                    - apple,t8142-smc
                -
                  const: apple,smc
            status:
              const: disabled
            reg:
              description: |
                Register apertures of the complete hardware complex, in hardware interface order.
              minItems: 3
              maxItems: 3
            interrupts:
              description: Interrupt lines wired to the system interrupt controller.
              minItems: 4
              maxItems: 4
          required:
            - compatible
            - reg
            - status
          additionalProperties: false
    else:
      $ref: "#/$defs/legacy-driver"

$defs:
  legacy-driver:
    type: object
    properties:
      compatible:
        oneOf:
          - description: T8152 SMC with read-only hardware monitoring.
            const: apple,t8152-smc
          - items:
              - enum:
                  - apple,t6020-smc
                  - apple,t6030-smc
                  - apple,t6031-smc
                  - apple,t6041-smc
                  - apple,t8122-smc
                  - apple,t8132-smc
                  - apple,t8140-smc
                  - apple,t8142-smc
              - const: apple,t8103-smc
          - items:
              - enum:
                  # Do not add additional SoC to this list.
                  - apple,t6000-smc
                  - apple,t8103-smc
                  - apple,t8112-smc
              - const: apple,smc

      reg:
        items:
          - description: SMC area
          - description: SRAM area

      reg-names:
        items:
          - const: smc
          - const: sram

      mboxes:
        maxItems: 1

      gpio:
        $ref: /schemas/gpio/apple,smc-gpio.yaml

      gpio-low:
        $ref: /schemas/gpio/apple,smc-gpio.yaml

      reboot:
        $ref: /schemas/power/reset/apple,smc-reboot.yaml

      rtc:
        $ref: /schemas/rtc/apple,smc-rtc.yaml

      hwmon:
        $ref: /schemas/hwmon/apple,smc-hwmon.yaml
    additionalProperties: false
    required:
      - compatible
      - reg
      - reg-names
      - mboxes

examples:
  - |
    soc {
      #address-cells = <2>;
      #size-cells = <2>;

      smc@23e400000 {
        compatible = "apple,t8103-smc", "apple,smc";
        reg = <0x2 0x3e400000 0x0 0x4000>,
               <0x2 0x3fe00000 0x0 0x100000>;
        reg-names = "smc", "sram";
        mboxes = <&smc_mbox>;

        smc_gpio: gpio {
          compatible = "apple,smc-gpio";
          gpio-controller;
          #gpio-cells = <2>;
        };

        reboot {
          compatible = "apple,smc-reboot";
          nvmem-cells = <&shutdown_flag>, <&boot_stage>,
                        <&boot_error_count>, <&panic_count>;
          nvmem-cell-names = "shutdown_flag", "boot_stage",
                             "boot_error_count", "panic_count";
        };

        rtc {
          compatible = "apple,smc-rtc";
          nvmem-cells = <&rtc_offset>;
          nvmem-cell-names = "rtc_offset";
       };

        hwmon {
          compatible = "apple,smc-hwmon";

          current-ID0R {
            apple,key-id = "ID0R";
            label = "AC Input Current";
          };

          fan-F0Ac {
            apple,key-id = "F0Ac";
            apple,fan-minimum = "F0Mn";
            apple,fan-maximum = "F0Mx";
            apple,fan-target = "F0Tg";
            apple,fan-mode = "F0Md";
            label = "Fan 1";
          };

          power-PSTR {
            apple,key-id = "PSTR";
            label = "Total System Power";
          };

          temperature-TW0P {
            apple,key-id = "TW0P";
            label = "WiFi/BT Module Temperature";
          };

          voltage-VD0R {
            apple,key-id = "VD0R";
            label = "AC Input Voltage";
          };
        };
      };
    };
```

## Documentation/devicetree/bindings/misc/apple,avellino.yaml
```yaml
# SPDX-License-Identifier: (GPL-2.0-only OR BSD-2-Clause)
%YAML 1.2
---
$id: http://devicetree.org/schemas/misc/apple,avellino.yaml#
$schema: http://devicetree.org/meta-schemas/core.yaml#

title: Apple Avellino control interface

maintainers:
  - Ryan Murray <81541646+RyanTheTide@users.noreply.github.com>

description: |
  Addressed Avellino control interfaces on an I2C bus. Describing their
  bus addresses does not specify a register protocol or transfer firmware
  ownership to the host.

properties:
  compatible:
    items:
      - const: apple,t8112-avellino
      - const: apple,avellino

  reg:
    maxItems: 1

required:
  - compatible
  - reg

additionalProperties: false
```

## Documentation/devicetree/bindings/misc/apple,display-pcon.yaml
```yaml
# SPDX-License-Identifier: (GPL-2.0-only OR BSD-2-Clause)
%YAML 1.2
---
$id: http://devicetree.org/schemas/misc/apple,display-pcon.yaml#
$schema: http://devicetree.org/meta-schemas/core.yaml#

title: Apple display protocol converter control

maintainers:
  - Ryan Murray <81541646+RyanTheTide@users.noreply.github.com>

description: |
  Display protocol converter control endpoint on the panel control bus.
  Firmware retains control of the display path at boot.

properties:
  compatible:
    items:
      - enum:
          - apple,t6041-display-pcon
          - apple,t8122-display-pcon
          - apple,t6030-display-pcon
          - apple,t6031-display-pcon
      - const: apple,display-pcon

  reg:
    maxItems: 1

required:
  - compatible
  - reg

additionalProperties: false
```

## Documentation/devicetree/bindings/misc/apple,hcpm.yaml
```yaml
# SPDX-License-Identifier: (GPL-2.0-only OR BSD-2-Clause)
%YAML 1.2
---
$id: http://devicetree.org/schemas/misc/apple,hcpm.yaml#
$schema: http://devicetree.org/meta-schemas/core.yaml#

title: Apple HCPM USB power control interface

maintainers:
  - Ryan Murray <81541646+RyanTheTide@users.noreply.github.com>

description: |
  I2C power control endpoint on the desktop port-management bus.
  Firmware personality, update data and power policy are runtime data.

properties:
  compatible:
    items:
      - enum:
          - apple,t8103-hcpm
      - const: apple,hcpm

  reg:
    maxItems: 1

required:
  - compatible
  - reg

additionalProperties: false
```

## Documentation/devicetree/bindings/misc/apple,radio-pmu.yaml
```yaml
# SPDX-License-Identifier: (GPL-2.0-only OR BSD-2-Clause)
%YAML 1.2
---
$id: http://devicetree.org/schemas/misc/apple,radio-pmu.yaml#
$schema: http://devicetree.org/meta-schemas/core.yaml#

title: Apple radio power management follower

maintainers:
  - Ryan Murray <81541646+RyanTheTide@users.noreply.github.com>

description: |
  SPMI radio power-management follower. The firmware controls its power
  policy. With the apple,spmi-nvmem fallback the follower register space is
  also exported as a read-only NVMEM device for inspection.

select:
  properties:
    compatible:
      contains:
        const: apple,radio-pmu
  required:
    - compatible

properties:
  compatible:
    minItems: 2
    items:
      - enum:
          - apple,t6041-radio-pmu
          - apple,t6000-wifibt-pmu
          - apple,t6000-uwb-pmu
          - apple,t8112-wifibt-pmu
      - const: apple,radio-pmu
      - const: apple,spmi-nvmem

  reg:
    maxItems: 1

required:
  - compatible
  - reg

allOf:
  - $ref: /schemas/nvmem/nvmem.yaml#
  - if:
      properties:
        compatible:
          contains:
            const: apple,spmi-nvmem
    then:
      required:
        - read-only

unevaluatedProperties: false
```

## Documentation/devicetree/bindings/misc/apple,sd-card-control.yaml
```yaml
# SPDX-License-Identifier: (GPL-2.0-only OR BSD-2-Clause)
%YAML 1.2
---
$id: http://devicetree.org/schemas/misc/apple,sd-card-control.yaml#
$schema: http://devicetree.org/meta-schemas/core.yaml#

title: Apple SD card sideband control

maintainers:
  - Ryan Murray <81541646+RyanTheTide@users.noreply.github.com>

description: |
  Sideband control device on the SD reader control bus. The PCIe card
  reader is a separate device; this endpoint does not replace it.

properties:
  compatible:
    items:
      - enum:
          - apple,t6000-sd-card-control
          - apple,t6030-sd-card-control
          - apple,t6031-sd-card-control
          - apple,t6041-sd-card-control
      - const: apple,sd-card-control

  reg:
    maxItems: 1

required:
  - compatible
  - reg

additionalProperties: false
```

## Documentation/devicetree/bindings/misc/apple,spmi-all-ace.yaml
```yaml
# SPDX-License-Identifier: (GPL-2.0-only OR BSD-2-Clause)
%YAML 1.2
---
$id: http://devicetree.org/schemas/misc/apple,spmi-all-ace.yaml#
$schema: http://devicetree.org/meta-schemas/core.yaml#

title: Apple SPMI Type-C control companion

maintainers:
  - Ryan Murray <81541646+RyanTheTide@users.noreply.github.com>

description: |
  SPMI companion endpoint alongside the Type-C port controllers. It
  remains firmware-owned and is distinct from the per-port HPM followers.

properties:
  compatible:
    items:
      - enum:
          - apple,t8140-spmi-all-ace
      - const: apple,spmi-all-ace

  reg:
    maxItems: 1

required:
  - compatible
  - reg

additionalProperties: false
```

## Documentation/devicetree/bindings/misc/apple,touchbar-calibration.yaml
```yaml
# SPDX-License-Identifier: (GPL-2.0-only OR BSD-2-Clause)
%YAML 1.2
---
$id: http://devicetree.org/schemas/misc/apple,touchbar-calibration.yaml#
$schema: http://devicetree.org/meta-schemas/core.yaml#

title: Apple Touch Bar calibration storage

maintainers:
  - Ryan Murray <81541646+RyanTheTide@users.noreply.github.com>

description: |
  I2C calibration storage associated with the Touch Bar. Contents and
  per-unit data are not part of the static hardware description.

properties:
  compatible:
    items:
      - enum:
          - apple,t8103-touchbar-calibration
      - const: apple,touchbar-calibration

  reg:
    maxItems: 1

required:
  - compatible
  - reg

additionalProperties: false
```

## Documentation/devicetree/bindings/misc/apple,touchbar-driver.yaml
```yaml
# SPDX-License-Identifier: (GPL-2.0-only OR BSD-2-Clause)
%YAML 1.2
---
$id: http://devicetree.org/schemas/misc/apple,touchbar-driver.yaml#
$schema: http://devicetree.org/meta-schemas/core.yaml#

title: Apple Touch Bar I2C control interface

maintainers:
  - Ryan Murray <81541646+RyanTheTide@users.noreply.github.com>

description: |
  I2C control interface associated with the Touch Bar. Its register
  protocol and ownership handoff remain unqualified.

properties:
  compatible:
    items:
      - enum:
          - apple,t8103-touchbar-driver
      - const: apple,touchbar-driver

  reg:
    maxItems: 1

required:
  - compatible
  - reg

additionalProperties: false
```

## Documentation/devicetree/bindings/misc/apple,xspmi-proxy.yaml
```yaml
# SPDX-License-Identifier: (GPL-2.0-only OR BSD-2-Clause)
%YAML 1.2
---
$id: http://devicetree.org/schemas/misc/apple,xspmi-proxy.yaml#
$schema: http://devicetree.org/meta-schemas/core.yaml#

title: Apple external SPMI proxy follower

maintainers:
  - Ryan Murray <81541646+RyanTheTide@users.noreply.github.com>

description: |
  External SPMI proxy endpoint on the NUB SPMI bus. Firmware owns the
  proxy transport until a host driver establishes an access contract.

properties:
  compatible:
    items:
      - enum:
          - apple,t8140-xspmi-proxy
      - const: apple,xspmi-proxy

  reg:
    maxItems: 1

required:
  - compatible
  - reg

additionalProperties: false
```
