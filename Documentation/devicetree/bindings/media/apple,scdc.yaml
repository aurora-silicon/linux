## Documentation/devicetree/bindings/mux/apple,display-crossbar.yaml
```yaml
# SPDX-License-Identifier: (GPL-2.0-only OR BSD-2-Clause)
%YAML 1.2
---
$id: http://devicetree.org/schemas/mux/apple,display-crossbar.yaml#

$schema: http://devicetree.org/meta-schemas/core.yaml#

title: Apple display crossbar

maintainers:
  - Sven Peter <sven@svenpeter.dev>

description:
  Routes display pipelines to the DisplayPort transmitters and inputs
  of an Apple Type-C PHY. Each crossbar exposes three mux controls,
  selected by the consumer's mux specifier.

select:
  anyOf:
    -
      properties:
        compatible:
          contains:
            enum:
              - apple,t6000-display-crossbar
              - apple,t6020-display-crossbar
              - apple,t6030-display-crossbar
              - apple,t6031-display-crossbar
              - apple,t6041-display-crossbar
              - apple,t6050-display-crossbar
              - apple,t8103-display-crossbar
              - apple,t8112-display-crossbar
              - apple,t8122-display-crossbar
              - apple,t8132-display-crossbar
              - apple,t8142-display-crossbar
      required:
        - compatible
    -
      properties:
        compatible:
          items:
            -
              const: apple,t6050-display-crossbar
            -
              const: apple,display-crossbar
      required:
        - compatible

properties:
  compatible: true
  reg: true
  power-domains: true
  power-domain-names: true
  "#mux-control-cells": true
  interrupts: true
  iommus: true
  clocks: true
  resets: true
  status: true

additionalProperties: true

allOf:
  - if:
      anyOf:
        -
          properties:
            compatible:
              items:
                -
                  const: apple,t6050-display-crossbar
                -
                  const: apple,display-crossbar
            status:
              const: disabled
          required:
            - compatible
            - status
    then:
      oneOf:
        -
          description: |
            T6050 native resource description. Firmware ownership, backend support and enables require
            separate qualification. This variant remains disabled and contains no programming sequences or
            firmware data.
          properties:
            compatible:
              items:
                -
                  const: apple,t6050-display-crossbar
                -
                  const: apple,display-crossbar
            status:
              const: disabled
            reg:
              maxItems: 1
              description: |
                Native register apertures in hardware-interface order, including shared auxiliary views.
          required:
            - compatible
            - reg
            - status
          additionalProperties: false
    else:
      allOf:
        - $ref: mux-controller.yaml#
        - if:
            properties:
              compatible:
                contains:
                  const: apple,t6050-display-crossbar
          then:
            properties:
              power-domains:
                minItems: 2
                maxItems: 2
            required:
              - power-domain-names
          else:
            properties:
              power-domains:
                maxItems: 1
      properties:
        compatible:
          oneOf:
            - enum:
                - apple,t8103-display-crossbar
                - apple,t8112-display-crossbar
                - apple,t6000-display-crossbar
                - apple,t6020-display-crossbar
                - apple,t6041-display-crossbar
                - apple,t8142-display-crossbar
                - apple,t8132-display-crossbar
            - items:
                - const: apple,t8112-display-crossbar
                - const: apple,t8103-display-crossbar
            - items:
                - enum:
                    - apple,t6030-display-crossbar
                    - apple,t6031-display-crossbar
                    - apple,t8122-display-crossbar
                - const: apple,t6020-display-crossbar
            - items:
                - const: apple,t6050-display-crossbar
                - const: apple,t8142-display-crossbar

        reg:
          maxItems: 1

        power-domains:
          minItems: 1
          maxItems: 2

        power-domain-names:
          items:
            - const: usb-aon
            - const: common

        '#mux-control-cells':
          const: 1
      required:
        - compatible
        - reg
        - '#mux-control-cells'
      unevaluatedProperties: false

examples:
  - |
    mux-controller@b04c000 {
        compatible = "apple,t6020-display-crossbar";
        reg = <0xb04c000 0x4000>;
        #mux-control-cells = <1>;
    };
```
