## Documentation/devicetree/bindings/media/apple,isp.yaml
```yaml
# SPDX-License-Identifier: (GPL-2.0-only OR BSD-2-Clause)
%YAML 1.2
---
$id: http://devicetree.org/schemas/media/apple,isp.yaml#
$schema: http://devicetree.org/meta-schemas/core.yaml#

title: Apple Image Signal Processor

maintainers:
  - Jonathan Goyvaerts <jonathan.goyvaerts@gmail.com>

description:
  The ISP controls the attached camera sensor and processes its frames using
  a coprocessor. The host exchanges commands and image buffers through three
  DART instances. The memory handoff identifies either the allocation heap or
  separate firmware text, data and heap regions.

select:
  properties:
    compatible:
      contains:
        enum: ['apple,t6020-isp', 'apple,t6041-isp', 'apple,t8112-isp']
  required:
    - compatible

properties:
  compatible:
    items:
      - enum:
          - apple,t6020-isp
          - apple,t6041-isp
          - apple,t8112-isp
      - const: apple,isp

  reg:
    items:
      - description: Coprocessor registers up to its control block
      - description: Mailbox interrupt registers
      - description: Firmware handshake registers
      - description: Mailbox doorbell registers

  reg-names:
    items:
      - const: coproc
      - const: mbox
      - const: gpio
      - const: mbox2

  interrupts:
    maxItems: 1

  iommus:
    items:
      - description: First ISP DART stream
      - description: Second ISP DART stream
      - description: Third ISP DART stream

  power-domains:
    minItems: 7
    maxItems: 18
    description: Register-backed power domains required by the ISP.

  memory-region:
    minItems: 1
    maxItems: 3
    description: Firmware memory and the host allocation heap.

  memory-region-names:
    minItems: 1
    maxItems: 3
    items:
      enum: [text, data, heap]

  apple,dart-vm-size:
    $ref: /schemas/types.yaml#/definitions/uint64
    description:
      Size in bytes of the host allocation aperture used by the ISP driver.

  apple,platform-id:
    $ref: /schemas/types.yaml#/definitions/uint32
    description:
      Platform identifier passed in the firmware boot descriptor.

  apple,cam-connections-scheme:
    $ref: /schemas/types.yaml#/definitions/uint32
    description:
      Camera connection layout of the board passed in the firmware boot
      descriptor.

  apple,temporal-filter:
    $ref: /schemas/types.yaml#/definitions/uint32
    description:
      Firmware temporal-filter strength selected for the attached sensor.

  sensor-presets:
    type: object
    description:
      Sensor firmware presets and the host output geometry associated with them.
    patternProperties:
      "^preset[0-9]+$":
        type: object
        properties:
          apple,config-index:
            $ref: /schemas/types.yaml#/definitions/uint32
            description: Sensor configuration index understood by the firmware
          apple,input-size:
            $ref: /schemas/types.yaml#/definitions/uint32-array
            items:
              - description: Input width in pixels
              - description: Input height in pixels
            description: Sensor input dimensions
          apple,output-size:
            $ref: /schemas/types.yaml#/definitions/uint32-array
            items:
              - description: Output width in pixels
              - description: Output height in pixels
            description: Delivered frame dimensions
          apple,crop:
            $ref: /schemas/types.yaml#/definitions/uint32-array
            items:
              - description: Horizontal crop origin in pixels
              - description: Vertical crop origin in pixels
              - description: Crop width in pixels
              - description: Crop height in pixels
            description: Cropped sensor rectangle
        required:
          - apple,config-index
          - apple,input-size
          - apple,output-size
          - apple,crop
        additionalProperties: false
    additionalProperties: false

required:
  - compatible
  - reg
  - reg-names
  - interrupts
  - iommus
  - power-domains
  - apple,dart-vm-size

allOf:
  - if:
      properties:
        compatible:
          contains:
            const: apple,t6041-isp
    then:
      properties:
        power-domains:
          items:
            - description: ISP system domain
            - description: ISP CPU domain
            - description: ISP FE domain
            - description: ISP DPRX domain
            - description: ISP secure domain
            - description: ISP BE domain
            - description: ISP CLR domain
            - description: Camera sensor domain
        memory-region:
          minItems: 3
        memory-region-names:
          items:
            - const: text
            - const: data
            - const: heap
      required:
        - memory-region
        - memory-region-names
        - apple,platform-id
        - sensor-presets
    else:
      properties:
        memory-region:
          maxItems: 1
        memory-region-names:
          items:
            - const: heap
  - if:
      not:
        properties:
          status:
            const: disabled
        required:
          - status
    then:
      required:
        - memory-region
        - memory-region-names
        - apple,platform-id
        - sensor-presets

additionalProperties: false

examples:
  - |
    #include <dt-bindings/interrupt-controller/apple-aic.h>
    #include <dt-bindings/interrupt-controller/irq.h>

    soc {
        #address-cells = <2>;
        #size-cells = <2>;

        isp@580000000 {
            compatible = "apple,t6041-isp", "apple,isp";
            reg = <0x5 0x80000000 0x0 0x1604000>,
                  <0x5 0x82924000 0x0 0x40>,
                  <0x5 0x829241d0 0x0 0x20>,
                  <0x5 0x82924464 0x0 0x10>;
            reg-names = "coproc", "mbox", "gpio", "mbox2";
            interrupt-parent = <&aic>;
            interrupts = <AIC_IRQ 0x286 IRQ_TYPE_LEVEL_HIGH>;
            iommus = <&isp_dart0 0>, <&isp_dart1 0>, <&isp_dart2 0>;
            power-domains = <&ps_isp_sys>, <&ps_isp_cpu>, <&ps_isp_fe>,
                            <&ps_isp_dprx>, <&ps_isp_secure>, <&ps_isp_be>,
                            <&ps_isp_clr>, <&ps_ispsens0>;
            memory-region = <&isp_fw_text>, <&isp_fw_data>, <&isp_heap>;
            memory-region-names = "text", "data", "heap";
            apple,dart-vm-size = /bits/ 64 <0xde600000>;
            apple,platform-id = <5>;
            apple,cam-connections-scheme = <0x10>;

            sensor-presets {
                preset0 {
                    apple,config-index = <5>;
                    apple,input-size = <1920 2160>;
                    apple,output-size = <1920 1080>;
                    apple,crop = <0 0 1920 1080>;
                };
            };
        };
    };
```

## Documentation/devicetree/bindings/media/apple,jpeg.yaml
```yaml
# SPDX-License-Identifier: (GPL-2.0-only OR BSD-2-Clause)
%YAML 1.2
---
$id: http://devicetree.org/schemas/media/apple,jpeg.yaml#
$schema: http://devicetree.org/meta-schemas/core.yaml#

title: Apple Silicon JPEG codec

maintainers:
  - Ryan Murray <ryan@aurorasilicon.org>

description: |
  Apple Silicon JPEG engines are directly programmed memory-to-memory codecs.
  Each engine has a dedicated interrupt and DART stream. Multiple engines can
  share a power domain. The power controller manages the gate. Earlier
  engines also identify native input-clock selectors. The codec has no
  firmware interface.

  On T6041 the DMA window reserves one 4 GiB slice of the DART high alias for
  the engine's 32-bit buffer pointer registers. T8140 engines take 64-bit
  buffer addresses and use their DART's full window.

select:
  properties:
    compatible:
      contains:
        enum:
          - apple,t6000-jpeg
          - apple,t6020-jpeg
          - apple,t6021-jpeg
          - apple,t6022-jpeg
          - apple,t6030-jpeg
          - apple,t6031-jpeg
          - apple,t6032-jpeg
          - apple,t6041-jpeg
          - apple,t8103-jpeg
          - apple,t8112-jpeg
          - apple,t8122-jpeg
          - apple,t8132-jpeg
          - apple,t6050-jpeg
          - apple,t8140-jpeg
  required:
    - compatible

properties:
  compatible: true

  apple,dma-range:
    $ref: /schemas/types.yaml#/definitions/uint64-array
    description: Shared hardware resource metadata.

allOf:
  - if:
      properties:
        compatible:
          contains:
            enum:
              - apple,t8132-jpeg
              - apple,t6050-jpeg
      required:
        - compatible
    then:
      properties:
        compatible:
          items:
            - enum:
                - apple,t8132-jpeg
                - apple,t6050-jpeg
            - const: apple,jpeg

        reg:
          maxItems: 1

        interrupts:
          maxItems: 1

        power-domains:
          maxItems: 1

        iommus:
          maxItems: 1

        clocks:
          minItems: 1
          maxItems: 2

      required:
        - compatible
        - reg
        - interrupts
        - power-domains
        - iommus
    else:
      allOf:
        - if:
            properties:
              compatible:
                contains:
                  enum:
                    - apple,t6032-jpeg
            required:
              - compatible
          then:
            properties:
              compatible:
                items:
                  - const: apple,t6032-jpeg
                  - const: apple,jpeg

              reg:
                maxItems: 1

              interrupts:
                maxItems: 1

              power-domains:
                maxItems: 1

              iommus:
                maxItems: 1

              clocks:
                minItems: 2
                maxItems: 2

            required:
              - compatible
              - reg
              - interrupts
              - power-domains
              - iommus
              - clocks
          else:
            properties:
              compatible:
                oneOf:
                  - enum:
                      - apple,t6041-jpeg
                      - apple,t8140-jpeg
                  - items:
                      - enum:
                          - apple,t6000-jpeg
                          - apple,t6020-jpeg
                          - apple,t6021-jpeg
                          - apple,t6022-jpeg
                          - apple,t6030-jpeg
                          - apple,t6031-jpeg
                          - apple,t8103-jpeg
                          - apple,t8112-jpeg
                          - apple,t8122-jpeg
                      - const: apple,jpeg

              reg:
                maxItems: 1

              interrupts:
                maxItems: 1

              iommus:
                maxItems: 1

              clocks:
                minItems: 1
                maxItems: 2

              power-domains:
                minItems: 1
                items:
                  - description: The engine's power domain
                  - description: Performance request held while the engine works

              power-domain-names:
                minItems: 1
                items:
                  - const: core
                  - const: perf

              apple,dma-range:
                $ref: /schemas/types.yaml#/definitions/uint64-array
                items:
                  - const: 0x10000000000
                  - const: 0x100000000
                description: Device-visible DMA window, as a 64-bit base and size.
                  Only for engines with 32-bit buffer pointers.

            required:
              - compatible
              - reg
              - interrupts
              - iommus
              - power-domains

            allOf:
              - if:
                  properties:
                    compatible:
                      const: apple,t6041-jpeg
                then:
                  required:
                    - apple,dma-range
                else:
                  properties:
                    apple,dma-range: false
              - if:
                  properties:
                    compatible:
                      contains:
                        enum:
                          - apple,t6030-jpeg
                          - apple,t6031-jpeg
                          - apple,t8122-jpeg
                then:
                  properties:
                    power-domains:
                      maxItems: 1

            additionalProperties: false

unevaluatedProperties: false

examples:
  - |
    #include <dt-bindings/interrupt-controller/apple-aic.h>
    #include <dt-bindings/interrupt-controller/irq.h>

    soc {
        #address-cells = <2>;
        #size-cells = <2>;

        jpeg@487000000 {
            compatible = "apple,t6041-jpeg";
            reg = <0x4 0x87000000 0x0 0x4000>;
            interrupt-parent = <&aic>;
            interrupts = <AIC_IRQ 1538 IRQ_TYPE_LEVEL_HIGH>;
            iommus = <&jpeg0_dart 0>;
            power-domains = <&ps_jpg>;
            apple,dma-range = /bits/ 64 <0x10000000000 0x100000000>;
            status = "disabled";
        };
    };
```

## Documentation/devicetree/bindings/media/apple,m2-ave.yaml
```yaml
# SPDX-License-Identifier: (GPL-2.0-only OR BSD-2-Clause)
%YAML 1.2
---
$id: http://devicetree.org/schemas/media/apple,m2-ave.yaml#
$schema: http://devicetree.org/meta-schemas/core.yaml#

title: Apple M2 generation video encoder

maintainers:
  - Ryan Murray <81541646+RyanTheTide@users.noreply.github.com>

description: |
  Video encoder resources on M2 generation SoCs. The register apertures
  follow hardware resource order. Firmware configuration and tuning are
  supplied by the bootloader and are not part of this binding. Unqualified
  instances must remain disabled.

select:
  properties:
    compatible:
      contains:
        enum:
          - apple,t6020-ave
          - apple,t6021-ave
          - apple,t6022-ave
  required:
    - compatible

properties:
  compatible:
    items:
      - enum:
          - apple,t6020-ave
          - apple,t6021-ave
          - apple,t6022-ave
      - const: apple,ave

  reg:
    maxItems: 5

  interrupts:
    maxItems: 5

  iommus:
    maxItems: 4

  power-domains:
    minItems: 6
    maxItems: 7

required:
  - compatible
  - reg
  - interrupts
  - iommus
  - power-domains

additionalProperties: false
```

## Documentation/devicetree/bindings/media/apple,m2-jpeg.yaml
```yaml
# SPDX-License-Identifier: (GPL-2.0-only OR BSD-2-Clause)
%YAML 1.2
---
$id: http://devicetree.org/schemas/media/apple,m2-jpeg.yaml#
$schema: http://devicetree.org/meta-schemas/core.yaml#

title: Apple M2 generation JPEG codec

maintainers:
  - Ryan Murray <81541646+RyanTheTide@users.noreply.github.com>

description: |
  JPEG codec resources on M2 generation SoCs. The register apertures
  follow hardware resource order. Firmware configuration and tuning are
  supplied by the bootloader and are not part of this binding. Unqualified
  instances must remain disabled.

select:
  properties:
    compatible:
      contains:
        enum:
          - apple,t6020-jpeg
          - apple,t6021-jpeg
          - apple,t6022-jpeg
          - apple,t8112-jpeg
  required:
    - compatible

properties:
  compatible:
    items:
      - enum:
          - apple,t6020-jpeg
          - apple,t6021-jpeg
          - apple,t6022-jpeg
          - apple,t8112-jpeg
      - const: apple,jpeg

  reg:
    maxItems: 1

  interrupts:
    maxItems: 1

  iommus:
    maxItems: 1

  power-domains:
    maxItems: 1

required:
  - compatible
  - reg
  - interrupts
  - iommus
  - power-domains

additionalProperties: false
```
