## Documentation/devicetree/bindings/iommu/apple,t6032-dart-smmu.yaml
```yaml
# SPDX-License-Identifier: (GPL-2.0-only OR BSD-2-Clause)
%YAML 1.2
---
$id: http://devicetree.org/schemas/iommu/apple,t6032-dart-smmu.yaml#
$schema: http://devicetree.org/meta-schemas/core.yaml#

title: Apple T6032 system MMU companion

maintainers:
  - Ryan Murray <81541646+RyanTheTide@users.noreply.github.com>

description: |
  Hardware resources of the T6032 system MMU companion. The package contains two
  peripheral dies. Register banks follow hardware resource order. The block
  remains disabled until its ownership and lifecycle are supported; firmware
  data and tuning are supplied separately by the boot firmware.

select:
  properties:
    compatible:
      contains:
        const: apple,t6032-dart-smmu
  required:
    - compatible

properties:
  compatible:
    items:
      - const: apple,t6032-dart-smmu
      - const: apple,dart-smmu

  reg:
    minItems: 1
    maxItems: 1

required:
  - compatible
  - reg

additionalProperties: false
```

## Documentation/devicetree/bindings/leds/backlight/apple,m3-dwi.yaml
```yaml
# SPDX-License-Identifier: (GPL-2.0-only OR BSD-2-Clause)
%YAML 1.2
---
$id: http://devicetree.org/schemas/leds/backlight/apple,m3-dwi.yaml#
$schema: http://devicetree.org/meta-schemas/core.yaml#

title: Apple M3 family two-wire display interface

maintainers:
  - Ryan Murray <81541646+RyanTheTide@users.noreply.github.com>

description: |
  Hardware resources of the M3 family two-wire display interface.
  The interface is described for discovery and must remain disabled until
  its ownership, initialization and shutdown are supported. Register windows
  are listed in hardware resource order; firmware configuration and tuning
  data are supplied by the boot firmware rather than this binding.

select:
  properties:
    compatible:
      contains:
        enum:
          - apple,t8122-dwi
          - apple,t6030-dwi
          - apple,t6031-dwi
  required:
    - compatible

properties:
  compatible:
    items:
      - enum:
          - apple,t8122-dwi
          - apple,t6030-dwi
          - apple,t6031-dwi
      - const: apple,dwi

  reg:
    minItems: 1
    maxItems: 1

  interrupts:
    minItems: 1
    maxItems: 1

  power-domains:
    minItems: 1
    maxItems: 1

required:
  - compatible
  - reg
  - interrupts
  - power-domains

additionalProperties: false
```

## Documentation/devicetree/bindings/mailbox/apple,ascwrap-v6.yaml
```yaml
# SPDX-License-Identifier: (GPL-2.0-only OR BSD-2-Clause)
%YAML 1.2
---
$id: http://devicetree.org/schemas/mailbox/apple,ascwrap-v6.yaml#
$schema: http://devicetree.org/meta-schemas/core.yaml#

title: Apple T8140 ASCWrap v6 mailbox

maintainers:
  - Ryan Murray <ryan@aurorasilicon.org>

description:
  Mailbox interface of the T8140 GPU coprocessors. The wrapper resource
  contains the coprocessor control registers and mailbox FIFOs. A separate
  resource provides the coprocessor vector-base register. The firmware role
  identifies which of the two GPU firmware instances uses the mailbox.

properties:
  compatible:
    const: apple,t8140-ascwrap-v6

  reg:
    items:
      - description: ASC wrapper registers
      - description: Coprocessor vector-base register

  reg-names:
    items:
      - const: wrapper
      - const: iop-vbar

  interrupts:
    items:
      - description: Send FIFO empty interrupt
      - description: Receive FIFO not-empty interrupt

  interrupt-names:
    items:
      - const: send-empty
      - const: recv-not-empty

  '#mbox-cells':
    const: 0

  power-domains:
    maxItems: 1

  apple,firmware-role:
    enum: [GFX, GFX1]

required:
  - compatible
  - reg
  - reg-names
  - interrupts
  - interrupt-names
  - '#mbox-cells'
  - apple,firmware-role

additionalProperties: false

examples:
  - |
    #include <dt-bindings/interrupt-controller/apple-aic.h>
    #include <dt-bindings/interrupt-controller/irq.h>

    soc {
        #address-cells = <2>;
        #size-cells = <2>;

        mailbox@482600000 {
            compatible = "apple,t8140-ascwrap-v6";
            reg = <0x4 0x82600000 0x0 0x88000>,
                  <0x4 0x82050000 0x0 0x8>;
            reg-names = "wrapper", "iop-vbar";
            interrupts = <AIC_IRQ 993 IRQ_TYPE_LEVEL_HIGH>,
                         <AIC_IRQ 996 IRQ_TYPE_LEVEL_HIGH>;
            interrupt-names = "send-empty", "recv-not-empty";
            apple,firmware-role = "GFX";
            #mbox-cells = <0>;
        };
    };
```

## Documentation/devicetree/bindings/mailbox/apple,mailbox.yaml
```yaml
# SPDX-License-Identifier: GPL-2.0 OR BSD-2-Clause
%YAML 1.2
---
$id: http://devicetree.org/schemas/mailbox/apple,mailbox.yaml#
$schema: http://devicetree.org/meta-schemas/core.yaml#

title: Apple Mailbox Controller

maintainers:
  - Hector Martin <marcan@marcan.st>
  - Sven Peter <sven@svenpeter.dev>

description:
  The Apple mailbox consists of two FIFOs used to exchange 64+32 bit
  messages between the main CPU and a co-processor. Multiple instances
  of this mailbox can be found on Apple SoCs.
  One of the two FIFOs is used to send data to a co-processor while the other
  FIFO is used for the other direction.
  Various clients implement different IPC protocols based on these simple
  messages and shared memory buffers.

properties:
  compatible:
    oneOf:
      - description:
          ASC mailboxes are the most common variant found on the M1 used
          for example for the display controller, the system management
          controller and the NVMe coprocessor.
        items:
          - enum:
              - apple,t8103-asc-mailbox
              - apple,t8112-asc-mailbox
              - apple,t8122-asc-mailbox
              - apple,t8140-asc-mailbox
              - apple,t6000-asc-mailbox
              - apple,t6020-asc-mailbox
          - const: apple,asc-mailbox-v4

      - description:
          AOP setup-port mailbox with a separate register layout.
        const: apple,t8140-aop-setup-mailbox

      - description:
          An older ASC mailbox interface found on T2 and A11 that is also
          used for the NVMe coprocessor and the system management
          controller.
        items:
          - const: apple,t8015-asc-mailbox

      - description:
          M3 mailboxes are an older variant with a slightly different MMIO
          interface still found on the M1. It is used for the Thunderbolt
          co-processors.
        items:
          - enum:
              - apple,t8103-m3-mailbox
              - apple,t8112-m3-mailbox
              - apple,t6000-m3-mailbox
          - const: apple,m3-mailbox-v2

  reg:
    maxItems: 1

  interrupts:
    minItems: 2
    maxItems: 4

  interrupt-names:
    minItems: 2
    maxItems: 4

  iommus:
    maxItems: 1

  apple,dma-range:
    $ref: /schemas/types.yaml#/definitions/uint64-array
    minItems: 2
    maxItems: 2
    description:
      Setup-port DMA allocation window, expressed as a base and nonzero size.
      This identifies host-available slots in the inherited AOP stream root.

  "#mbox-cells":
    const: 0

  power-domains:
    maxItems: 1

allOf:
  - if:
      properties:
        compatible:
          contains:
            const: apple,t8140-aop-setup-mailbox
    then:
      properties:
        interrupts:
          maxItems: 2
        interrupt-names:
          items:
            - const: send-empty
            - const: recv-not-empty
      required:
        - iommus
        - apple,dma-range
    else:
      properties:
        interrupts:
          minItems: 4
        interrupt-names:
          items:
            - const: send-empty
            - const: send-not-empty
            - const: recv-empty
            - const: recv-not-empty
        iommus: false
        apple,dma-range: false

required:
  - compatible
  - reg
  - interrupts
  - interrupt-names
  - "#mbox-cells"

additionalProperties: false

examples:
  - |
    mailbox@77408000 {
        compatible = "apple,t8103-asc-mailbox", "apple,asc-mailbox-v4";
        reg = <0x77408000 0x4000>;
        interrupts = <1 583 4>, <1 584 4>, <1 585 4>, <1 586 4>;
        interrupt-names = "send-empty", "send-not-empty",
                          "recv-empty", "recv-not-empty";
        #mbox-cells = <0>;
    };
```

## Documentation/devicetree/bindings/mailbox/apple,secure-mailbox.yaml
```yaml
# SPDX-License-Identifier: (GPL-2.0-only OR BSD-2-Clause)
%YAML 1.2
---
$id: http://devicetree.org/schemas/mailbox/apple,secure-mailbox.yaml#
$schema: http://devicetree.org/meta-schemas/core.yaml#

title: Apple secure coprocessor mailbox aperture

maintainers:
  - Ryan Murray <81541646+RyanTheTide@users.noreply.github.com>

description: |
  Secure coprocessor proxy mailbox aperture and its transport interrupts.
  This description does not authorize access to secure-world registers.

properties:
  compatible:
    oneOf:
      - items:
          - const: apple,t8152-secure-mailbox
          - const: apple,secure-mailbox
      - items:
          - enum:
              - apple,t6050-secure-mailbox
              - apple,t8142-secure-mailbox
          - const: apple,secure-mailbox
      - items:
          - const: apple,t8140-secure-mailbox
          - const: apple,secure-mailbox

  reg:
    maxItems: 1
    description: Register apertures in hardware-description order.

  interrupts:
    minItems: 2
    maxItems: 3

  iommus:
    maxItems: 1

required:
  - compatible
  - reg
  - interrupts
  - iommus

allOf:
  - if:
      properties:
        compatible:
          contains:
            const: apple,t8152-secure-mailbox
    then:
      properties:
        interrupts:
          minItems: 3
          maxItems: 3
    else:
      properties:
        interrupts:
          maxItems: 2

additionalProperties: false
```
