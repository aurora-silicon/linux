## Documentation/devicetree/bindings/media/apple,m2-prores.yaml
```yaml
# SPDX-License-Identifier: (GPL-2.0-only OR BSD-2-Clause)
%YAML 1.2
---
$id: http://devicetree.org/schemas/media/apple,m2-prores.yaml#
$schema: http://devicetree.org/meta-schemas/core.yaml#

title: Apple M2 generation ProRes codec

maintainers:
  - Ryan Murray <81541646+RyanTheTide@users.noreply.github.com>

description: |
  ProRes codec resources on M2 generation SoCs. The register apertures
  follow hardware resource order. Firmware configuration and tuning are
  supplied by the bootloader and are not part of this binding. Unqualified
  instances must remain disabled.

select:
  properties:
    compatible:
      contains:
        enum:
          - apple,t6020-prores
          - apple,t6021-prores
          - apple,t6022-prores
          - apple,t8112-prores
  required:
    - compatible

properties:
  compatible:
    items:
      - enum:
          - apple,t6020-prores
          - apple,t6021-prores
          - apple,t6022-prores
          - apple,t8112-prores
      - const: apple,prores

  reg:
    maxItems: 2

  interrupts:
    minItems: 1
    maxItems: 2

  iommus:
    minItems: 1
    maxItems: 2

  power-domains:
    minItems: 1
    maxItems: 2

required:
  - compatible
  - reg
  - interrupts
  - iommus
  - power-domains

additionalProperties: false
```

## Documentation/devicetree/bindings/media/apple,m2-scaler.yaml
```yaml
# SPDX-License-Identifier: (GPL-2.0-only OR BSD-2-Clause)
%YAML 1.2
---
$id: http://devicetree.org/schemas/media/apple,m2-scaler.yaml#
$schema: http://devicetree.org/meta-schemas/core.yaml#

title: Apple M2 generation image scaler

maintainers:
  - Ryan Murray <81541646+RyanTheTide@users.noreply.github.com>

description: |
  Image scaler resources on M2 generation SoCs. The register apertures
  follow hardware resource order. Firmware configuration and tuning are
  supplied by the bootloader and are not part of this binding. Unqualified
  instances must remain disabled.

select:
  properties:
    compatible:
      contains:
        enum:
          - apple,t6020-scaler
          - apple,t6021-scaler
          - apple,t6022-scaler
          - apple,t8112-scaler
  required:
    - compatible

properties:
  compatible:
    items:
      - enum:
          - apple,t6020-scaler
          - apple,t6021-scaler
          - apple,t6022-scaler
          - apple,t8112-scaler
      - const: apple,scaler

  reg:
    maxItems: 3

  interrupts:
    maxItems: 2

  iommus:
    maxItems: 2

  power-domains:
    minItems: 2
    maxItems: 3

required:
  - compatible
  - reg
  - interrupts
  - iommus
  - power-domains

additionalProperties: false
```

## Documentation/devicetree/bindings/media/apple,m3-ave.yaml
```yaml
# SPDX-License-Identifier: (GPL-2.0-only OR BSD-2-Clause)
%YAML 1.2
---
$id: http://devicetree.org/schemas/media/apple,m3-ave.yaml#
$schema: http://devicetree.org/meta-schemas/core.yaml#

title: Apple M3 family video encoder

maintainers:
  - Ryan Murray <81541646+RyanTheTide@users.noreply.github.com>

description: |
  Hardware resources of the M3 family video encoder.
  The interface is described for discovery and must remain disabled until
  its ownership, initialization and shutdown are supported. Register windows
  are listed in hardware resource order; firmware configuration and tuning
  data are supplied by the boot firmware rather than this binding.

select:
  properties:
    compatible:
      contains:
        enum:
          - apple,t8122-ave
          - apple,t6030-ave
          - apple,t6031-ave
  required:
    - compatible

properties:
  compatible:
    items:
      - enum:
          - apple,t8122-ave
          - apple,t6030-ave
          - apple,t6031-ave
      - const: apple,ave

  reg:
    minItems: 5
    maxItems: 5

  interrupts:
    minItems: 5
    maxItems: 5

  power-domains:
    minItems: 1
    maxItems: 6

  iommus:
    minItems: 1
    maxItems: 2

required:
  - compatible
  - reg
  - interrupts
  - power-domains
  - iommus

additionalProperties: false
```

## Documentation/devicetree/bindings/media/apple,m3-jpeg.yaml
```yaml
# SPDX-License-Identifier: (GPL-2.0-only OR BSD-2-Clause)
%YAML 1.2
---
$id: http://devicetree.org/schemas/media/apple,m3-jpeg.yaml#
$schema: http://devicetree.org/meta-schemas/core.yaml#

title: Apple M3 family JPEG codec

maintainers:
  - Ryan Murray <81541646+RyanTheTide@users.noreply.github.com>

description: |
  Hardware resources of the M3 family JPEG codec.
  The interface is described for discovery and must remain disabled until
  its ownership, initialization and shutdown are supported. Register windows
  are listed in hardware resource order; firmware configuration and tuning
  data are supplied by the boot firmware rather than this binding.

select:
  properties:
    compatible:
      contains:
        enum:
          - apple,t8122-jpeg
          - apple,t6030-jpeg
          - apple,t6031-jpeg
  required:
    - compatible

properties:
  compatible:
    items:
      - enum:
          - apple,t8122-jpeg
          - apple,t6030-jpeg
          - apple,t6031-jpeg
      - const: apple,jpeg

  reg:
    minItems: 1
    maxItems: 1

  interrupts:
    minItems: 1
    maxItems: 1

  power-domains:
    minItems: 1
    maxItems: 1

  iommus:
    minItems: 1
    maxItems: 1

required:
  - compatible
  - reg
  - interrupts
  - power-domains
  - iommus

additionalProperties: false
```

## Documentation/devicetree/bindings/media/apple,m3-prores.yaml
```yaml
# SPDX-License-Identifier: (GPL-2.0-only OR BSD-2-Clause)
%YAML 1.2
---
$id: http://devicetree.org/schemas/media/apple,m3-prores.yaml#
$schema: http://devicetree.org/meta-schemas/core.yaml#

title: Apple M3 family ProRes codec

maintainers:
  - Ryan Murray <81541646+RyanTheTide@users.noreply.github.com>

description: |
  Hardware resources of the M3 family ProRes codec.
  The interface is described for discovery and must remain disabled until
  its ownership, initialization and shutdown are supported. Register windows
  are listed in hardware resource order; firmware configuration and tuning
  data are supplied by the boot firmware rather than this binding.

select:
  properties:
    compatible:
      contains:
        enum:
          - apple,t8122-prores
          - apple,t6030-prores
          - apple,t6031-prores
  required:
    - compatible

properties:
  compatible:
    items:
      - enum:
          - apple,t8122-prores
          - apple,t6030-prores
          - apple,t6031-prores
      - const: apple,prores

  reg:
    minItems: 2
    maxItems: 3

  interrupts:
    minItems: 1
    maxItems: 2

  power-domains:
    minItems: 1
    maxItems: 1

  iommus:
    minItems: 1
    maxItems: 2

required:
  - compatible
  - reg
  - interrupts
  - power-domains
  - iommus

additionalProperties: false
```

## Documentation/devicetree/bindings/media/apple,prores.yaml
```yaml
# SPDX-License-Identifier: (GPL-2.0-only OR BSD-2-Clause)
%YAML 1.2
---
$id: http://devicetree.org/schemas/media/apple,prores.yaml#
$schema: http://devicetree.org/meta-schemas/core.yaml#

title: Apple Silicon ProRes codec (APR)

maintainers:
  - Ryan Murray <ryan@aurorasilicon.org>

description: |
  The APR is a directly programmed ProRes engine with its own DART. Jobs are
  descriptors in a DMA ring; the engine signals completion with an
  interrupt. On T6041 an optional per-machine initialization table,
  apple/prores-t6041-init.bin, replaces the driver's built-in one. Other
  supported variants have no firmware.
  The engine's power domain also resets it.

select:
  properties:
    compatible:
      contains:
        enum:
          - apple,t6000-prores
          - apple,t6020-prores
          - apple,t6021-prores
          - apple,t6022-prores
          - apple,t6030-prores
          - apple,t6031-prores
          - apple,t6032-prores
          - apple,t6041-prores
          - apple,t8112-prores
          - apple,t8122-prores
          - apple,t8132-prores
          - apple,t6050-prores
          - apple,t8140-prores
  required:
    - compatible

properties:
  compatible: true

allOf:
  - if:
      properties:
        compatible:
          contains:
            const: apple,t8132-prores
    then:
      properties:
        reg:
          minItems: 3
          maxItems: 3
  - if:
      properties:
        compatible:
          contains:
            enum:
              - apple,t8132-prores
              - apple,t6050-prores
      required:
        - compatible
    then:
      properties:
        compatible:
          items:
            - enum:
                - apple,t8132-prores
                - apple,t6050-prores
            - const: apple,prores

        reg:
          minItems: 2
          maxItems: 5
          description:
            Three windows on T8132. On T6050 the ADT lists two for the first
            ProRes instance and five for the second.

        interrupts:
          minItems: 2
          maxItems: 2

        power-domains:
          maxItems: 1

        iommus:
          maxItems: 1

      required:
        - compatible
        - reg
        - interrupts
        - power-domains
        - iommus
    else:
      allOf:
        - if:
            properties:
              compatible:
                contains:
                  enum:
                    - apple,t6032-prores
            required:
              - compatible
          then:
            properties:
              compatible:
                items:
                  - const: apple,t6032-prores
                  - const: apple,prores

              reg:
                minItems: 2
                maxItems: 3

              interrupts:
                maxItems: 1

              power-domains:
                maxItems: 1

              iommus:
                minItems: 1
                maxItems: 2

            required:
              - compatible
              - reg
              - interrupts
              - power-domains
              - iommus
          else:
            properties:
              compatible:
                oneOf:
                  - const: apple,t8140-prores
                  - items:
                      - enum:
                          - apple,t6000-prores
                          - apple,t6020-prores
                          - apple,t6021-prores
                          - apple,t6022-prores
                          - apple,t6030-prores
                          - apple,t6031-prores
                          - apple,t6041-prores
                          - apple,t8112-prores
                          - apple,t8122-prores
                      - const: apple,prores

              reg:
                minItems: 2
                maxItems: 3
                description: Engine, wrapper and generation-specific auxiliary register windows.

              reg-names:
                minItems: 2
                items:
                  - const: core
                  - const: wrapper
                  - const: aux

              interrupts:
                minItems: 1
                maxItems: 2

              iommus:
                minItems: 1
                maxItems: 2

              power-domains:
                minItems: 1
                items:
                  - description: The engine's power domain
                  - description: Performance request held while the engine works

              power-domain-names:
                minItems: 1
                items:
                  - const: core
                  - const: perf

              resets:
                maxItems: 1

            required:
              - compatible
              - reg
              - interrupts
              - iommus
              - power-domains

            allOf:
              - if:
                  properties:
                    compatible:
                      contains:
                        enum:
                          - apple,t6030-prores
                          - apple,t6031-prores
                          - apple,t8122-prores
                then:
                  properties:
                    reg:
                      minItems: 2
                      maxItems: 3
                    power-domains:
                      maxItems: 1
              - if:
                  properties:
                    compatible:
                      contains:
                        enum:
                          - apple,t6020-prores
                          - apple,t6021-prores
                          - apple,t6022-prores
                          - apple,t8112-prores
                then:
                  properties:
                    reg:
                      maxItems: 2
                    reg-names:
                      maxItems: 2
              - if:
                  properties:
                    compatible:
                      contains:
                        enum:
                          - apple,t6041-prores
                then:
                  properties:
                    reg:
                      minItems: 3
                      maxItems: 3
                    reg-names:
                      minItems: 3
                      maxItems: 3
                    interrupts:
                      maxItems: 1
                    iommus:
                      maxItems: 1
                  required:
                    - resets
                    - reg-names
              - if:
                  properties:
                    compatible:
                      contains:
                        enum:
                          - apple,t8140-prores
                then:
                  properties:
                    reg:
                      maxItems: 2
                    reg-names:
                      maxItems: 2
                    iommus:
                      maxItems: 1
                  required:
                    - reg-names

            additionalProperties: false

unevaluatedProperties: false

examples:
  - |
    #include <dt-bindings/interrupt-controller/apple-aic.h>
    #include <dt-bindings/interrupt-controller/irq.h>

    soc {
        #address-cells = <2>;
        #size-cells = <2>;

        video-codec@295000000 {
            compatible = "apple,t8140-prores";
            reg = <0x2 0x95000000 0x0 0x4000>,
                  <0x2 0x94000000 0x0 0x8000>;
            reg-names = "core", "wrapper";
            interrupt-parent = <&aic>;
            interrupts = <AIC_IRQ 1260 IRQ_TYPE_LEVEL_HIGH>,
                         <AIC_IRQ 1259 IRQ_TYPE_LEVEL_HIGH>;
            iommus = <&apr_dart 0>;
            power-domains = <&ps_prores>;
            resets = <&ps_prores>;
        };
    };
```
