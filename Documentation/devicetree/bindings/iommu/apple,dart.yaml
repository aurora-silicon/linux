## Documentation/devicetree/bindings/iommu/apple,dart.yaml
```yaml
# SPDX-License-Identifier: (GPL-2.0 OR BSD-2-Clause)
%YAML 1.2
---
$id: http://devicetree.org/schemas/iommu/apple,dart.yaml#
$schema: http://devicetree.org/meta-schemas/core.yaml#

title: Apple DART IOMMU

maintainers:
  - Sven Peter <sven@svenpeter.dev>

description: |+
  Apple SoCs may contain an implementation of their Device Address
  Resolution Table which provides a mandatory layer of address
  translations for various masters.

  Depending on the generation, a DART instance handles up to 256 streams
  with individual pagetables and page-level read/write protection flags.

  This DART IOMMU also raises interrupts in response to various
  fault conditions.

properties:
  compatible:
    oneOf:
      - items:
          - const: apple,t6000-display-dart
          - const: apple,t6000-dart
          - const: apple,t8110-dart
      - enum:
          - apple,t8103-dart
          - apple,t8103-usb4-dart
          - apple,t8110-dart
          - apple,t6000-dart
      - items:
          - const: apple,t8140-ane-dart
          - const: apple,t8140-dart
          - const: apple,t8110-dart
      - items:
          - const: apple,t8142-ane-dart
          - const: apple,t8142-dart
          - const: apple,t8110-dart
      - items:
          - enum:
              - apple,t6000-dart
              - apple,t8112-dart
          - const: apple,t8110-dart
      - items:
          - enum:
              - apple,t6020-dart
              - apple,t6030-dart
              - apple,t6031-dart
              - apple,t6041-dart
              - apple,t6050-dart
              - apple,t6050-isp-dart
              - apple,t8122-dart
              - apple,t8132-dart
              - apple,t8140-dart
              - apple,t8142-dart
              - apple,t8152-dart
          - const: apple,t8110-dart

  apple,managed-sids:
    $ref: /schemas/types.yaml#/definitions/uint32-array
    items:
      - const: 1
      - const: 2
    description: >
      J713 radio ordinary stream ownership profile. Only these inactive
      normal streams and their exact-RID entries may be adopted by the OS.
      Other streams and RID entries remain inherited. The documented static
      SID16 bypass role may be initialized only from a disabled stream with
      no valid root; an existing bypass remains unchanged. PIODMA and other
      reserved roles are not modified. This does not authorize a controller
      reset or takeover of active page tables. Both the radio DART and PCI
      host describe the same two ordinary streams. Error reporting must
      already be unmasked at admission; the OS preserves the inherited global
      error-mask policy rather than changing it for these streams.

  reg:
    minItems: 1
    items:
      - description: DART registers
      - description:
          Address filter (DAPF) registers, which restrict the physical
          addresses the DART lets its masters reach, or the slice of the
          fabric filter (GAPF) that protects the power state of the
          coprocessor CPU behind this DART, cleared to power that CPU down

  reg-names:
    minItems: 1
    items:
      - const: dart
      - enum: [dapf, gapf, auxiliary]

  interrupts:
    maxItems: 1

  clocks:
    description:
      Reference to the gate clock phandle if required for this IOMMU.
      Optional since not all IOMMUs are attached to a clock gate.

  '#iommu-cells':
    enum: [1, 5]
    description:
      One cell describes the stream ID emitted by a master. Five cells
      describe the stream ID followed by the 64-bit base and length of its
      device-visible DMA window.

  nonposted-mmio: true

  power-domains:
    maxItems: 1

  apple,dma-range:
    $ref: /schemas/types.yaml#/definitions/uint64-array
    minItems: 2
    maxItems: 2
    description: >
      Device-visible DMA aperture encoded as a base and a nonzero size. The
      IOMMU DMA allocator restricts mappings to this range; high address bits
      may select a firmware-visible alias of the translation aperture.
      A consumer may further specify its own aperture in its binding.

  apple,dapf-ranges:
    $ref: /schemas/types.yaml#/definitions/uint64-matrix
    items:
      items:
        - description: First address of a range
        - description: Last address of a range
    description:
      The address filter the loader programs into the dapf registers, one
      entry per range. A sleep that reaches the hardware clears it, and the
      DART writes it back before its consumer's firmware starts again.

  apple,dapf-r20:
    $ref: /schemas/types.yaml#/definitions/uint32-array
    description:
      The last word of each filter entry, one per range in apple,dapf-ranges.
      1 where absent.

  apple,restore-on-power-up:
    type: boolean
    description:
      Reset and restore the DART, and write its address filter back, every
      time it powers up, even where its registers still read as they were
      left. For a DART that keeps its values through a sleep in which the
      SoC's sleep engine runs its consumer, but whose address filter only
      takes effect once written again.

  apple,sleep-prepare:
    $ref: /schemas/types.yaml#/definitions/uint32-matrix
    items:
      items:
        - description: Register offset
        - description: Value
    description:
      Register writes before a consumer that gates itself is told about a
      firmware-driven system suspend, after the DART's state is saved. Streams
      they stop are started again at the restore. Needs apple,sleep-restore.

  apple,sleep-restore:
    $ref: /schemas/types.yaml#/definitions/uint32-matrix
    items:
      items:
        - description: Register offset
        - description: Value
    description:
      Register writes after such a suspend, before the translations are put
      back. With this, the consumer saves and restores the DART around the
      suspend, as the order relative to its firmware's start matters.

  apple,sleep-restore-late:
    $ref: /schemas/types.yaml#/definitions/uint32-matrix
    items:
      items:
        - description: Register offset
        - description: Value
    description:
      Register writes after the translations are back and before the streams
      are enabled.

  apple,dma-offset:
    $ref: /schemas/types.yaml#/definitions/uint64
    description: >
      Offset added to device-visible DMA addresses when indexing the DART page
      tables. This models host bridges which alias a low PCI bus aperture into
      a high DART translation window.

  apple,firmware-root-handoff:
    $ref: /schemas/types.yaml#/definitions/uint32
    const: 1
    description: >
      The bootloader has reserved the actual three-level locked root and leaf
      table pages as normal RAM and completed the display coprocessor power
      handoff. Linux retains occupied root slots and excludes their entire
      IOVA spans from allocation. This does not assert immutable descendants.

  apple,clock-protection:
    $ref: /schemas/types.yaml#/definitions/phandle-array
    items:
      - items:
          - description: PS_PROT (clock protection) register bank
          - description: Index of this DART's slice in the bank
    description: >
      The clock protection slice that guards a power state register of the
      power domain of this DART. Its consumer may power that domain down: the
      DART's streams are then disabled and flushed, and the slice disabled,
      before the domain powers off, and the slice is enabled again when it
      powers up. On the J713 the internal display DARTs use it for their DCP's
      power-down, and the ACIO, tunneled PCIe and external display DARTs for a
      deep sleep, in which their hosts save and restore them.

  apple,manual-availability:
    type: boolean
    description: >
      The DART's registers answer only once its client, a PCIe root complex,
      is up. The client's driver makes the DART available after bringing the
      root complex up, and the DART probes then. The root complex lists the DART
      in its post-init-providers property as well as in iommu-map: otherwise
      fw_devlink.strict=1 makes the root complex wait for a DART that waits for
      it.

  apple,tunable:
    $ref: /schemas/types.yaml#/definitions/uint32-matrix
    items:
      items:
        - description: Register offset
        - description: Mask to be applied to the register value
        - description: Bits to be set after applying the mask
    description: >
      List of (register offset, mask, value) tuples copied from Apple's Device
      Tree by the bootloader and required to initialize dynamically powered
      DART instances.

  apple,resume-tunable:
    $ref: /schemas/types.yaml#/definitions/uint32-matrix
    items:
      items:
        - description: Register offset
        - description: Mask to be applied to the register value
        - description: Bits to be set after applying the mask
    description: >
      The same tuples for a DART whose bootloader has already applied them,
      written back where a power-off lost them, before its consumer's
      firmware starts again.

  apple,bypass-sids:
    $ref: /schemas/types.yaml#/definitions/uint32-array
    minItems: 1
    maxItems: 8
    items:
      maximum: 255
    description:
      Streams set to bypass after every reset of the DART, outside any domain.
      On a USB4 PCIe tunnel DART, the reserved streams its PCIe-C port issues
      its own writes on, such as the interrupt controller writes its MSIs
      turn into. On a T8110 DART that nothing initialises before Linux, such
      as a USB4 router's, the streams its co-processor uses without
      translation.

  apple,full-error-reporting:
    type: boolean
    description:
      Unmask every error and enable the error interrupt for every stream,
      with the registers of the DART's revision, and leave the DART unlocked
      on error. For a T8110 DART that nothing initialises before Linux.

  apple,ctc-flush:
    type: boolean
    description:
      Flush the DART's context cache after a stream flush, where the DART
      has one. For a T8110 DART that nothing initialises before Linux.

  apple,remap-streams:
    $ref: /schemas/types.yaml#/definitions/uint32-matrix
    minItems: 1
    maxItems: 256
    items:
      items:
        - description: Source stream ID, unique within this list.
          maximum: 255
        - description: Destination stream ID, which must not itself be remapped.
          maximum: 15
    description:
      T8110 stream remaps. A source uses the destination stream's translation
      and filtering state without a separate page-table root. Source and
      destination must differ, and both must exist on the controller.

required:
  - compatible
  - reg
  - '#iommu-cells'
  - interrupts

allOf:
  - if:
      properties:
        compatible:
          contains:
            const: apple,t6000-display-dart
    then:
      properties:
        reg:
          minItems: 2
      required:
        - reg-names
  - if:
      properties:
        reg:
          minItems: 2
      required:
        - reg
    then:
      required:
        - reg-names

additionalProperties: false

examples:
  - |+
    dart1: iommu@82f80000 {
      compatible = "apple,t8103-dart";
      reg = <0x82f80000 0x4000>;
      interrupts = <1 781 4>;
      #iommu-cells = <1>;
    };

    master1 {
      iommus = <&dart1 0>;
    };

  - |+
    dart2a: iommu@82f00000 {
      compatible = "apple,t8103-dart";
      reg = <0x82f00000 0x4000>;
      interrupts = <1 781 4>;
      #iommu-cells = <1>;
    };
    dart2b: iommu@82f80000 {
      compatible = "apple,t8103-dart";
      reg = <0x82f80000 0x4000>;
      interrupts = <1 781 4>;
      #iommu-cells = <1>;
    };

    master2 {
      iommus = <&dart2a 0>, <&dart2b 1>;
    };

  - |+
    dart3: iommu@8e8c0000 {
      compatible = "apple,t8132-dart", "apple,t8110-dart";
      reg = <0x8e8c0000 0xc000>, <0x8e8d0000 0x4000>;
      reg-names = "dart", "dapf";
      interrupts = <1 387 4>;
      #iommu-cells = <1>;
    };
```

## Documentation/devicetree/bindings/iommu/apple,gapf.yaml
```yaml
# SPDX-License-Identifier: (GPL-2.0-only OR BSD-2-Clause)
%YAML 1.2
---
$id: http://devicetree.org/schemas/iommu/apple,gapf.yaml#
$schema: http://devicetree.org/meta-schemas/core.yaml#

title: Apple M4 base SoC global address protection filter

maintainers:
  - Ryan Murray <81541646+RyanTheTide@users.noreply.github.com>

description: |
  Hardware resources of the M4 base SoC global address protection filter.
  The interface is described for discovery and must remain disabled until
  its ownership, initialization and shutdown are supported. Register windows
  are listed in hardware resource order; firmware configuration and tuning
  data are supplied by the boot firmware rather than this binding.

select:
  properties:
    compatible:
      contains:
        enum:
          - apple,t8132-gapf
  required:
    - compatible

properties:
  compatible:
    items:
      - enum:
          - apple,t8132-gapf
      - const: apple,gapf

  reg:
    maxItems: 1

required:
  - compatible
  - reg

additionalProperties: false
```

## Documentation/devicetree/bindings/iommu/apple,m3-dapf.yaml
```yaml
# SPDX-License-Identifier: (GPL-2.0-only OR BSD-2-Clause)
%YAML 1.2
---
$id: http://devicetree.org/schemas/iommu/apple,m3-dapf.yaml#
$schema: http://devicetree.org/meta-schemas/core.yaml#

title: Apple M3 family DMA address protection filter

maintainers:
  - Ryan Murray <81541646+RyanTheTide@users.noreply.github.com>

description: |
  Hardware resources of the M3 family DMA address protection filter.
  The interface is described for discovery and must remain disabled until
  its ownership, initialization and shutdown are supported. Register windows
  are listed in hardware resource order; firmware configuration and tuning
  data are supplied by the boot firmware rather than this binding.

select:
  properties:
    compatible:
      contains:
        enum:
          - apple,t8122-dapf
          - apple,t6030-dapf
          - apple,t6031-dapf
  required:
    - compatible

properties:
  compatible:
    items:
      - enum:
          - apple,t8122-dapf
          - apple,t6030-dapf
          - apple,t6031-dapf
      - const: apple,dapf

  reg:
    minItems: 1
    maxItems: 1

required:
  - compatible
  - reg

additionalProperties: false
```

## Documentation/devicetree/bindings/iommu/apple,t6032-dapf.yaml
```yaml
# SPDX-License-Identifier: (GPL-2.0-only OR BSD-2-Clause)
%YAML 1.2
---
$id: http://devicetree.org/schemas/iommu/apple,t6032-dapf.yaml#
$schema: http://devicetree.org/meta-schemas/core.yaml#

title: Apple T6032 DMA address protection filter

maintainers:
  - Ryan Murray <81541646+RyanTheTide@users.noreply.github.com>

description: |
  Hardware resources of the T6032 DMA address protection filter. The package contains two
  peripheral dies. Register banks follow hardware resource order. The block
  remains disabled until its ownership and lifecycle are supported; firmware
  data and tuning are supplied separately by the boot firmware.

select:
  properties:
    compatible:
      contains:
        const: apple,t6032-dapf
  required:
    - compatible

properties:
  compatible:
    items:
      - const: apple,t6032-dapf
      - const: apple,dapf

  reg:
    minItems: 1
    maxItems: 1

required:
  - compatible
  - reg

additionalProperties: false
```
