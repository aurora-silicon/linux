## Documentation/devicetree/bindings/media/apple,avd.yaml
```yaml
# SPDX-License-Identifier: GPL-2.0-only OR BSD-2-Clause
%YAML 1.2
---
$id: http://devicetree.org/schemas/media/apple,avd.yaml#

$schema: http://devicetree.org/meta-schemas/core.yaml#

title: Apple AVD (Apple Video Decoder)

maintainers:
  - Sofus <sofus.c@icloud.com>

description:
  AVD is a video decode block present on all apple silicon devices.

select:
  anyOf:
    -
      properties:
        compatible:
          contains:
            enum:
              - apple,t6000-avd
              - apple,t6020-avd
              - apple,t6030-avd
              - apple,t6031-avd
              - apple,t6041-avd
              - apple,t6041-max-avd
              - apple,t8103-avd
              - apple,t8112-avd
              - apple,t8122-avd
              - apple,t8132-avd
              - apple,t8140-avd
              - apple,t8142-avd
      required:
        - compatible
    -
      properties:
        compatible:
          allOf:
            -
              contains:
                enum:
                  - apple,t8142-avd
                  - apple,t8152-avd
                  - apple,t6050-avd
            -
              contains:
                const: apple,avd
      required:
        - compatible
properties:
  compatible: true

  reg: true

  reg-names: true

  iommus: true

  power-domains: true

  power-domain-names: true

  resets: true

  interrupts: true

# The root declares the union of property types for DTB decoding. The
# conditional variants below each retain their closed property contract.
additionalProperties: true

allOf:
  -
    if:
      anyOf:
        -
          properties:
            compatible:
              allOf:
                -
                  contains:
                    enum:
                      - apple,t8142-avd
                      - apple,t8152-avd
                      - apple,t6050-avd
                -
                  contains:
                    const: apple,avd
            status:
              const: disabled
          required:
            - compatible
            - status
          not:
            required:
              - mboxes
    then:
      oneOf:
        -
          type: object
          description: |
            Apple video decoding accelerator complex. Initial resource description for an unsupported
            firmware/backend layout. Register, IRQ and DMA topology can be recorded before a driver
            exists. This form must stay disabled; it does not substitute for the enabled driver contract
            or supply firmware, calibration, programming sequences or unresolved providers.
          properties:
            compatible:
              items:
                -
                  enum:
                    - apple,t8142-avd
                    - apple,t8152-avd
                    - apple,t6050-avd
                -
                  const: apple,avd
            status:
              const: disabled
            reg:
              description: |
                Register apertures of the complete hardware complex, in hardware interface order.
              minItems: 2
              maxItems: 3
            interrupts:
              description: Interrupt lines wired to the system interrupt controller.
              minItems: 2
              maxItems: 2
            iommus:
              description: DMA translation streams emitted by this hardware.
              minItems: 3
              maxItems: 3
          required:
            - compatible
            - reg
            - status
          additionalProperties: false
    else:
      $ref: "#/$defs/legacy-driver"

$defs:
  legacy-driver:
    type: object
    properties:
      compatible:
        oneOf:
          - items:
              - enum:
                  - apple,t6030-avd
                  - apple,t6031-avd
              - const: apple,t8122-avd
          - items:
              - const: apple,t6041-max-avd
              - const: apple,t6041-avd
              - const: apple,t8132-avd
          - items:
              - const: apple,t6041-avd
              - const: apple,t8132-avd
          - enum:
              - apple,t8103-avd
              - apple,t6000-avd
              - apple,t8112-avd
              - apple,t6020-avd
              - apple,t8122-avd
              - apple,t8132-avd
              - apple,t8140-avd
              - apple,t8142-avd

      reg:
        items:
          - description: cm3 code
          - description: cm3 sram
          - description: mbox registers
          - description: decode ctrl registers

      reg-names:
        items:
          - const: code
          - const: sram
          - const: mbox
          - const: ctrl

      iommus:
        minItems: 1
        maxItems: 3

      power-domains:
        minItems: 1
        items:
          - description: decoder power state
          - description: performance floor (PMC rail or PMP device level) held while decoding

      power-domain-names:
        minItems: 1
        items:
          - const: core
          - const: perf

      resets:
        maxItems: 1

      interrupts:
        minItems: 2
        items:
          - description: mailbox 0
          - description: mailbox 1
          - description: mailbox 2
          - description: mailbox 3
          - description: flag 0
          - description: flag 1
    required:
      - compatible
      - reg
      - interrupts
      - reg-names
      - iommus
      - power-domains
      - resets
    additionalProperties: false

examples:
  - |
    #include <dt-bindings/interrupt-controller/apple-aic.h>
    #include <dt-bindings/interrupt-controller/irq.h>

    soc {
        #address-cells = <2>;
        #size-cells = <2>;

        avd: avd@288000000 {
            compatible = "apple,t8122-avd";
            interrupt-parent = <&aic>;
            interrupts = <AIC_IRQ 679 IRQ_TYPE_LEVEL_HIGH>,
                         <AIC_IRQ 680 IRQ_TYPE_LEVEL_HIGH>;
            power-domains = <&ps_avd_sys>;
            resets = <&ps_avd_sys>;
            reg = <0x2 0x89080000 0x0 0x12000>,
                  <0x2 0x89092000 0x0 0x12000>,
                  <0x2 0x890a4000 0x0 0x4000>,
                  <0x2 0x89100000 0x0 0x10000>;
            reg-names = "code", "sram", "mbox", "ctrl";
            iommus = <&avd_dart 0>;
        };
    };
```

## Documentation/devicetree/bindings/media/apple,isp-profile.yaml
```yaml
# SPDX-License-Identifier: (GPL-2.0-only OR BSD-2-Clause)
%YAML 1.2
---
$id: http://devicetree.org/schemas/media/apple,isp-profile.yaml#
$schema: http://devicetree.org/meta-schemas/core.yaml#

title: Apple ISP firmware profile memory preparation

maintainers:
  - Ryan Murray <ryan@aurorasilicon.org>

description: |
  Version-specific ISP memory and wire preparation. This profile identifies
  the measured T6040 board6 resident 25G76 image. It does not admit native
  startup, interrupt delivery, inherited DART ownership or a firmware lifetime
  transition. The producer keeps this device disabled until those boundaries
  have been qualified. Firmware physical ranges are supplied at boot.

select:
  required:
    - apple,isp-profile

properties:
  apple,isp-profile:
    const: t6040-25G76

  apple,isp-firmware-uuid:
    const: 4C8FBA5E-45CC-308E-9BE5-053518C19D76

  apple,isp-board-id:
    $ref: /schemas/types.yaml#/definitions/uint32
    const: 6

  apple,isp-mcc-mask:
    $ref: /schemas/types.yaml#/definitions/uint32
    const: 15

  memory-region:
    minItems: 3
    maxItems: 3

  memory-region-names:
    items:
      - const: firmware-text
      - const: firmware-data
      - const: heap

  status:
    const: disabled

required:
  - apple,isp-profile
  - apple,isp-firmware-uuid
  - apple,isp-board-id
  - apple,isp-mcc-mask
  - memory-region
  - memory-region-names
  - status

additionalProperties: true
```

## Documentation/devicetree/bindings/media/apple,isp-secure-proxy.yaml
```yaml
# SPDX-License-Identifier: (GPL-2.0-only OR BSD-2-Clause)
%YAML 1.2
---
$id: http://devicetree.org/schemas/media/apple,isp-secure-proxy.yaml#
$schema: http://devicetree.org/meta-schemas/core.yaml#

title: Apple secure image processor proxy apertures

maintainers:
  - Ryan Murray <81541646+RyanTheTide@users.noreply.github.com>

description: |
  Secure image processor proxy register apertures. They are distinct from
  the non-secure image processor and remain owned by firmware.

properties:
  compatible:
    oneOf:
      - items:
          - const: apple,t8152-isp-secure-proxy
          - const: apple,isp-secure-proxy
      - items:
          - const: apple,t8140-isp-secure-proxy
          - const: apple,isp-secure-proxy

  reg:
    minItems: 3
    maxItems: 3
    description: Register apertures in hardware-description order.

required:
  - compatible
  - reg

additionalProperties: false
```

## Documentation/devicetree/bindings/media/apple,isp-service-proxy.yaml
```yaml
# SPDX-License-Identifier: (GPL-2.0-only OR BSD-2-Clause)
%YAML 1.2
---
$id: http://devicetree.org/schemas/media/apple,isp-service-proxy.yaml#
$schema: http://devicetree.org/meta-schemas/core.yaml#

title: Apple image processor firmware service proxy

maintainers:
  - Ryan Murray <81541646+RyanTheTide@users.noreply.github.com>

description: |
  Image processor secure firmware service endpoint. This is separate
  from the AP image processor and has no AP register window.

properties:
  compatible:
    oneOf:
      - items:
          - const: apple,t8140-isp-service-proxy
          - const: apple,isp-service-proxy

required:
  - compatible

additionalProperties: false
```
