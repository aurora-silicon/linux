## Documentation/devicetree/bindings/spi/apple,spi.yaml
```yaml
# SPDX-License-Identifier: (GPL-2.0-only OR BSD-2-Clause)
%YAML 1.2
---
$id: http://devicetree.org/schemas/spi/apple,spi.yaml#

$schema: http://devicetree.org/meta-schemas/core.yaml#

title: Apple ARM SoC SPI controller

maintainers:
  - Hector Martin <marcan@marcan.st>

select:
  anyOf:
    -
      properties:
        compatible:
          contains:
            enum:
              - "apple,spi"
              - "apple,t6000-spi"
              - "apple,t6020-spi"
              - "apple,t6030-spi"
              - "apple,t6031-spi"
              - "apple,t6041-spi"
              - "apple,t8103-spi"
              - "apple,t8112-spi"
              - "apple,t8122-spi"
              - "apple,t8132-spi"
              - "apple,t8140-spi"
      required:
        - "compatible"
    -
      properties:
        compatible:
          items:
            -
              const: "apple,t6050-spi"
            -
              const: "apple,t8103-spi"
      required:
        - "compatible"

properties:
  compatible: true
  reg: true
  clocks: true
  interrupts: true
  power-domains: true
  iommus: true
  resets: true
  status: true

additionalProperties: true

allOf:
  - if:
      anyOf:
        -
          properties:
            compatible:
              items:
                -
                  const: "apple,t6050-spi"
                -
                  const: "apple,t8103-spi"
            status:
              const: "disabled"
          required:
            - "compatible"
            - "status"
    then:
      oneOf:
        -
          description: "T6050 native resource description. Firmware ownership, backend support and enables require separate qualification. This variant remains disabled and contains no programming sequences or firmware data."
          properties:
            compatible:
              items:
                -
                  const: "apple,t6050-spi"
                -
                  const: "apple,t8103-spi"
            status:
              const: "disabled"
            reg:
              maxItems: 1
              description: "Native register apertures in hardware-interface order, including shared auxiliary views."
            interrupts:
              maxItems: 1
            power-domains:
              maxItems: 1
            clocks:
              maxItems: 1
            "#address-cells":
              const: 1
            "#size-cells":
              const: 0
          required:
            - "compatible"
            - "reg"
            - "status"
            - "interrupts"
            - "power-domains"
            - "clocks"
            - "#address-cells"
            - "#size-cells"
          additionalProperties: false
    else:
      allOf:
        - $ref: spi-controller.yaml#
      properties:
        compatible:
          oneOf:
            - items:
                - enum:
                    - apple,t6000-spi
                    - apple,t6020-spi
                    - apple,t6030-spi
                    - apple,t6031-spi
                    - apple,t6041-spi
                    - apple,t8112-spi
                    - apple,t8122-spi
                    - apple,t8132-spi
                    - apple,t8140-spi
                - const: apple,t8103-spi
            - items:
                - enum:
                    - apple,t8103-spi
                    - apple,t8112-spi
                    - apple,t6000-spi
                - const: apple,spi

        reg:
          maxItems: 1

        clocks:
          maxItems: 1

        interrupts:
          maxItems: 1

        power-domains:
          maxItems: 1
      required:
        - compatible
        - reg
        - clocks
        - interrupts
      unevaluatedProperties: false

examples:
  - |
    #include <dt-bindings/interrupt-controller/apple-aic.h>
    #include <dt-bindings/interrupt-controller/irq.h>

    soc {
      #address-cells = <2>;
      #size-cells = <2>;

      spi@39b104000 {
        compatible = "apple,t6000-spi", "apple,spi";
        reg = <0x3 0x9b104000 0x0 0x4000>;
        interrupt-parent = <&aic>;
        interrupts = <AIC_IRQ 0 1107 IRQ_TYPE_LEVEL_HIGH>;
        #address-cells = <1>;
        #size-cells = <0>;
        clocks = <&clk>;
      };
    };
```

## Documentation/devicetree/bindings/spmi/apple,m2-spmi-pmic.yaml
```yaml
# SPDX-License-Identifier: (GPL-2.0-only OR BSD-2-Clause)
%YAML 1.2
---
$id: http://devicetree.org/schemas/spmi/apple,m2-spmi-pmic.yaml#
$schema: http://devicetree.org/meta-schemas/core.yaml#

title: Apple M2 generation SPMI power management IC

maintainers:
  - Ryan Murray <81541646+RyanTheTide@users.noreply.github.com>

description: |
  SPMI power management IC resources. The address is a unique slave identifier on
  its parent bus. Register access and protocol support are separate from
  describing the peripheral and its interrupt resources.

select:
  properties:
    compatible:
      contains:
        enum:
          - apple,t6020-maverick-pmic
          - apple,t6020-mirabeau-pmic
          - apple,t6021-maverick-pmic
          - apple,t6021-mirabeau-pmic
          - apple,t6022-maverick-pmic
          - apple,t6022-mirabeau-pmic
          - apple,t8112-vale-pmic
  required:
    - compatible

properties:
  compatible:
    items:
      - enum:
          - apple,t6020-maverick-pmic
          - apple,t6020-mirabeau-pmic
          - apple,t6021-maverick-pmic
          - apple,t6021-mirabeau-pmic
          - apple,t6022-maverick-pmic
          - apple,t6022-mirabeau-pmic
          - apple,t8112-vale-pmic
      - const: apple,spmi-pmic

  reg:
    maxItems: 1

  interrupts:
    maxItems: 1

required:
  - compatible
  - reg

additionalProperties: false
```

## Documentation/devicetree/bindings/spmi/apple,spmi-monitor.yaml
```yaml
# SPDX-License-Identifier: (GPL-2.0-only OR BSD-2-Clause)
%YAML 1.2
---
$id: http://devicetree.org/schemas/spmi/apple,spmi-monitor.yaml#
$schema: http://devicetree.org/meta-schemas/core.yaml#

title: Apple first-generation SPMI secondary and event resources

maintainers:
  - Ryan Murray <81541646+RyanTheTide@users.noreply.github.com>

description: |
  The primary PMIC bus is serviced by the polled SPMI driver. Its secondary
  controller and interrupt-status apertures, and its external AIC interrupt,
  remain firmware-owned. Describing them separately preserves the active
  polled register window without enabling an unqualified interrupt path.

properties:
  compatible:
    items:
      - enum:
          - apple,t8103-spmi-monitor
          - apple,t6000-spmi-monitor
      - const: apple,spmi-monitor

  reg:
    items:
      - description: Secondary controller registers
      - description: Interrupt-status registers

  interrupts:
    maxItems: 1

  interrupt-controller: true

  "#interrupt-cells":
    const: 2

  "#address-cells":
    const: 0

  apple,controller:
    $ref: /schemas/types.yaml#/definitions/phandle
    description: Primary polled SPMI controller sharing these resources.

required:
  - compatible
  - reg
  - interrupts
  - apple,controller

additionalProperties: false
```

## Documentation/devicetree/bindings/spmi/apple,spmi-peripheral.yaml
```yaml
# SPDX-License-Identifier: (GPL-2.0-only OR BSD-2-Clause)
%YAML 1.2
---
$id: http://devicetree.org/schemas/spmi/apple,spmi-peripheral.yaml#
$schema: http://devicetree.org/meta-schemas/core.yaml#

title: Apple SPMI peripheral

maintainers:
  - Ryan Murray <81541646+RyanTheTide@users.noreply.github.com>

description: |
  SPMI peripheral resources. The address is a unique slave identifier on
  its parent bus. Register access and protocol support are separate from
  describing the peripheral and its interrupt resources.

select:
  properties:
    compatible:
      contains:
        enum:
          - apple,t6020-spmi-peripheral
          - apple,t6021-spmi-peripheral
          - apple,t6022-spmi-peripheral
          - apple,t8112-spmi-peripheral
  required:
    - compatible

properties:
  compatible:
    items:
      - enum:
          - apple,t6020-spmi-peripheral
          - apple,t6021-spmi-peripheral
          - apple,t6022-spmi-peripheral
          - apple,t8112-spmi-peripheral
      - const: apple,spmi-peripheral

  reg:
    maxItems: 1

required:
  - compatible
  - reg

additionalProperties: false
```

## Documentation/devicetree/bindings/spmi/apple,spmi-sideband.yaml
```yaml
# SPDX-License-Identifier: (GPL-2.0-only OR BSD-2-Clause)
%YAML 1.2
---
$id: http://devicetree.org/schemas/spmi/apple,spmi-sideband.yaml#
$schema: http://devicetree.org/meta-schemas/core.yaml#

title: Apple SPMI sideband

maintainers:
  - Ryan Murray <81541646+RyanTheTide@users.noreply.github.com>

description: |
  SPMI sideband resources on M2 generation SoCs. The register apertures
  follow hardware resource order. Firmware configuration and tuning are
  supplied by the bootloader and are not part of this binding. Unqualified
  instances must remain disabled.

select:
  properties:
    compatible:
      contains:
        enum:
          - apple,t6020-spmi-sideband
          - apple,t6021-spmi-sideband
          - apple,t6022-spmi-sideband
          - apple,t8112-spmi-sideband
  required:
    - compatible

properties:
  compatible:
    items:
      - enum:
          - apple,t6020-spmi-sideband
          - apple,t6021-spmi-sideband
          - apple,t6022-spmi-sideband
          - apple,t8112-spmi-sideband
      - const: apple,spmi-sideband

  reg:
    maxItems: 1

required:
  - compatible
  - reg

additionalProperties: false
```

## Documentation/devicetree/bindings/spmi/apple,spmi.yaml
```yaml
# SPDX-License-Identifier: (GPL-2.0 OR BSD-2-Clause)
%YAML 1.2
---
$id: http://devicetree.org/schemas/spmi/apple,spmi.yaml#
$schema: http://devicetree.org/meta-schemas/core.yaml#

title: Apple SPMI controller

maintainers:
  - Sasha Finkelstein <k@chaosmail.tech>

description: A SPMI controller present on most Apple SoCs

allOf:
  - $ref: spmi.yaml#

properties:
  compatible:
    oneOf:
      - const: apple,t8142-spmi
      - items:
          - enum:
              - apple,t6000-spmi
              - apple,t8103-spmi
              - apple,t8112-spmi
          - const: apple,spmi
      - items:
          - const: apple,t6050-spmi
          - const: apple,t8142-spmi
      - items:
          - enum:
              - apple,t6000-spmi
              - apple,t6020-spmi
              - apple,t6030-spmi
              - apple,t6031-spmi
              - apple,t6041-spmi
              - apple,t8012-spmi
              - apple,t8015-spmi
              - apple,t8112-spmi
              - apple,t8122-spmi
              - apple,t8132-spmi
              - apple,t8140-spmi
          - const: apple,t8103-spmi
      - description:
          The gen-4 controller of T8152, with its FIFO registers at 0x200.
        items:
          - const: apple,t8152-spmi
          - const: apple,t8142-spmi

  reg:
    minItems: 1
    items:
      - description: SPMI command interface
      - description: SPMI interrupt interface
      - description: SPMI auxiliary interface

  interrupts:
    maxItems: 1
    description: Optional, operates in polled mode if not present

  interrupt-controller:
    description:
      The controller demultiplexes follower interrupts. Some instances (the
      T8112 AOP controllers) have no interrupt line to the AP. Follower
      interrupts are then described but cannot be delivered, and drivers
      fall back to polling or stay idle.

  "#interrupt-cells":
    const: 2

  power-domains:
    maxItems: 1

required:
  - compatible
  - reg

dependentRequired:
  interrupt-controller:
    - "#interrupt-cells"

unevaluatedProperties: false

examples:
  - |
    #include <dt-bindings/spmi/spmi.h>

    spmi@920a1300 {
        compatible = "apple,t6000-spmi", "apple,spmi";
        reg = <0x920a1300 0x100>;
        #address-cells = <2>;
        #size-cells = <0>;

        pmic@f {
            reg = <0xf SPMI_USID>;
            /* PMIC-specific properties */
        };
    };
```

## Documentation/devicetree/bindings/spmi/apple,viper-spmi.yaml
```yaml
# SPDX-License-Identifier: (GPL-2.0-only OR BSD-2-Clause)
%YAML 1.2
---
$id: http://devicetree.org/schemas/spmi/apple,viper-spmi.yaml#
$schema: http://devicetree.org/meta-schemas/core.yaml#

title: Apple Viper SPMI endpoint

maintainers:
  - Ryan Murray <81541646+RyanTheTide@users.noreply.github.com>

description: |
  A Viper endpoint on an auxiliary SPMI bus. Its register protocol and
  firmware ownership are separate from those of the primary PMIC.

properties:
  compatible:
    oneOf:
      - items:
          - const: apple,t6000-viper-spmi
          - const: apple,viper-spmi

  reg:
    maxItems: 1

required:
  - compatible
  - reg

additionalProperties: false
```

## Documentation/devicetree/bindings/thermal/apple,die-temperature-sensor.yaml
```yaml
# SPDX-License-Identifier: (GPL-2.0-only OR BSD-2-Clause)
%YAML 1.2
---
$id: http://devicetree.org/schemas/thermal/apple,die-temperature-sensor.yaml#
$schema: http://devicetree.org/meta-schemas/core.yaml#

title: Apple T8103 die temperature sensor registers

maintainers:
  - Ryan Murray <81541646+RyanTheTide@users.noreply.github.com>

description: |
  Each channel has a readback register and, where present, independent
  control, accumulator and alarm registers. Channels share larger PMGR or
  CPU apertures, so only their individual registers are described here.
  Register addresses do not describe sensor calibration, alarm thresholds
  or firmware control sequences. A driver needs a separate calibration
  handoff before reporting temperatures.

properties:
  compatible:
    items:
      - const: apple,t8103-die-temperature-sensor
      - const: apple,die-temperature-sensor

  reg:
    minItems: 2
    maxItems: 17

  reg-names:
    minItems: 2
    maxItems: 17
    items:
      enum:
        - readbk
        - readbk1
        - readcnt
        - readsum
        - ctl0-clr
        - ctl0-set
        - ctl1
        - ctl1-clr
        - ctl1-set
        - ctl2
        - ctl2-clr
        - ctl2-set
        - ctl3-clr
        - ctl3-set
        - ctl4-clr
        - ctl4-set
        - alarm0
        - alarm1
        - alarm2
        - alarm3
        - status

required:
  - compatible
  - reg
  - reg-names

additionalProperties: false
```

## Documentation/devicetree/bindings/timer/apple,aic-timebase.yaml
```yaml
# SPDX-License-Identifier: (GPL-2.0-only OR BSD-2-Clause)
%YAML 1.2
---
$id: http://devicetree.org/schemas/timer/apple,aic-timebase.yaml#
$schema: http://devicetree.org/meta-schemas/core.yaml#

title: Apple AIC timebase

maintainers:
  - Ryan Murray <81541646+RyanTheTide@users.noreply.github.com>

description: |
  The timebase register aperture associated with the interrupt controller.

properties:
  compatible:
    items:
      - enum:
          - apple,t6000-aic-timebase
          - apple,t6020-aic-timebase
          - apple,t6021-aic-timebase
          - apple,t6022-aic-timebase
          - apple,t6041-aic-timebase
          - apple,t6050-aic-timebase
          - apple,t8103-aic-timebase
          - apple,t8112-aic-timebase
          - apple,t8142-aic-timebase
          - apple,t8152-aic-timebase
      - const: apple,aic-timebase

  reg:
    maxItems: 1
    description: Register apertures in hardware-description order.

required:
  - compatible
  - reg

additionalProperties: false
```
