## Documentation/devicetree/bindings/timer/apple,secure-timebase.yaml
```yaml
# SPDX-License-Identifier: (GPL-2.0-only OR BSD-2-Clause)
%YAML 1.2
---
$id: http://devicetree.org/schemas/timer/apple,secure-timebase.yaml#
$schema: http://devicetree.org/meta-schemas/core.yaml#

title: Apple secure audio timebase aperture

maintainers:
  - Ryan Murray <81541646+RyanTheTide@users.noreply.github.com>

description: |
  Secure audio timebase register aperture, owned by firmware at boot.

properties:
  compatible:
    oneOf:
      - items:
          - const: apple,t8140-secure-timebase
          - const: apple,secure-timebase

  reg:
    maxItems: 1
    description: Register apertures in hardware-description order.

required:
  - compatible
  - reg

additionalProperties: false
```

## Documentation/devicetree/bindings/usb/apple,ausb-drd.yaml
```yaml
# SPDX-License-Identifier: (GPL-2.0-only OR BSD-2-Clause)
%YAML 1.2
---
$id: http://devicetree.org/schemas/usb/apple,ausb-drd.yaml#
$schema: http://devicetree.org/meta-schemas/core.yaml#

title: Apple T6000 AUSB dual-role controller

maintainers:
  - Ryan Murray <81541646+RyanTheTide@users.noreply.github.com>

description: |
  The AUSB controller has four register apertures and four interrupt
  sources. Both DMA translation banks use stream 3. Its PHY is separate.

properties:
  compatible:
    items:
      - enum:
          - apple,t6000-ausb-drd
      - const: apple,ausb-drd

  reg:
    minItems: 4
    maxItems: 4

  interrupts:
    minItems: 4
    maxItems: 4

  power-domains:
    maxItems: 1

  phys:
    maxItems: 1

  iommus:
    minItems: 2
    maxItems: 2

required:
  - compatible
  - reg
  - interrupts
  - power-domains
  - phys
  - iommus

additionalProperties: false
```

## Documentation/devicetree/bindings/usb/apple,dwc3.yaml
```yaml
# SPDX-License-Identifier: (GPL-2.0-only OR BSD-2-Clause)
%YAML 1.2
---
$id: http://devicetree.org/schemas/usb/apple,dwc3.yaml#
$schema: http://devicetree.org/meta-schemas/core.yaml#

title: Apple Silicon DWC3 USB controller

maintainers:
  - Sven Peter <sven@kernel.org>

description:
  Apple Silicon SoCs use a Synopsys DesignWare DWC3 based controller for each of
  their Type-C ports.

  On T8152 the bootloader can hand a controller over already running, powered
  and with the USB2 side of its ATC PHY set up for host mode. Such a controller
  is described by its DWC3 core region, as a host. Its PHY reset and power
  domain, and on a Type-C port its USB role switch, exist but are left to the
  bootloader, so they are optional.

allOf:
  - $ref: snps,dwc3-common.yaml#
  - if:
      properties:
        compatible:
          not:
            contains:
              enum:
                - apple,t8132-dwc3
                - apple,t8152-dwc3
    then:
      required:
        - power-domains
  - if:
      properties:
        compatible:
          contains:
            const: apple,t8152-dwc3
    then:
      properties:
        dr_mode:
          const: host
      required:
        - dr_mode
    else:
      properties:
        reg:
          minItems: 2
        reg-names:
          minItems: 2
      required:
        - reg-names
  - if:
      properties:
        compatible:
          not:
            contains:
              const: apple,t8152-dwc3
      not:
        properties:
          status:
            const: disabled
        required:
          - status
    then:
      required:
        - resets
        - usb-role-switch
  - if:
      properties:
        compatible:
          contains:
            const: apple,t6050-dwc3
    then:
      properties:
        reg:
          minItems: 3
        reg-names:
          minItems: 3
    else:
      properties:
        reg:
          maxItems: 3
        reg-names:
          maxItems: 3

$defs:
  apple,tunable:
    $ref: /schemas/types.yaml#/definitions/uint32-matrix
    minItems: 1
    maxItems: 512
    items:
      items:
        - description: Register offset
        - description: Mask to be applied to the register value
        - description: Bits to be set after applying the mask
    description: >
      Controller table from the device's Apple device tree, applied after
      every core reset (T6040, T6050).

properties:
  compatible:
    oneOf:
      - items:
          - enum:
              - apple,t6000-dwc3
              - apple,t6020-dwc3
              - apple,t6030-dwc3
              - apple,t6031-dwc3
              - apple,t6040-dwc3
              - apple,t6050-dwc3
              - apple,t8112-dwc3
              - apple,t8122-dwc3
              - apple,t8140-dwc3
              - apple,t8142-dwc3
          - const: apple,t8103-dwc3
      - const: apple,t8103-dwc3
      - const: apple,t8132-dwc3
      - const: apple,t8152-dwc3

  reg:
    minItems: 1
    items:
      - description: Core DWC3 region
      - description: Apple-specific DWC3 region
      - description: Controller configuration block (T6040, T6050)
      - description: Bulk fabric block (T6050)
      - description: AUSBC debug block (T6050)

  reg-names:
    minItems: 1
    items:
      - const: dwc3-core
      - const: dwc3-apple
      - const: drd-cfg
      - const: drd-bulk
      - const: drd-ausbc

  interrupts:
    maxItems: 1

  iommus:
    maxItems: 2

  resets:
    maxItems: 1

  power-domains:
    maxItems: 1

  apple,tunable-gbl-default:
    $ref: "#/$defs/apple,tunable"
    description: Tunables applied to the DWC3 global registers.

  apple,tunable-gbl-host:
    $ref: "#/$defs/apple,tunable"
    description: Host mode tunables applied to the DWC3 global registers.

  apple,tunable-dbg:
    $ref: "#/$defs/apple,tunable"
    description: Tunables applied to the debug registers of the Apple region.

  apple,tunable-cfg-host:
    $ref: "#/$defs/apple,tunable"
    description: Host mode tunables applied to the drd-cfg region.

  apple,tunable-link:
    $ref: "#/$defs/apple,tunable"
    description: Tunables applied to the link registers of the Apple region.

  apple,tunable-cio:
    $ref: "#/$defs/apple,tunable"
    description:
      Tunables applied to the CIO registers of the Apple region, from offset
      0x20 of that region, after the driver's fixed CIO values.

  apple,tunable-bulk:
    $ref: "#/$defs/apple,tunable"
    description: Tunables applied to the drd-bulk region.

  apple,tunable-ausbc:
    $ref: "#/$defs/apple,tunable"
    description: Tunables applied to the drd-ausbc region.

  apple,sleep-ddr:
    type: boolean
    description:
      While the controller runs as a host, a system sleep keeps DRAM for its
      always-on side, as macOS's USB_SLP_DDR vote does from the host's start
      to its stop.

required:
  - compatible
  - reg
  - interrupts
  - iommus

unevaluatedProperties: false

examples:
  - |
    #include <dt-bindings/interrupt-controller/apple-aic.h>
    #include <dt-bindings/interrupt-controller/irq.h>

    usb@82280000 {
      compatible = "apple,t8103-dwc3";
      reg = <0x82280000 0xcd00>, <0x8228cd00 0x3200>;
      reg-names = "dwc3-core", "dwc3-apple";
      interrupts = <AIC_IRQ 777 IRQ_TYPE_LEVEL_HIGH>;
      iommus = <&dwc3_0_dart_0 0>, <&dwc3_0_dart_1 1>;

      power-domains = <&ps_atc0_usb>;
      resets = <&atcphy0>;

      usb-role-switch;
    };

  - |
    #include <dt-bindings/interrupt-controller/apple-aic.h>
    #include <dt-bindings/interrupt-controller/irq.h>

    usb@82430000 {
      compatible = "apple,t8152-dwc3";
      reg = <0x82430000 0xcd00>;
      interrupts = <AIC_IRQ 1763 IRQ_TYPE_LEVEL_HIGH>;
      iommus = <&dwc3_2_dart_0 0>, <&dwc3_2_dart_1 1>;
      dr_mode = "host";
      maximum-speed = "high-speed";
      snps,dis_u2_susphy_quirk;
      snps,dis_u3_susphy_quirk;
    };
```

## Documentation/devicetree/bindings/usb/apple,sn201202x.yaml
```yaml
# SPDX-License-Identifier: (GPL-2.0-only OR BSD-2-Clause)
%YAML 1.2
---
$id: http://devicetree.org/schemas/usb/apple,sn201202x.yaml#
$schema: http://devicetree.org/meta-schemas/core.yaml#

title: Texas Instruments sn201202x Type-C Power Delivery controller

maintainers:
  - Sasha Finkelstein <k@chaosmail.tech>

description: |
  Texas Instruments sn201202x Type-C Power Delivery controller

  A variant of tps6598x controller also known as Apple ACE3
  present on hardware with Apple SoCs starting from the M3.

  The controller can be polled when interrupt resources are not supplied.

  T8132 omits the register-selection interrupt, so selection is polled while
  event, standby and wakeup notifications use interrupts.

properties:
  compatible:
    oneOf:
      - const: apple,sn201202x
      - items:
          - const: apple,t8132-sn201202x
          - const: apple,sn201202x

  reg:
    maxItems: 1

  interrupts:
    minItems: 3
    maxItems: 4

  interrupt-names:
    minItems: 3
    maxItems: 4

  wakeup-source: true

  connector:
    $ref: /schemas/connector/usb-connector.yaml#

required:
  - compatible
  - reg

allOf:
  - if:
      properties:
        compatible:
          contains:
            const: apple,t8132-sn201202x
    then:
      properties:
        interrupts:
          items:
            - description: Primary irq used for tps6598x events
            - description: Standby command completed
            - description: Wakeup command completed
        interrupt-names:
          items:
            - const: irq
            - const: sleep
            - const: wake
    else:
      properties:
        interrupts:
          items:
            - description: Primary irq used for tps6598x events
            - description: Logical register selection completed
            - description: Standby command completed
            - description: Wakeup command completed
        interrupt-names:
          items:
            - const: irq
            - const: select
            - const: sleep
            - const: wake

dependentRequired:
  interrupts: [interrupt-names]
  interrupt-names: [interrupts]

additionalProperties: false

examples:
  - |
    #include <dt-bindings/interrupt-controller/irq.h>
    #include <dt-bindings/spmi/spmi.h>
    spmi {
        #address-cells = <2>;
        #size-cells = <0>;
        usb-pd@c {
            compatible = "apple,sn201202x";
            reg = <0xc SPMI_USID>;
            interrupts = <11 IRQ_TYPE_EDGE_RISING>,
                         <13 IRQ_TYPE_EDGE_RISING>,
                         <17 IRQ_TYPE_EDGE_RISING>,
                         <19 IRQ_TYPE_EDGE_RISING>;
            interrupt-names = "irq", "select", "sleep", "wake";

            connector {
                compatible = "usb-c-connector";
                label = "USB-C";

                port {
                    typec_ep: endpoint {
                        remote-endpoint = <&otg_ep>;
                    };
                };
            };
        };
    };
```

## Documentation/devicetree/bindings/usb/apple,usb-auss.yaml
```yaml
# SPDX-License-Identifier: (GPL-2.0-only OR BSD-2-Clause)
%YAML 1.2
---
$id: http://devicetree.org/schemas/usb/apple,usb-auss.yaml#
$schema: http://devicetree.org/meta-schemas/core.yaml#

title: Apple AUSS USB controller

maintainers:
  - Ryan Murray <81541646+RyanTheTide@users.noreply.github.com>

description:
  The USB controller in the AUSS block that the T6050 Type-C routers share
  (ADT usb-auss0), separate from the per-port controllers. It is described
  from the ADT so the device tree lists all of the SoC's hardware; no driver
  uses it yet and the node stays disabled.

properties:
  compatible:
    const: apple,t6050-usb-auss

  reg:
    minItems: 10
    maxItems: 10
    description: Register windows in the ADT's order.

  interrupts:
    minItems: 4
    maxItems: 4

  iommus:
    maxItems: 1

  power-domains:
    maxItems: 1

required:
  - compatible
  - reg
  - interrupts
  - iommus
  - power-domains

additionalProperties: false
```

## Documentation/devicetree/bindings/usb/apple,usb2-otg.yaml
```yaml
# SPDX-License-Identifier: (GPL-2.0-only OR BSD-2-Clause)
%YAML 1.2
---
$id: http://devicetree.org/schemas/usb/apple,usb2-otg.yaml#
$schema: http://devicetree.org/meta-schemas/core.yaml#

title: Apple USB2 OTG interface

maintainers:
  - Ryan Murray <81541646+RyanTheTide@users.noreply.github.com>

description: |
  Hardware resources of the Apple Silicon USB2 OTG interface.
  The interface is described for discovery and must remain disabled until
  its ownership, initialization and shutdown are supported. Register windows
  are listed in hardware resource order; firmware configuration and tuning
  data are supplied by the boot firmware rather than this binding.

select:
  properties:
    compatible:
      contains:
        enum:
          - apple,t8122-usb2-otg
          - apple,t6030-usb2-otg
          - apple,t6031-usb2-otg
  required:
    - compatible

properties:
  compatible:
    items:
      - enum:
          - apple,t8122-usb2-otg
          - apple,t6030-usb2-otg
          - apple,t6031-usb2-otg
      - const: apple,usb2-otg

  reg:
    minItems: 2
    maxItems: 2

  interrupts:
    maxItems: 1

  iommus:
    minItems: 2
    maxItems: 2

  power-domains:
    maxItems: 1

  phys:
    maxItems: 1
  phy-names:
    const: usb2-phy

required:
  - compatible
  - reg
  - interrupts
  - iommus
  - power-domains
  - phys
  - phy-names

additionalProperties: false
```

## Documentation/devicetree/bindings/usb/via,vl122.yaml
```yaml
# SPDX-License-Identifier: (GPL-2.0-only OR BSD-2-Clause)
%YAML 1.2
---
$id: http://devicetree.org/schemas/usb/via,vl122.yaml#
$schema: http://devicetree.org/meta-schemas/core.yaml#

title: VIA Labs VL122 USB 2.0 hub sideband interface

maintainers:
  - Ryan Murray <81541646+RyanTheTide@users.noreply.github.com>

description: |
  The VL122 exposes an I2C sideband configuration interface while its reset is
  asserted. Firmware supplies board-specific masked register updates. The
  driver identifies the attached hub and selects the matching firmware list;
  it deliberately has no built-in fallback tuning values.

properties:
  compatible:
    const: via,vl122

  reg:
    maxItems: 1

  reset-gpios:
    maxItems: 1
    description:
      Hub reset. The management interface only answers while the hub is
      held in reset.

  usb-hub:
    $ref: /schemas/types.yaml#/definitions/phandle
    description: USB device-tree node for the hub controlled by this interface.

  apple,tunable-vl:
    $ref: /schemas/types.yaml#/definitions/uint8-array
    minItems: 4
    maxItems: 1024
    description: VIA Labs variant tuning tuples.

  apple,tunable-vlf0:
    $ref: /schemas/types.yaml#/definitions/uint8-array
    minItems: 4
    maxItems: 1024
    description: VIA Labs variant 0xf0 tuning tuples.

  apple,tunable-gl:
    $ref: /schemas/types.yaml#/definitions/uint8-array
    minItems: 4
    maxItems: 1024
    description: Genesys Logic compatible-controller tuning tuples.

required:
  - compatible
  - reg
  - reset-gpios

additionalProperties: false

examples:
  - |
    #include <dt-bindings/gpio/gpio.h>

    i2c {
        #address-cells = <1>;
        #size-cells = <0>;

        usb-hub@2c {
            compatible = "via,vl122";
            reg = <0x2c>;
            reset-gpios = <&gpio 142 GPIO_ACTIVE_HIGH>;
            apple,tunable-vl = [ 07 ff 55 00 ];
            apple,tunable-vlf0 = [ 07 ff aa 00 ];
            apple,tunable-gl = [ 09 7f 08 00 ];
        };
    };
...
```
