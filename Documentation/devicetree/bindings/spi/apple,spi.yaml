## Documentation/devicetree/bindings/usb/vialab,vl122.yaml
```yaml
# SPDX-License-Identifier: GPL-2.0-only OR BSD-2-Clause
%YAML 1.2
---
$id: http://devicetree.org/schemas/usb/vialab,vl122.yaml#
$schema: http://devicetree.org/meta-schemas/core.yaml#

title: VIA Labs VL122 USB 2.0 hub controller

maintainers:
  - Ryan Murray <ryan@aurorasilicon.org>

description:
  The VL122 is a two-port USB 2.0 hub controller. Apple's J700 has one
  permanently attached to the USB 2.0 root port of a Type-C USB controller,
  with the two downstream ports wired to the high-speed pairs of the two
  Type-C connectors.

allOf:
  - $ref: usb-hub.yaml#

properties:
  compatible:
    enum:
      - usb2109,2122

  reg: true

  ports:
    $ref: /schemas/graph.yaml#/properties/ports
    description: The two downstream facing ports.

    properties:
      port@1:
        $ref: /schemas/graph.yaml#/properties/port
        description: Downstream port 1.

      port@2:
        $ref: /schemas/graph.yaml#/properties/port
        description: Downstream port 2.

required:
  - compatible
  - reg

unevaluatedProperties: false

examples:
  - |
    usb {
        #address-cells = <1>;
        #size-cells = <0>;

        hub@1 {
            compatible = "usb2109,2122";
            reg = <1>;

            ports {
                #address-cells = <1>;
                #size-cells = <0>;

                port@1 {
                    reg = <1>;

                    hub_front: endpoint {
                        remote-endpoint = <&typec1_connector_hs>;
                    };
                };

                port@2 {
                    reg = <2>;

                    hub_rear: endpoint {
                        remote-endpoint = <&typec0_connector_hs>;
                    };
                };
            };
        };
    };
```

## Documentation/devicetree/bindings/watchdog/apple,secure-watchdog.yaml
```yaml
# SPDX-License-Identifier: (GPL-2.0-only OR BSD-2-Clause)
%YAML 1.2
---
$id: http://devicetree.org/schemas/watchdog/apple,secure-watchdog.yaml#
$schema: http://devicetree.org/meta-schemas/core.yaml#

title: Apple secure hibernation watchdog aperture

maintainers:
  - Ryan Murray <81541646+RyanTheTide@users.noreply.github.com>

description: |
  Secure hibernation watchdog register aperture, owned by firmware at boot.

properties:
  compatible:
    oneOf:
      - items:
          - const: apple,t8142-secure-watchdog
          - const: apple,secure-watchdog
      - items:
          - const: apple,t8140-secure-watchdog
          - const: apple,secure-watchdog

  reg:
    maxItems: 1
    description: Register apertures in hardware-description order.

required:
  - compatible
  - reg

additionalProperties: false
```

## Documentation/devicetree/bindings/watchdog/apple,wdt.yaml
```yaml
# SPDX-License-Identifier: (GPL-2.0-only OR BSD-2-Clause)
%YAML 1.2
---
$id: http://devicetree.org/schemas/watchdog/apple,wdt.yaml#

$schema: http://devicetree.org/meta-schemas/core.yaml#

title: Apple SoC Watchdog

maintainers:
  - Sven Peter <sven@svenpeter.dev>

select:
  anyOf:
    -
      properties:
        compatible:
          contains:
            enum:
              - apple,s5l8960x-wdt
              - apple,s8000-wdt
              - apple,t6000-wdt
              - apple,t6020-wdt
              - apple,t6030-wdt
              - apple,t6031-wdt
              - apple,t6041-wdt
              - apple,t6050-wdt
              - apple,t7000-wdt
              - apple,t8010-wdt
              - apple,t8015-wdt
              - apple,t8103-wdt
              - apple,t8112-wdt
              - apple,t8122-wdt
              - apple,t8132-wdt
              - apple,t8140-wdt
              - apple,wdt
      required:
        - compatible
    -
      properties:
        compatible:
          allOf:
            -
              contains:
                enum:
                  - apple,t8142-wdt
                  - apple,t8152-wdt
            -
              contains:
                const: apple,wdt
      required:
        - compatible
properties:
  compatible: true

  reg: true

  clocks: true

  interrupts: true

# The root declares the union of property types for DTB decoding. The
# conditional variants below each retain their closed property contract.
additionalProperties: true

allOf:
  -
    if:
      anyOf:
        -
          properties:
            compatible:
              allOf:
                -
                  contains:
                    enum:
                      - apple,t8142-wdt
                      - apple,t8152-wdt
                -
                  contains:
                    const: apple,wdt
            status:
              const: disabled
          required:
            - compatible
            - status
          not:
            required:
              - mboxes
    then:
      oneOf:
        -
          type: object
          description: |
            Apple watchdog and reset register complex. Initial resource description for an unsupported
            firmware/backend layout. Register, IRQ and DMA topology can be recorded before a driver
            exists. This form must stay disabled; it does not substitute for the enabled driver contract
            or supply firmware, calibration, programming sequences or unresolved providers.
          properties:
            compatible:
              items:
                -
                  enum:
                    - apple,t8142-wdt
                    - apple,t8152-wdt
                -
                  const: apple,wdt
            status:
              const: disabled
            reg:
              description: |
                Register apertures of the complete hardware complex, in hardware interface order.
              minItems: 5
              maxItems: 5
            interrupts:
              description: Interrupt lines wired to the system interrupt controller.
              minItems: 2
              maxItems: 2
            power-domains:
              description: Physical power and combined clock-gate dependencies.
              minItems: 1
              maxItems: 8
          required:
            - compatible
            - reg
            - status
          additionalProperties: false
    else:
      $ref: "#/$defs/legacy-driver"

$defs:
  legacy-driver:
    type: object
    allOf:
      - $ref: watchdog.yaml#
    properties:
      compatible:
        oneOf:
          - items:
              - enum:
                  - apple,t6020-wdt
                  - apple,t6030-wdt
                  - apple,t6031-wdt
                  - apple,t6041-wdt
                  - apple,t6050-wdt
                  - apple,t8122-wdt
                  - apple,t8132-wdt
                  - apple,t8140-wdt
              - const: apple,t8103-wdt
          - items:
              - enum:
                  # Do not add additional SoC to this list.
                  - apple,s5l8960x-wdt
                  - apple,t7000-wdt
                  - apple,s8000-wdt
                  - apple,t8010-wdt
                  - apple,t8015-wdt
                  - apple,t8103-wdt
                  - apple,t8112-wdt
                  - apple,t6000-wdt
              - const: apple,wdt

      reg:
        maxItems: 1

      clocks:
        maxItems: 1

      interrupts:
        maxItems: 1
    required:
      - compatible
      - reg
      - clocks
      - interrupts
    unevaluatedProperties: false

examples:
  - |
    #include <dt-bindings/interrupt-controller/apple-aic.h>
    #include <dt-bindings/interrupt-controller/irq.h>

    wdt: watchdog@50000000 {
        compatible = "apple,t8103-wdt", "apple,wdt";
        reg = <0x50000000 0x4000>;
        clocks = <&clk>;
        interrupts = <AIC_IRQ 123 IRQ_TYPE_LEVEL_HIGH>;
    };

...
```

## arch/arm64/Kconfig.debug
```kconfig
# SPDX-License-Identifier: GPL-2.0-only

config PID_IN_CONTEXTIDR
	bool "Write the current PID to the CONTEXTIDR register"
	help
	  Enabling this option causes the kernel to write the current PID to
	  the CONTEXTIDR register, at the expense of some additional
	  instructions during context switch. Say Y here only if you are
	  planning to use hardware trace tools with this kernel.

config DEBUG_EFI
	depends on EFI && DEBUG_INFO
	bool "UEFI debugging"
	help
	  Enable this option to include EFI specific debugging features into
	  the kernel that are only useful when using a debug build of the
	  UEFI firmware

config ARM64_RELOC_TEST
	depends on m
	tristate "Relocation testing module"

source "drivers/hwtracing/coresight/Kconfig"

config ARM64_USER4K_EXPERIMENTAL
	bool "Experimental mixed-granule userspace"
	select ARCH_HAS_MM_PGTABLE
	select ARCH_HAS_USER_PAGE_SIZE
	select MM_SUBPAGE
	select MM_ID
	select HAVE_ARCH_TLB_REMOVE_TABLE
	select ARCH_SUPPORTS_PT_RECLAIM
	depends on (ARM64_16K_PAGES || ARM64_64K_PAGES) && ARM64_VA_BITS_48 && ARM64_PA_BITS_48
	depends on !ARM64_LPA2 && !NO_PAGE_MAPCOUNT
	default n
	help
	  Build the in-development MM support for alternative 4K user tables
	  on 16K/64K kernels and 16K user tables on 64K kernels.
	  Ordinary address spaces and kernel tables retain the native granule. An experimental
	  one-shot prctl selects a supported granule for the next exec.
	  This is a development ABI: several MM interfaces and device mappings
	  still require integration and validation. The private prctl numbers
	  are not upstream assignments or a stable ABI promise.
	  Say N for normal kernels.
```

## drivers/accel/ane/Kconfig
```kconfig
# SPDX-License-Identifier: GPL-2.0-only

config DRM_ACCEL_ANE
	tristate "Apple Neural Engine (ANE)"
	depends on DRM_ACCEL
	depends on ARCH_APPLE || COMPILE_TEST
	depends on APPLE_RTKIT
	depends on APPLE_DART || COMPILE_TEST
	depends on MMU
	select INTERCONNECT
	select PM_OPP
	select CRYPTO_LIB_SHA256
	select DRM_ACCEL_ANE_H16_VALIDATION
	help
	  Choose this option if you have an Apple SoC with a Neural Engine:
	  M1 (T8103), M1 Pro, Max and Ultra (T6000, T6001, T6002), M2
	  (T8112), or M2 Pro, Max and Ultra (T6020, T6021, T6022).
	  H16 (M4 Pro) and H17 (A18 Pro) are recognized for firmware preflight
	  and ownership refusal by default. A bound H16 device stays idle until
	  a bring-up stage is written to its debugfs control file. H17 has a
	  staged cold-boot backend that requires loader ownership evidence and
	  reserved preload memory, driven from its firmware_stage sysfs file.
	  On both, the last stage, program, adds an ABI 3 accel node that
	  loads original HWX programs.

	  The interface exposed to userspace is described in
	  include/uapi/drm/ane_accel.h.

	  If unsure, say N.

	  To compile this driver as modules, choose M here: the module for
	  the M1 family will be called ane, and the module for the M2 family
	  will be called ane_t6021.

config DRM_ACCEL_ANE_KUNIT_TEST
	tristate "KUnit tests for the Apple Neural Engine driver" if !KUNIT_ALL_TESTS
	depends on DRM_ACCEL_ANE && KUNIT
	default KUNIT_ALL_TESTS
	help
	  Build KUnit tests for the Apple Neural Engine driver. They check
	  the buffer sizes that DRM_IOCTL_ANE_SUBMIT accepts against the
	  task descriptor layout that userspace builds, at the limits, one
	  past them and with a size product that overflows.

	  If unsure, say N.

config DRM_ACCEL_ANE_H16_VALIDATION
	tristate
	select CRYPTO_LIB_SHA256

config DRM_ACCEL_ANE_FW_KUNIT_TEST
	tristate "KUnit tests for ANE firmware validation" if !KUNIT_ALL_TESTS
	depends on DRM_ACCEL && KUNIT
	select DRM_ACCEL_ANE_H16_VALIDATION
	default KUNIT_ALL_TESTS
	help
	  Check preload identity/ranges, channel validation, RTKit ordering,
	  H16 HWX/resource bounds, UUID retirement, shared transport and bounded
	  allocation, staged H16 cold boot and the H16 program lifecycle
	  without hardware.
	  These tests can run on architectures other than Apple arm64.

	  If unsure, say N.

config DRM_ACCEL_ANE_PM_KUNIT_TEST
	tristate "KUnit tests for ANE runtime-PM recovery" if !KUNIT_ALL_TESTS
	depends on DRM_ACCEL && KUNIT && PM
	default KUNIT_ALL_TESTS
	help
	  Exercise supplier suspension, power-off verification failure and
	  runtime resume errors against the runtime-PM and device-link core.
	  No ANE hardware is required. These tests can run independently of
	  the ANE driver on non-Apple platforms.

	  If unsure, say N.
```

## drivers/gpu/drm/apple-neo/Kconfig
```kconfig
# SPDX-License-Identifier: GPL-2.0-only OR MIT
config DRM_APPLE_NEO
	tristate "DRM Support for the Apple T8140 display controller"
	depends on DRM && OF && ARM64
	depends on ARCH_APPLE || COMPILE_TEST
	depends on APPLE_RTKIT
	depends on TYPEC
	depends on OF_ADDRESS
	select APPLE_PMP_REPORT
	select DRM_CLIENT_SELECTION
	select DRM_KMS_HELPER
	select DRM_KMS_DMA_HELPER
	select DRM_GEM_DMA_HELPER
	select VIDEOMODE_HELPERS
	depends on BACKLIGHT_CLASS_DEVICE
	select MULTIPLEXER
	help
	  Say Y for native display support on the MacBook Neo.

config DRM_APPLE_NEO_AUDIO
	bool "DisplayPort/HDMI Audio support"
	default y
	depends on DRM_APPLE_NEO
	depends on SND
	select SND_PCM
	select SND_DMAENGINE_PCM

config DRM_APPLE_NEO_DEBUG
	bool "Enable additional driver debugging"
	depends on DRM_APPLE_NEO
	depends on EXPERT # only for developers

config DRM_APPLE_NEO_KUNIT_TEST
	tristate "KUnit tests for Apple display controller" if !KUNIT_ALL_TESTS
	depends on KUNIT
	default KUNIT_ALL_TESTS
	help
	  Build tests for the Apple display driver's AFK ring parser and
	  backlight policy (takeover, DPMS, suspend and present completion).
	  The tests cover the header strides used by older firmware and
	  larger rings, as well as malformed ring size combinations.
	  This option is intended for developer test kernels.
	  Also test the Type-C modeset, hotplug and service ownership state.
```
