## Documentation/devicetree/bindings/sound/apple,audio-listening-client.yaml
```yaml
# SPDX-License-Identifier: (GPL-2.0-only OR BSD-2-Clause)
%YAML 1.2
---
$id: http://devicetree.org/schemas/sound/apple,audio-listening-client.yaml#
$schema: http://devicetree.org/meta-schemas/core.yaml#

title: Apple listening client firmware audio service

maintainers:
  - Ryan Murray <81541646+RyanTheTide@users.noreply.github.com>

description: |
  Firmware audio service endpoint, separate from the active sound card.
  It has no independently published AP MMIO aperture. DMA and DART
  references describe the service resources, without transferring audio
  fabric ownership or authorizing a stream to start. The endpoint remains
  disabled until its host client and ownership protocol are qualified.
  Acoustic tuning and runtime buffer contents are not static properties.

properties:
  compatible:
    items:
      - enum:
          - apple,t6041-audio-listening-client
          - apple,t8140-audio-listening-client
      - const: apple,audio-listening-client

required:
  - compatible

additionalProperties: false
```

## Documentation/devicetree/bindings/sound/apple,audio-mca-loopback.yaml
```yaml
# SPDX-License-Identifier: (GPL-2.0-only OR BSD-2-Clause)
%YAML 1.2
---
$id: http://devicetree.org/schemas/sound/apple,audio-mca-loopback.yaml#
$schema: http://devicetree.org/meta-schemas/core.yaml#

title: Apple mca loopback firmware audio service

maintainers:
  - Ryan Murray <81541646+RyanTheTide@users.noreply.github.com>

description: |
  Firmware audio service endpoint, separate from the active sound card.
  It has no independently published AP MMIO aperture. DMA and DART
  references describe the service resources, without transferring audio
  fabric ownership or authorizing a stream to start. The endpoint remains
  disabled until its host client and ownership protocol are qualified.
  Acoustic tuning and runtime buffer contents are not static properties.

properties:
  compatible:
    items:
      - enum:
          - apple,t6041-audio-mca-loopback
          - apple,t8140-audio-mca-loopback
      - const: apple,audio-mca-loopback

  dmas:
    minItems: 2
    maxItems: 2

required:
  - compatible
  - dmas

additionalProperties: false
```

## Documentation/devicetree/bindings/sound/apple,audio-mic-proxy.yaml
```yaml
# SPDX-License-Identifier: (GPL-2.0-only OR BSD-2-Clause)
%YAML 1.2
---
$id: http://devicetree.org/schemas/sound/apple,audio-mic-proxy.yaml#
$schema: http://devicetree.org/meta-schemas/core.yaml#

title: Apple isolated microphone service proxy

maintainers:
  - Ryan Murray <81541646+RyanTheTide@users.noreply.github.com>

description: |
  Isolated microphone firmware endpoint. Buffer geometry and calibration
  are runtime data and are not static hardware resources.

properties:
  compatible:
    oneOf:
      - items:
          - const: apple,t8140-audio-mic-proxy
          - const: apple,audio-mic-proxy

required:
  - compatible

additionalProperties: false
```

## Documentation/devicetree/bindings/sound/apple,audio-voice-trigger.yaml
```yaml
# SPDX-License-Identifier: (GPL-2.0-only OR BSD-2-Clause)
%YAML 1.2
---
$id: http://devicetree.org/schemas/sound/apple,audio-voice-trigger.yaml#
$schema: http://devicetree.org/meta-schemas/core.yaml#

title: Apple voice trigger firmware audio service

maintainers:
  - Ryan Murray <81541646+RyanTheTide@users.noreply.github.com>

description: |
  Firmware audio service endpoint, separate from the active sound card.
  It has no independently published AP MMIO aperture. DMA and DART
  references describe the service resources, without transferring audio
  fabric ownership or authorizing a stream to start. The endpoint remains
  disabled until its host client and ownership protocol are qualified.
  Acoustic tuning and runtime buffer contents are not static properties.

properties:
  compatible:
    items:
      - enum:
          - apple,t6041-audio-voice-trigger
          - apple,t8140-audio-voice-trigger
      - const: apple,audio-voice-trigger

required:
  - compatible

additionalProperties: false
```

## Documentation/devicetree/bindings/sound/apple,dpaudio.yaml
```yaml
# SPDX-License-Identifier: (GPL-2.0-only OR BSD-2-Clause)
%YAML 1.2
---
$id: http://devicetree.org/schemas/sound/apple,dpaudio.yaml#
$schema: http://devicetree.org/meta-schemas/core.yaml#

title: Apple DisplayPort audio interface

maintainers:
  - Ryan Murray <ryan@aurorasilicon.org>

description: |
  The display processor provides a firmware audio service. Samples arrive
  through an SIO DMA channel, and the graph connects the audio interface to
  the display processor's audio service. The interface has a PMGR power gate.

  Existing device trees also identify a register window. The firmware audio
  transport does not program that window directly.

select:
  properties:
    compatible:
      contains:
        enum:
          - apple,t8112-dpaudio
  required:
    - compatible

properties:
  compatible:
    items:
      - enum:
          - apple,t8112-dpaudio
      - const: apple,dpaudio

  reg:
    maxItems: 1

  dmas:
    maxItems: 1

  dma-names:
    const: tx

  power-domains:
    maxItems: 1

  reset-domains:
    $ref: /schemas/types.yaml#/definitions/phandle-array
    maxItems: 1
    items:
      maxItems: 1
    description: PMGR provider used to reset the display audio interface.

  ports:
    $ref: /schemas/graph.yaml#/properties/ports
    properties:
      port@0:
        $ref: /schemas/graph.yaml#/properties/port
        description: Connection to the display processor's audio service.
    required:
      - port@0

required:
  - compatible
  - dmas
  - dma-names
  - power-domains
  - ports

additionalProperties: false

examples:
  - |
    audio-controller {
        compatible = "apple,t8112-dpaudio", "apple,dpaudio";
        dmas = <&sio 0x66>;
        dma-names = "tx";
        power-domains = <&ps_dpa1>;

        ports {
            #address-cells = <1>;
            #size-cells = <0>;

            port@0 {
                reg = <0>;

                endpoint {
                    remote-endpoint = <&dcpext_audio>;
                };
            };
        };
    };
```

## Documentation/devicetree/bindings/sound/apple,j616s-aop-jack.yaml
```yaml
# SPDX-License-Identifier: (GPL-2.0-only OR BSD-2-Clause)
%YAML 1.2
---
$id: http://devicetree.org/schemas/sound/apple,j616s-aop-jack.yaml#
$schema: http://devicetree.org/meta-schemas/core.yaml#

title: Apple J616s AOP retained-profile jack control

maintainers:
  - Ryan Murray <ryan@aurorasilicon.org>

description: |
  Read-only control inspection of the J616s AOP audio service on EPIC v2
  endpoint 0x22. This node is a service child of the AOP provider. The
  bootloader copies the current firmware identity from the AOP firmware nub.
  The driver accepts the qualified identity and exact retained coS/cin MCA
  profiles. It does not upload configuration, power a path, expose a PCM or
  enable speakers. DMA and shared-clock lifecycle require separate admission.

properties:
  compatible:
    const: apple,j616s-aop-jack

  apple,firmware-uuid:
    $ref: /schemas/types.yaml#/definitions/string
    pattern: '^[0-9A-F]{8}-[0-9A-F]{4}-[0-9A-F]{4}-[0-9A-F]{4}-[0-9A-F]{12}$'
    description: Current firmware UUID copied from the AOP nub, not the SoC identity.

  apple,firmware-name:
    $ref: /schemas/types.yaml#/definitions/string
    description: Current firmware name copied from the AOP nub.

required:
  - compatible
  - apple,firmware-uuid
  - apple,firmware-name

additionalProperties: false
```

## Documentation/devicetree/bindings/sound/apple,macaudio.yaml
```yaml
# SPDX-License-Identifier: (GPL-2.0-only OR BSD-2-Clause)
%YAML 1.2
---
$id: http://devicetree.org/schemas/sound/apple,macaudio.yaml#
$schema: http://devicetree.org/meta-schemas/core.yaml#

title: Apple Silicon Macs integrated sound peripherals

description:
  This binding represents the overall machine-level integration of sound
  peripherals on 'Apple Silicon' machines by Apple.

maintainers:
  - Martin Povišer <povik+lin@cutebit.org>

properties:
  compatible:
    items:
      - enum:
          - apple,j274-macaudio
          - apple,j293-macaudio
          - apple,j314-macaudio
          - apple,j616-macaudio
          - apple,j616-macaudio-jack
          - apple,j700-macaudio
          - apple,j713-macaudio
          - apple,j713-macaudio-jack
      - const: apple,macaudio

  "#address-cells":
    const: 1

  "#size-cells":
    const: 0

  model:
    description:
      Model name for presentation to users
    $ref: /schemas/types.yaml#/definitions/string

  speaker-id-gpios:
    minItems: 1
    maxItems: 8
    description:
      Inputs encoding the fitted speaker assembly variant, least significant
      bit first. The machine driver exposes their logical levels through the
      read-only Speaker Variant ID control. GPIO polarity flags define each
      bit's logical level.

patternProperties:
  "^dai-link(@[0-9a-f]+)?$":
    description: |
      Node for each sound peripheral such as the speaker array, headphones jack,
      or microphone.
    type: object

    additionalProperties: false

    properties:
      reg:
        maxItems: 1

      link-name:
        description: |
          Name for the peripheral, expecting 'Speaker' or 'Speakers' if this is
          the speaker array.
        $ref: /schemas/types.yaml#/definitions/string

      cpu:
        type: object

        properties:
          sound-dai:
            description: |
              DAI list with CPU-side I2S ports involved in this peripheral.
            minItems: 1
            maxItems: 2

        required:
          - sound-dai

      codec:
        type: object

        properties:
          sound-dai:
            minItems: 1
            maxItems: 8
            description: |
              DAI list with the CODEC-side DAIs connected to the above CPU-side
              DAIs and involved in this sound peripheral.

              The list is in left/right order if applicable. If there are more
              than one CPU-side DAIs (there can be two), the CODECs must be
              listed first those connected to the first CPU, then those
              connected to the second.

              In addition, on some machines with many speaker codecs, the CODECs
              are listed in this fixed order:

              J293: Left Front, Left Rear, Right Front, Right Rear
              J314: Left Woofer 1, Left Tweeter, Left Woofer 2,
                    Right Woofer 1, Right Tweeter, Right Woofer 2

        required:
          - sound-dai

    patternProperties:
      "^dai-tdm-idle-mode-[0-7]$":
        description: |
          How the CODEC at this index of the codec sound-dai list drives the
          TDM transmit slots it leaves idle. The index counts the CODECs of
          the link in list order, across both CPU-side DAIs.
        $ref: /schemas/types.yaml#/definitions/string
        enum:
          - zero
          - pulldown

      "^dai-tdm-slot-tx-idle-mask-[0-7]$":
        description: |
          Transmit slots of the CODEC at the same index that are idle and
          driven as dai-tdm-idle-mode-<n> says, one bit per slot with slot 0
          in the LSB. Only used together with dai-tdm-idle-mode-<n>.
        $ref: /schemas/types.yaml#/definitions/uint32

    required:
      - reg
      - cpu
      - codec

required:
  - compatible
  - model

additionalProperties: false

examples:
  - |
    mca: mca@9b600000 {
      compatible = "apple,t6000-mca", "apple,mca";
      reg = <0x9b600000 0x10000>,
            <0x9b500000 0x20000>;

      clocks = <&nco 0>, <&nco 1>, <&nco 2>, <&nco 3>;
      power-domains = <&ps_audio_p>, <&ps_mca0>, <&ps_mca1>,
                      <&ps_mca2>, <&ps_mca3>;
      dmas = <&admac 0>, <&admac 1>, <&admac 2>, <&admac 3>,
             <&admac 4>, <&admac 5>, <&admac 6>, <&admac 7>,
             <&admac 8>, <&admac 9>, <&admac 10>, <&admac 11>,
             <&admac 12>, <&admac 13>, <&admac 14>, <&admac 15>;
      dma-names = "tx0a", "rx0a", "tx0b", "rx0b",
                  "tx1a", "rx1a", "tx1b", "rx1b",
                  "tx2a", "rx2a", "tx2b", "rx2b",
                  "tx3a", "rx3a", "tx3b", "rx3b";

      #sound-dai-cells = <1>;
    };

    sound {
      compatible = "apple,j314-macaudio", "apple,macaudio";
      model = "MacBook Pro J314 integrated audio";

      #address-cells = <1>;
      #size-cells = <0>;

      dai-link@0 {
        reg = <0>;
        link-name = "Speakers";

        cpu {
          sound-dai = <&mca 0>, <&mca 1>;
        };
        codec {
          sound-dai = <&speaker_left_woof1>,
                      <&speaker_left_tweet>,
                      <&speaker_left_woof2>,
                      <&speaker_right_woof1>,
                      <&speaker_right_tweet>,
                      <&speaker_right_woof2>;
        };
      };

      dai-link@1 {
        reg = <1>;
        link-name = "Headphones Jack";

        cpu {
          sound-dai = <&mca 2>;
        };
        codec {
          sound-dai = <&jack_codec>;
        };
      };
    };
```

## Documentation/devicetree/bindings/sound/apple,smc-mogul.yaml
```yaml
# SPDX-License-Identifier: (GPL-2.0-only OR BSD-2-Clause)
%YAML 1.2
---
$id: http://devicetree.org/schemas/sound/apple,smc-mogul.yaml#
$schema: http://devicetree.org/meta-schemas/core.yaml#

title: Apple SMC Mogul control endpoint

maintainers:
  - Ryan Murray <81541646+RyanTheTide@users.noreply.github.com>

description: |
  Mogul control endpoint published below the SMC firmware node. Its
  control address belongs to the SMC-mediated peripheral namespace and
  must not be interpreted as an AP physical address.

properties:
  compatible:
    items:
      - enum:
          - apple,t8140-smc-mogul
      - const: apple,smc-mogul

  apple,smc:
    $ref: /schemas/types.yaml#/definitions/phandle
    description: SMC firmware transport provider.

  apple,control-address:
    $ref: /schemas/types.yaml#/definitions/uint32
    description: Peripheral address in the SMC-mediated control namespace.

required:
  - compatible
  - apple,smc
  - apple,control-address

additionalProperties: false
```
