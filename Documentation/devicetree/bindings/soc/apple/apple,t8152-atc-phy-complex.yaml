## Documentation/devicetree/bindings/soc/apple/apple,t8152-atc-phy-complex.yaml
```yaml
# SPDX-License-Identifier: (GPL-2.0-only OR BSD-2-Clause)
%YAML 1.2
---
$id: http://devicetree.org/schemas/soc/apple/apple,t8152-atc-phy-complex.yaml#
$schema: http://devicetree.org/meta-schemas/core.yaml#

title: Apple T8152 type-c phy complex

maintainers:
  - Ryan Murray <ryan@aurorasilicon.org>

description: |
  Type-C PHY complex on T8152. This describes the complete register complex,
  including auxiliary control and status apertures shared with firmware.
  It does not imply compatibility with an earlier generation's driver.
  The node remains disabled until ownership of the register windows and
  the firmware handoff have been established. Calibration, firmware and
  programming sequences are supplied separately by the boot environment.

select:
  properties:
    compatible:
      contains:
        const: apple,t8152-atc-phy-complex
  required:
    - compatible

properties:
  compatible:
    items:
      - const: apple,t8152-atc-phy-complex
      - const: apple,atc-phy-complex

  reg:
    description: Controller register apertures, in hardware interface order.
    minItems: 4
    maxItems: 4

required:
  - compatible
  - reg

additionalProperties: false
```

## Documentation/devicetree/bindings/soc/apple/apple,t8152-dptx-phy-complex.yaml
```yaml
# SPDX-License-Identifier: (GPL-2.0-only OR BSD-2-Clause)
%YAML 1.2
---
$id: http://devicetree.org/schemas/soc/apple/apple,t8152-dptx-phy-complex.yaml#
$schema: http://devicetree.org/meta-schemas/core.yaml#

title: Apple T8152 displayport transmitter phy

maintainers:
  - Ryan Murray <ryan@aurorasilicon.org>

description: |
  DisplayPort transmitter PHY on T8152. This describes the complete register complex,
  including auxiliary control and status apertures shared with firmware.
  It does not imply compatibility with an earlier generation's driver.
  The node remains disabled until ownership of the register windows and
  the firmware handoff have been established. Calibration, firmware and
  programming sequences are supplied separately by the boot environment.

select:
  properties:
    compatible:
      contains:
        const: apple,t8152-dptx-phy-complex
  required:
    - compatible

properties:
  compatible:
    items:
      - const: apple,t8152-dptx-phy-complex
      - const: apple,dptx-phy-complex

  reg:
    description: Controller register apertures, in hardware interface order.
    minItems: 2
    maxItems: 2

required:
  - compatible
  - reg

additionalProperties: false
```

## Documentation/devicetree/bindings/soc/apple/apple,t8152-error-monitor.yaml
```yaml
# SPDX-License-Identifier: (GPL-2.0-only OR BSD-2-Clause)
%YAML 1.2
---
$id: http://devicetree.org/schemas/soc/apple/apple,t8152-error-monitor.yaml#
$schema: http://devicetree.org/meta-schemas/core.yaml#

title: Apple T8152 soc error monitoring register windows

maintainers:
  - Ryan Murray <ryan@aurorasilicon.org>

description: |
  SoC error monitoring register windows on T8152. This describes the complete register complex,
  including auxiliary control and status apertures shared with firmware.
  It does not imply compatibility with an earlier generation's driver.
  The node remains disabled until ownership of the register windows and
  the firmware handoff have been established. Calibration, firmware and
  programming sequences are supplied separately by the boot environment.

select:
  properties:
    compatible:
      contains:
        const: apple,t8152-error-monitor
  required:
    - compatible

properties:
  compatible:
    items:
      - const: apple,t8152-error-monitor
      - const: apple,error-monitor

  reg:
    description: Controller register apertures, in hardware interface order.
    minItems: 112
    maxItems: 120

  interrupts:
    description: Interrupt lines wired to the system interrupt controller.
    minItems: 96
    maxItems: 96

required:
  - compatible
  - reg

additionalProperties: false
```

## Documentation/devicetree/bindings/soc/apple/apple,t8152-pmgr-complex.yaml
```yaml
# SPDX-License-Identifier: (GPL-2.0-only OR BSD-2-Clause)
%YAML 1.2
---
$id: http://devicetree.org/schemas/soc/apple/apple,t8152-pmgr-complex.yaml#
$schema: http://devicetree.org/meta-schemas/core.yaml#

title: Apple T8152 power management register complex

maintainers:
  - Ryan Murray <ryan@aurorasilicon.org>

description: |
  Power management register complex on T8152. This describes the complete register complex,
  including auxiliary control and status apertures shared with firmware.
  It does not imply compatibility with an earlier generation's driver.
  The node remains disabled until ownership of the register windows and
  the firmware handoff have been established. Calibration, firmware and
  programming sequences are supplied separately by the boot environment.

select:
  properties:
    compatible:
      contains:
        const: apple,t8152-pmgr-complex
  required:
    - compatible

properties:
  compatible:
    items:
      - const: apple,t8152-pmgr-complex
      - const: apple,pmgr-complex

  reg:
    description: Controller register apertures, in hardware interface order.
    minItems: 64
    maxItems: 64

  interrupts:
    description: Interrupt lines wired to the system interrupt controller.
    minItems: 7
    maxItems: 7

required:
  - compatible
  - reg

additionalProperties: false
```

## Documentation/devicetree/bindings/soc/apple/apple,t8152-processor-trace.yaml
```yaml
# SPDX-License-Identifier: (GPL-2.0-only OR BSD-2-Clause)
%YAML 1.2
---
$id: http://devicetree.org/schemas/soc/apple/apple,t8152-processor-trace.yaml#
$schema: http://devicetree.org/meta-schemas/core.yaml#

title: Apple T8152 cpu processor trace windows

maintainers:
  - Ryan Murray <ryan@aurorasilicon.org>

description: |
  CPU processor trace windows on T8152. This describes the complete register complex,
  including auxiliary control and status apertures shared with firmware.
  It does not imply compatibility with an earlier generation's driver.
  The node remains disabled until ownership of the register windows and
  the firmware handoff have been established. Calibration, firmware and
  programming sequences are supplied separately by the boot environment.

select:
  properties:
    compatible:
      contains:
        const: apple,t8152-processor-trace
  required:
    - compatible

properties:
  compatible:
    items:
      - const: apple,t8152-processor-trace
      - const: apple,processor-trace

  reg:
    description: Controller register apertures, in hardware interface order.
    minItems: 22
    maxItems: 22

required:
  - compatible
  - reg

additionalProperties: false
```

## Documentation/devicetree/bindings/soc/apple/apple,t8152-pwm-controller.yaml
```yaml
# SPDX-License-Identifier: (GPL-2.0-only OR BSD-2-Clause)
%YAML 1.2
---
$id: http://devicetree.org/schemas/soc/apple/apple,t8152-pwm-controller.yaml#
$schema: http://devicetree.org/meta-schemas/core.yaml#

title: Apple T8152 fixed-frequency pwm controller

maintainers:
  - Ryan Murray <ryan@aurorasilicon.org>

description: |
  Fixed-frequency PWM controller on T8152. This describes the complete register complex,
  including auxiliary control and status apertures shared with firmware.
  It does not imply compatibility with an earlier generation's driver.
  The node remains disabled until ownership of the register windows and
  the firmware handoff have been established. Calibration, firmware and
  programming sequences are supplied separately by the boot environment.

select:
  properties:
    compatible:
      contains:
        const: apple,t8152-pwm-controller
  required:
    - compatible

properties:
  compatible:
    items:
      - const: apple,t8152-pwm-controller
      - const: apple,pwm-controller

  reg:
    description: Controller register apertures, in hardware interface order.
    minItems: 1
    maxItems: 1

  interrupts:
    description: Interrupt lines wired to the system interrupt controller.
    minItems: 1
    maxItems: 1

required:
  - compatible
  - reg

additionalProperties: false
```

## Documentation/devicetree/bindings/soc/apple/apple,wireless-debug-dock.yaml
```yaml
# SPDX-License-Identifier: (GPL-2.0-only OR BSD-2-Clause)
%YAML 1.2
---
$id: http://devicetree.org/schemas/soc/apple/apple,wireless-debug-dock.yaml#
$schema: http://devicetree.org/meta-schemas/core.yaml#

title: Apple wireless debug dock endpoint

maintainers:
  - Ryan Murray <81541646+RyanTheTide@users.noreply.github.com>

description: |
  Wireless debug dock firmware endpoint. It does not describe a second
  wireless radio or transfer ownership of the existing radio.

properties:
  compatible:
    oneOf:
      - items:
          - const: apple,t8140-wireless-debug-dock
          - const: apple,wireless-debug-dock

required:
  - compatible

additionalProperties: false
```

## Documentation/devicetree/bindings/soc/apple/apple,xspmi-controller.yaml
```yaml
# SPDX-License-Identifier: (GPL-2.0-only OR BSD-2-Clause)
%YAML 1.2
---
$id: http://devicetree.org/schemas/soc/apple/apple,xspmi-controller.yaml#
$schema: http://devicetree.org/meta-schemas/core.yaml#

title: Apple external SPMI controller endpoint

maintainers:
  - Ryan Murray <81541646+RyanTheTide@users.noreply.github.com>

description: |
  External SPMI controller queue aperture, published separately from the
  non-secure bus and its SPMI proxy follower. The queue aperture is owned
  by secure firmware; the response vector is local to this transport and
  is not an AIC interrupt number.

properties:
  compatible:
    items:
      - enum:
          - apple,t8140-xspmi-controller
      - const: apple,xspmi-controller

  reg:
    maxItems: 1

  apple,response-vector:
    $ref: /schemas/types.yaml#/definitions/uint32
    description: Local response vector of the firmware transport.

required:
  - compatible
  - reg
  - apple,response-vector

additionalProperties: false
```

## Documentation/devicetree/bindings/sound/apple,alc.yaml
```yaml
# SPDX-License-Identifier: (GPL-2.0-only OR BSD-2-Clause)
%YAML 1.2
---
$id: http://devicetree.org/schemas/sound/apple,alc.yaml#
$schema: http://devicetree.org/meta-schemas/core.yaml#

title: Apple Audio Leap controller

maintainers:
  - Ryan Murray <81541646+RyanTheTide@users.noreply.github.com>

description: |
  Firmware microphone capture controller using an ADMAC instance. The
  hardware description identifies the controller instance and its DMA
  provider. Stream buffer geometry, microphone calibration and firmware
  control sequences are runtime data and must not be copied into DTS.

properties:
  compatible:
    items:
      - enum:
          - apple,t8103-alc
          - apple,t6000-alc
      - const: apple,alc

  apple,dma-controller:
    $ref: /schemas/types.yaml#/definitions/phandle
    description: ADMAC controller used by the firmware capture service.

  apple,instance-id:
    $ref: /schemas/types.yaml#/definitions/uint32
    description: Hardware controller instance number.

required:
  - compatible
  - apple,dma-controller
  - apple,instance-id

additionalProperties: false
```

## Documentation/devicetree/bindings/sound/apple,aop-audio.yaml
```yaml
# SPDX-License-Identifier: (GPL-2.0-only OR BSD-2-Clause)
%YAML 1.2
---
$id: http://devicetree.org/schemas/sound/apple,aop-audio.yaml#
$schema: http://devicetree.org/meta-schemas/core.yaml#

title: Apple AOP audio service

maintainers:
  - Ryan Murray <81541646+RyanTheTide@users.noreply.github.com>

description: |
  The service is supplied by the parent Always-On Processor. Firmware and
  calibration handoff determine its availability. It has no independent
  application-processor register window or interrupt.

select:
  properties:
    compatible:
      contains:
        enum:
          - apple,t6020-aop-audio
          - apple,t8112-aop-audio
  required:
    - compatible

properties:
  compatible:
    items:
      - enum:
          - apple,t6020-aop-audio
          - apple,t8112-aop-audio
      - const: apple,aop-audio

  dmas:
    maxItems: 1

  dma-names:
    const: dma

  apple,chassis-name:
    $ref: /schemas/types.yaml#/definitions/string
    description: Board family used to identify the audio configuration.

  apple,machine-kind:
    $ref: /schemas/types.yaml#/definitions/string
    description: Machine family used for the sound card identity.

required:
  - compatible
  - dmas
  - dma-names

additionalProperties: false
```

## Documentation/devicetree/bindings/sound/apple,audio-dart-proxy.yaml
```yaml
# SPDX-License-Identifier: (GPL-2.0-only OR BSD-2-Clause)
%YAML 1.2
---
$id: http://devicetree.org/schemas/sound/apple,audio-dart-proxy.yaml#
$schema: http://devicetree.org/meta-schemas/core.yaml#

title: Apple isolated audio DART service proxy

maintainers:
  - Ryan Murray <81541646+RyanTheTide@users.noreply.github.com>

description: |
  Isolated audio firmware endpoint and its DART streams. The firmware
  retains ownership of the stream mappings at boot.

properties:
  compatible:
    oneOf:
      - items:
          - const: apple,t8140-audio-dart-proxy
          - const: apple,audio-dart-proxy

  iommus:
    minItems: 2
    maxItems: 2

required:
  - compatible
  - iommus

additionalProperties: false
```

## Documentation/devicetree/bindings/sound/apple,audio-firmware-services.yaml
```yaml
# SPDX-License-Identifier: (GPL-2.0-only OR BSD-2-Clause)
%YAML 1.2
---
$id: http://devicetree.org/schemas/sound/apple,audio-firmware-services.yaml#
$schema: http://devicetree.org/meta-schemas/core.yaml#

title: Apple firmware audio service endpoints

maintainers:
  - Ryan Murray <81541646+RyanTheTide@users.noreply.github.com>

description: |
  Firmware audio services published separately from the active sound card.
  These endpoints identify voice-trigger, loopback, low-power microphone,
  shared microphone buffer and listening clients. A service has no AP MMIO
  aperture. DMA references describe ADMAC channel ownership, not permission
  to reset a firmware-owned audio fabric or start an audio stream.
  These endpoints remain disabled until their host client and ownership
  protocol have been qualified. No acoustic tuning or buffer contents are
  static hardware properties.

properties:
  compatible:
    oneOf:
      - items:
          - const: apple,t6041-audio-leap-loopback
          - const: apple,audio-leap-loopback
      - items:
          - const: apple,t6041-audio-listening-client
          - const: apple,audio-listening-client
      - items:
          - const: apple,t6041-audio-low-power-mic
          - const: apple,audio-low-power-mic
      - items:
          - const: apple,t6041-audio-mca-loopback
          - const: apple,audio-mca-loopback
      - items:
          - const: apple,t6041-audio-mic-buffer
          - const: apple,audio-mic-buffer
      - items:
          - const: apple,t6041-audio-voice-trigger
          - const: apple,audio-voice-trigger
      - items:
          - const: apple,t8140-audio-leap-loopback
          - const: apple,audio-leap-loopback
      - items:
          - const: apple,t8140-audio-listening-client
          - const: apple,audio-listening-client
      - items:
          - const: apple,t8140-audio-low-power-mic
          - const: apple,audio-low-power-mic
      - items:
          - const: apple,t8140-audio-mca-loopback
          - const: apple,audio-mca-loopback
      - items:
          - const: apple,t8140-audio-mic-buffer
          - const: apple,audio-mic-buffer
      - items:
          - const: apple,t8140-audio-mic-injection
          - const: apple,audio-mic-injection
      - items:
          - const: apple,t8140-audio-speaker-tap
          - const: apple,audio-speaker-tap
      - items:
          - const: apple,t8140-audio-voice-trigger
          - const: apple,audio-voice-trigger

  dmas:
    minItems: 1
    maxItems: 2

  iommus:
    minItems: 1
    maxItems: 2

required:
  - compatible

additionalProperties: false
```
