## Documentation/devicetree/bindings/sound/apple,t6000-dpaudio.yaml
```yaml
# SPDX-License-Identifier: (GPL-2.0-only OR BSD-2-Clause)
%YAML 1.2
---
$id: http://devicetree.org/schemas/sound/apple,t6000-dpaudio.yaml#
$schema: http://devicetree.org/meta-schemas/core.yaml#

title: Apple T6000, T6020 and T8112 DisplayPort audio

maintainers:
  - Ryan Murray <ryan@aurorasilicon.org>

description: |
  Each display coprocessor (DCP) provides a DisplayPort/HDMI audio service.
  Samples are fed to it by SIO DMA; the host does not access the register
  window of the interface. The graph connects this interface to port 0 of
  the display processor that owns the audio service.

select:
  properties:
    compatible:
      contains:
        enum:
          - apple,t6000-dpaudio
          - apple,t6020-dpaudio
          - apple,t8112-dpaudio
  required:
    - compatible

properties:
  compatible:
    items:
      - enum:
          - apple,t6000-dpaudio
          - apple,t6020-dpaudio
          - apple,t8112-dpaudio
      - const: apple,dpaudio

  reg:
    maxItems: 1

  dmas:
    maxItems: 1

  dma-names:
    const: tx

  power-domains:
    maxItems: 1

  ports:
    $ref: /schemas/graph.yaml#/properties/ports
    properties:
      port@0:
        $ref: /schemas/graph.yaml#/properties/port
        description: Connection to the display processor's audio service.
    required:
      - port@0

required:
  - compatible
  - reg
  - dmas
  - dma-names
  - power-domains

additionalProperties: false

examples:
  - |
    soc {
        #address-cells = <2>;
        #size-cells = <2>;

        audio-controller@39b500000 {
            compatible = "apple,t6000-dpaudio", "apple,dpaudio";
            reg = <0x3 0x9b500000 0x0 0x4000>;
            dmas = <&sio 0x64>;
            dma-names = "tx";
            power-domains = <&ps_dpa0>;

            ports {
                #address-cells = <1>;
                #size-cells = <0>;

                port@0 {
                    reg = <0>;

                    endpoint {
                        remote-endpoint = <&dcp_audio>;
                    };
                };
            };
        };
    };
```

## Documentation/devicetree/bindings/sound/apple,t6030-dpaudio.yaml
```yaml
# SPDX-License-Identifier: (GPL-2.0-only OR BSD-2-Clause)
%YAML 1.2
---
$id: http://devicetree.org/schemas/sound/apple,t6030-dpaudio.yaml#
$schema: http://devicetree.org/meta-schemas/core.yaml#

title: Apple T6030, T6041, T6050 and T8140 DisplayPort audio

maintainers:
  - Ryan Murray <ryan@aurorasilicon.org>

description: |
  The external display processor provides a DisplayPort/HDMI audio service.
  Its DisplayPort audio interface has no application-processor registers.
  Samples arrive through SIO, or on T6050 through the display engine's own
  ADMAC, and the graph connects this interface to port 0 of the display
  processor that owns the audio service.

  T6041 interfaces remain disabled until a generation-specific SIO firmware
  backend and loader handoff are available and display audio is qualified.

select:
  properties:
    compatible:
      contains:
        enum:
          - apple,t6030-dpaudio
          - apple,t6041-dpaudio
          - apple,t6050-dpaudio
          - apple,t8140-dpaudio
  required:
    - compatible

properties:
  compatible:
    items:
      - enum:
          - apple,t6030-dpaudio
          - apple,t6041-dpaudio
          - apple,t6050-dpaudio
          - apple,t8140-dpaudio
      - const: apple,dpaudio

  dmas:
    maxItems: 1

  dma-names:
    const: tx

  power-domains:
    maxItems: 1

  post-init-providers: true

  ports:
    $ref: /schemas/graph.yaml#/properties/ports
    properties:
      port@0:
        $ref: /schemas/graph.yaml#/properties/port
        description: Connection to the display processor's audio service.
    required:
      - port@0

required:
  - compatible
  - dmas
  - dma-names
  - power-domains
  - ports

additionalProperties: false
```

## Documentation/devicetree/bindings/sound/apple,t6041-aop-audio.yaml
```yaml
# SPDX-License-Identifier: (GPL-2.0-only OR BSD-2-Clause)
%YAML 1.2
---
$id: http://devicetree.org/schemas/sound/apple,t6041-aop-audio.yaml#
$schema: http://devicetree.org/meta-schemas/core.yaml#

title: Apple T6041 and T8132 AOP audio

maintainers:
  - Jonathan Goyvaerts <jonathan.goyvaerts@gmail.com>

description: |
  The Always-On Processor on Apple T6041 and T8132 SoCs runs the machine's audio
  streams in its firmware: the microphone array, the internal speakers with
  their voltage and current sense, and the 3.5 mm headset jack in both
  directions. This node is a child of the AOP node and names the ADMAC
  channels the host moves each stream's data over while the firmware runs
  its serializer. The parent AOP binding describes the firmware transport.

  The speaker and headset jack channels are optional: a node without them has
  no speaker or jack streams.

# Only select T6041 nodes: other AOP audio nodes carry the
# apple,t6030-aop-audio fallback too and have a different set of streams.
select:
  properties:
    compatible:
      contains:
        const: apple,t6041-aop-audio
  required:
    - compatible

allOf:
  - $ref: dai-common.yaml#

properties:
  compatible:
    oneOf:
      - items:
          - const: apple,t6041-aop-audio
          - const: apple,t6030-aop-audio
      - items:
          - const: apple,t8132-aop-audio
          - const: apple,t6041-aop-audio
          - const: apple,t6030-aop-audio

  dmas:
    description:
      The ADMAC channels named in dma-names, in that order. "dma" is the
      microphone array input, "spkr" the internal speaker output, "sense" the
      speakers' voltage and current sense input, "cout" the headset jack output
      and "cin" the headset microphone input.
    minItems: 1
    maxItems: 5

  dma-names:
    oneOf:
      - description: The microphones only
        items:
          - const: dma
      - description: The microphones and the headset jack
        items:
          - const: dma
          - const: cout
          - const: cin
      - description: The microphones and the speakers
        items:
          - const: dma
          - const: spkr
          - const: sense
      - description: The microphones, the speakers and the headset jack
        items:
          - const: dma
          - const: spkr
          - const: sense
          - const: cout
          - const: cin

  "#sound-dai-cells":
    const: 1
    description: |
      AOP audio DAI identifier:
        0, 1, 2 - the speaker card's front-ends: unused, the speakers and
                  their sense
        3 - the internal speaker back-end
        4 - the headset jack back-end

  apple,chassis-name:
    $ref: /schemas/types.yaml#/definitions/string
    description:
      Chassis identifier used to name the microphone sound card.

  apple,machine-kind:
    $ref: /schemas/types.yaml#/definitions/string
    description:
      Human-readable machine name used in the microphone sound card's
      description.

required:
  - compatible
  - dmas
  - dma-names
  - "#sound-dai-cells"
  - apple,chassis-name
  - apple,machine-kind

unevaluatedProperties: false

examples:
  - |
    aop {
        audio {
            compatible = "apple,t6041-aop-audio", "apple,t6030-aop-audio";
            apple,chassis-name = "J616";
            apple,machine-kind = "MacBook Pro";
            dmas = <&admac0 1>, <&admac1 0>, <&admac1 1>,
                   <&admac1 4>, <&admac1 5>;
            dma-names = "dma", "spkr", "sense", "cout", "cin";
            #sound-dai-cells = <1>;
        };
    };
```

## Documentation/devicetree/bindings/sound/apple,t8152-aop-audio.yaml
```yaml
# SPDX-License-Identifier: (GPL-2.0-only OR BSD-2-Clause)
%YAML 1.2
---
$id: http://devicetree.org/schemas/sound/apple,t8152-aop-audio.yaml#
$schema: http://devicetree.org/meta-schemas/core.yaml#

title: Apple T8152-generation AOP audio

maintainers:
  - Ryan Murray <81541646+RyanTheTide@users.noreply.github.com>

description:
  The audio service of the T8142, T8152 and T6050 Always-On Processor, a
  child of the AOP node. It names the ADMAC channels of the headset jack, the
  speaker and the speaker amplifiers' voltage and current sense, and where
  the board has one the high-quality microphone array, plus the power
  domains the host enables while they run.

allOf:
  - $ref: dai-common.yaml#

properties:
  compatible:
    oneOf:
      - items:
          - const: apple,t8142-aop-audio
          - const: apple,t8152-aop-audio
      - const: apple,t6050-aop-audio
      - const: apple,t8152-aop-audio

  dmas:
    minItems: 4
    items:
      - description: Headset jack output
      - description: Headset microphone input
      - description: Internal speaker output
      - description: Speaker amplifier sense input
      - description: High-quality microphone array input

  dma-names:
    minItems: 4
    items:
      - const: cout
      - const: cin
      - const: spkr
      - const: sense
      - const: hpai

  power-domains:
    minItems: 1
    maxItems: 9

  power-domain-names:
    minItems: 1
    maxItems: 9

  '#sound-dai-cells':
    const: 1

  apple,chassis-name:
    $ref: /schemas/types.yaml#/definitions/string
    description: Board name used for the microphone card identity.

  apple,machine-kind:
    $ref: /schemas/types.yaml#/definitions/string
    description: Machine family used for the sound card identity.

  apple,speaker-amps:
    $ref: /schemas/types.yaml#/definitions/uint32
    enum: [4, 6]
    description:
      Number of speaker amplifiers on the firmware's speaker stream (one
      playback slot and a voltage/current sense pair each), when it differs
      from the SoC's default (T8142 - 4).

required:
  - compatible
  - dmas
  - dma-names
  - '#sound-dai-cells'

unevaluatedProperties: false
```

## Documentation/devicetree/bindings/spi/apple,qspi.yaml
```yaml
# SPDX-License-Identifier: (GPL-2.0-only OR BSD-2-Clause)
%YAML 1.2
---
$id: http://devicetree.org/schemas/spi/apple,qspi.yaml#
$schema: http://devicetree.org/meta-schemas/core.yaml#

title: Apple ARM SoC QSPIMC controller

maintainers:
  - Ryan Murray <ryan@aurorasilicon.org>

description: |
  Apple QSPIMC is a SPI-memory-only controller with a packed command FIFO.
  It is distinct from the ordinary Apple SPIMC controller despite serving a
  similar set of SPI NOR devices.

allOf:
  - $ref: spi-controller.yaml#

properties:
  compatible:
    oneOf:
      - enum:
          - apple,t8122-qspi
          - apple,t8132-qspi
          - apple,t6041-qspi
          - apple,t8140-qspi
      - items:
          - enum:
              - apple,t6030-qspi
              - apple,t6031-qspi
              - apple,t8122-qspi
          - const: apple,qspi
      - items:
          - enum:
              - apple,t6050-qspi
              - apple,t8142-qspi
              - apple,t8152-qspi
          - const: apple,t8140-qspi

  reg:
    maxItems: 1

  clocks:
    maxItems: 1

  interrupts:
    maxItems: 1

  power-domains:
    maxItems: 1

required:
  - compatible
  - reg
  - clocks
  - interrupts

unevaluatedProperties: false

examples:
  - |
    #include <dt-bindings/interrupt-controller/apple-aic.h>
    #include <dt-bindings/interrupt-controller/irq.h>

    soc {
      #address-cells = <2>;
      #size-cells = <2>;

      spi@385110000 {
        compatible = "apple,t8140-qspi";
        reg = <0x3 0x85110000 0x0 0x4800>;
        interrupt-parent = <&aic>;
        interrupts = <AIC_IRQ 1106 IRQ_TYPE_LEVEL_HIGH>;
        clocks = <&clk_200m>;
        #address-cells = <1>;
        #size-cells = <0>;
      };
    };
```
