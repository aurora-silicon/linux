## Documentation/devicetree/bindings/soc/apple/apple,gpu-coproc.yaml
```yaml
# SPDX-License-Identifier: (GPL-2.0-only OR BSD-2-Clause)
%YAML 1.2
---
$id: "http://devicetree.org/schemas/soc/apple/apple,gpu-coproc.yaml#"
$schema: "http://devicetree.org/meta-schemas/core.yaml#"
title: "Apple gpu coproc hardware resources"
maintainers:
  - "Ryan Murray <81541646+RyanTheTide@users.noreply.github.com>"
description: "T6050 native resource description. Firmware ownership, backend support and enables require separate qualification. This variant remains disabled and contains no programming sequences or firmware data."
properties:
  compatible:
    items:
      -
        const: "apple,t6050-gpu-coproc"
      -
        const: "apple,gpu-coproc"
  status:
    const: "disabled"
  reg:
    minItems: 2
    maxItems: 2
    description: "Native register apertures in hardware-interface order, including shared auxiliary views."
  interrupts:
    minItems: 4
    maxItems: 4
  power-domains:
    maxItems: 1
  clocks:
    maxItems: 1
required:
  - "compatible"
  - "reg"
  - "status"
  - "interrupts"
  - "power-domains"
  - "clocks"
additionalProperties: false
```

## Documentation/devicetree/bindings/soc/apple/apple,hibernation-watchdog.yaml
```yaml
# SPDX-License-Identifier: (GPL-2.0-only OR BSD-2-Clause)
%YAML 1.2
---
$id: http://devicetree.org/schemas/soc/apple/apple,hibernation-watchdog.yaml#
$schema: http://devicetree.org/meta-schemas/core.yaml#
title: Apple isolated hibernation watchdog
maintainers:
  - Ryan Murray <81541646+RyanTheTide@users.noreply.github.com>
select:
  properties:
    compatible:
      allOf:
        -
          contains:
            enum:
              - apple,t8142-hibernation-watchdog
        -
          contains:
            const: apple,hibernation-watchdog
  required:
    - compatible
description: |
  Apple isolated hibernation watchdog. Initial resource description for an unsupported firmware/backend
  layout. Register, IRQ and DMA topology can be recorded before a driver exists. This form must stay
  disabled; it does not substitute for the enabled driver contract or supply firmware, calibration,
  programming sequences or unresolved providers.
properties:
  compatible:
    items:
      -
        enum:
          - apple,t8142-hibernation-watchdog
      -
        const: apple,hibernation-watchdog
  status:
    const: disabled
  reg:
    description: Register apertures of the complete hardware complex, in hardware interface order.
    maxItems: 1
  power-domains:
    description: Physical power and combined clock-gate dependencies.
    minItems: 1
    maxItems: 8
required:
  - compatible
  - reg
  - status
additionalProperties: false
```

## Documentation/devicetree/bindings/soc/apple/apple,hid-transport-mux.yaml
```yaml
# SPDX-License-Identifier: (GPL-2.0-only OR BSD-2-Clause)
%YAML 1.2
---
$id: http://devicetree.org/schemas/soc/apple/apple,hid-transport-mux.yaml#
$schema: http://devicetree.org/meta-schemas/core.yaml#

title: Apple HID transport multiplexer

maintainers:
  - Ryan Murray <81541646+RyanTheTide@users.noreply.github.com>

description: |
  Firmware HID transport multiplexer between the MTP and AOP services.
  The hardware description provides no independent register aperture.

properties:
  compatible:
    oneOf:
      - items:
          - const: apple,t6041-hid-transport-mux
          - const: apple,hid-transport-mux
      - items:
          - const: apple,t8140-hid-transport-mux
          - const: apple,hid-transport-mux

required:
  - compatible

additionalProperties: false
```

## Documentation/devicetree/bindings/soc/apple/apple,isp-secure-proxy.yaml
```yaml
# SPDX-License-Identifier: (GPL-2.0-only OR BSD-2-Clause)
%YAML 1.2
---
$id: "http://devicetree.org/schemas/soc/apple/apple,isp-secure-proxy.yaml#"
$schema: "http://devicetree.org/meta-schemas/core.yaml#"
title: "Apple isolated image processor register proxy"
maintainers:
  - "Ryan Murray <81541646+RyanTheTide@users.noreply.github.com>"
select:
  properties:
    compatible:
      allOf:
        -
          contains:
            enum:
              - "apple,t8152-isp-secure-proxy"
        -
          contains:
            const: "apple,isp-secure-proxy"
  required:
    - "compatible"
description: "Apple isolated image processor register proxy. Initial resource description for an unsupported firmware/backend layout. Register, IRQ and DMA topology can be recorded before a driver exists. This form must stay disabled; it does not substitute for the enabled driver contract or supply firmware, calibration, programming sequences or unresolved providers."
properties:
  compatible:
    items:
      -
        enum:
          - "apple,t8152-isp-secure-proxy"
      -
        const: "apple,isp-secure-proxy"
  status:
    const: "disabled"
  reg:
    description: "Register apertures of the complete hardware complex, in hardware interface order."
    minItems: 3
    maxItems: 3
required:
  - "compatible"
  - "reg"
  - "status"
additionalProperties: false
```

## Documentation/devicetree/bindings/soc/apple/apple,m2-aic-timebase.yaml
```yaml
# SPDX-License-Identifier: (GPL-2.0-only OR BSD-2-Clause)
%YAML 1.2
---
$id: http://devicetree.org/schemas/soc/apple/apple,m2-aic-timebase.yaml#
$schema: http://devicetree.org/meta-schemas/core.yaml#

title: Apple M2 generation interrupt timebase

maintainers:
  - Ryan Murray <81541646+RyanTheTide@users.noreply.github.com>

description: |
  Interrupt timebase resources on M2 generation SoCs. The register apertures
  follow hardware resource order. Firmware configuration and tuning are
  supplied by the bootloader and are not part of this binding. Unqualified
  instances must remain disabled.

select:
  properties:
    compatible:
      contains:
        enum:
          - apple,t6020-aic-timebase
          - apple,t6021-aic-timebase
          - apple,t6022-aic-timebase
          - apple,t8112-aic-timebase
  required:
    - compatible

properties:
  compatible:
    items:
      - enum:
          - apple,t6020-aic-timebase
          - apple,t6021-aic-timebase
          - apple,t6022-aic-timebase
          - apple,t8112-aic-timebase
      - const: apple,aic-timebase

  reg:
    maxItems: 1

required:
  - compatible
  - reg

additionalProperties: false
```

## Documentation/devicetree/bindings/soc/apple/apple,m2-mcc.yaml
```yaml
# SPDX-License-Identifier: (GPL-2.0-only OR BSD-2-Clause)
%YAML 1.2
---
$id: http://devicetree.org/schemas/soc/apple/apple,m2-mcc.yaml#
$schema: http://devicetree.org/meta-schemas/core.yaml#

title: Apple M2 generation memory cache controller

maintainers:
  - Ryan Murray <81541646+RyanTheTide@users.noreply.github.com>

description: |
  Memory cache controller resources on M2 generation SoCs. The register apertures
  follow hardware resource order. Firmware configuration and tuning are
  supplied by the bootloader and are not part of this binding. Unqualified
  instances must remain disabled.

select:
  properties:
    compatible:
      contains:
        enum:
          - apple,t8112-mcc
  required:
    - compatible

properties:
  compatible:
    items:
      - enum:
          - apple,t8112-mcc
      - const: apple,mcc

  reg:
    maxItems: 5

required:
  - compatible
  - reg

additionalProperties: false
```

## Documentation/devicetree/bindings/soc/apple/apple,m3-error-handler.yaml
```yaml
# SPDX-License-Identifier: (GPL-2.0-only OR BSD-2-Clause)
%YAML 1.2
---
$id: http://devicetree.org/schemas/soc/apple/apple,m3-error-handler.yaml#
$schema: http://devicetree.org/meta-schemas/core.yaml#

title: Apple M3 family fabric error reporting interface

maintainers:
  - Ryan Murray <81541646+RyanTheTide@users.noreply.github.com>

description: |
  Hardware resources of the M3 family fabric error reporting interface.
  The interface is described for discovery and must remain disabled until
  its ownership, initialization and shutdown are supported. Register windows
  are listed in hardware resource order; firmware configuration and tuning
  data are supplied by the boot firmware rather than this binding.

select:
  properties:
    compatible:
      contains:
        enum:
          - apple,t8122-error-handler
          - apple,t6030-error-handler
          - apple,t6031-error-handler
  required:
    - compatible

properties:
  compatible:
    items:
      - enum:
          - apple,t8122-error-handler
          - apple,t6030-error-handler
          - apple,t6031-error-handler
      - const: apple,error-handler

  reg:
    minItems: 19
    maxItems: 123

  interrupts:
    minItems: 39
    maxItems: 159

  power-domains:
    minItems: 1
    maxItems: 1

required:
  - compatible
  - reg
  - interrupts

additionalProperties: false
```
