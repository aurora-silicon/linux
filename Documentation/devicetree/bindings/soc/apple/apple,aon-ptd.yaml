## Documentation/devicetree/bindings/soc/apple/apple,aon-ptd.yaml
```yaml
# SPDX-License-Identifier: (GPL-2.0-only OR BSD-2-Clause)
%YAML 1.2
---
$id: http://devicetree.org/schemas/soc/apple/apple,aon-ptd.yaml#
$schema: http://devicetree.org/meta-schemas/core.yaml#

title: Apple always-on power telemetry interrupt router

maintainers:
  - Ryan Murray <81541646+RyanTheTide@users.noreply.github.com>

description: |
  Always-on power telemetry register banks and upstream interrupts. The
  firmware owns the telemetry data and interrupt routing at boot.

select:
  properties:
    compatible:
      contains:
        enum:
          - apple,t6031-aon-ptd
          - apple,t6032-aon-ptd
          - apple,t6041-aon-ptd
          - apple,t8132-aon-ptd
          - apple,t8140-aon-ptd
          - apple,t8142-aon-ptd
          - apple,t8152-aon-ptd
          - apple,t6050-aon-ptd
  required:
    - compatible

properties:
  compatible: true

allOf:
  - if:
      properties:
        compatible:
          contains:
            enum:
              - apple,t8132-aon-ptd
      required:
        - compatible
    then:
      properties:
        compatible:
          items:
            - enum:
                - apple,t8132-aon-ptd
            - const: apple,aon-ptd

        reg:
          minItems: 4
          maxItems: 4

        interrupts:
          minItems: 32
          maxItems: 32

        '#address-cells':
          const: 0
        '#interrupt-cells':
          const: 1
        interrupt-controller: true

      required:
        - compatible
        - reg
        - interrupts
        - interrupt-controller
        - '#interrupt-cells'
        - '#address-cells'
    else:
      allOf:
        - if:
            properties:
              compatible:
                contains:
                  enum:
                    - apple,t6032-aon-ptd
            required:
              - compatible
          then:
            properties:
              compatible:
                items:
                  - enum:
                      - apple,t6032-aon-ptd
                  - const: apple,aon-ptd

              reg:
                minItems: 4
                maxItems: 4

              interrupts:
                minItems: 32
                maxItems: 32

              '#address-cells':
                const: 0
              '#interrupt-cells':
                const: 1
              interrupt-controller: true

            required:
              - compatible
              - reg
              - interrupts
              - interrupt-controller
              - '#interrupt-cells'
              - '#address-cells'
          else:
            properties:
              compatible:
                items:
                  - enum:
                      - apple,t6031-aon-ptd
                      - apple,t6041-aon-ptd
                      - apple,t8140-aon-ptd
                      - apple,t8142-aon-ptd
                      - apple,t8152-aon-ptd
                      - apple,t6050-aon-ptd
                  - const: apple,aon-ptd

              reg:
                minItems: 4
                maxItems: 4
                description: Register apertures in hardware-description order.

              interrupts:
                minItems: 32
                maxItems: 32

              interrupt-controller: true

              '#interrupt-cells':
                description: Firmware telemetry source identifier, plus flags on T8140.
                enum: [1, 2]

              '#address-cells':
                const: 0

            required:
              - compatible
              - reg
              - interrupts
              - interrupt-controller
              - '#interrupt-cells'

            additionalProperties: false

unevaluatedProperties: false
```

## Documentation/devicetree/bindings/soc/apple/apple,aop.yaml
```yaml
# SPDX-License-Identifier: (GPL-2.0-only OR BSD-2-Clause)
%YAML 1.2
---
$id: http://devicetree.org/schemas/soc/apple/apple,aop.yaml#

$schema: http://devicetree.org/meta-schemas/core.yaml#

title: Apple Always-On Processor

maintainers:
  - Ryan Murray <81541646+RyanTheTide@users.noreply.github.com>

description: |
  The Always-On Processor runs firmware that owns audio and sensor services.
  The host uses an RTKit mailbox and a DART stream to exchange messages and
  buffers. Service nodes do not have independent host MMIO or interrupts.

select:
  anyOf:
    -
      properties:
        compatible:
          items:
            - enum:
                - apple,t6020-aop
                - apple,t8112-aop
      required:
        - compatible
    -
      properties:
        compatible:
          items:
            -
              const: "apple,t6050-aop"
            -
              const: "apple,t8152-aop"
      required:
        - "compatible"

properties:
  "compatible": true
  "reg": true
  mboxes:
    maxItems: 1
  mbox-names:
    const: mbox
  "iommus": true
  audio:
    $ref: /schemas/sound/apple,aop-audio.yaml#
  als:
    $ref: /schemas/iio/light/apple,aop-als.yaml#
  las:
    $ref: /schemas/iio/position/apple,aop-las.yaml#
  accel:
    $ref: /schemas/iio/imu/apple,aop-motion.yaml#
  gyro:
    $ref: /schemas/iio/imu/apple,aop-motion.yaml#
  reg-names: true
  nonposted-mmio: true

additionalProperties: true

allOf:
  - if:
      properties:
        compatible:
          items:
            -
              const: "apple,t6050-aop"
            -
              const: "apple,t8152-aop"
      required:
        - "compatible"
    then:
      properties:
        compatible:
          items:
            -
              const: "apple,t6050-aop"
            -
              const: "apple,t8152-aop"
        reg:
          minItems: 2
          maxItems: 2
        reg-names:
          minItems: 2
          maxItems: 2
        mboxes:
          maxItems: 1
        mbox-names:
          const: "mbox"
        iommus:
          maxItems: 1
        nonposted-mmio: true
        audio:
          $ref: "/schemas/sound/apple,aop-audio.yaml#"
      required:
        - "compatible"
        - "reg"
        - "reg-names"
        - "mboxes"
        - "mbox-names"
        - "iommus"
      additionalProperties: false
    else:
      properties:
        compatible:
          enum:
            - apple,t6020-aop
            - apple,t8112-aop

        reg:
          items:
            - description: Shared SRAM
            - description: Coprocessor registers

        mboxes:
          maxItems: 1

        mbox-names:
          const: mbox

        iommus:
          maxItems: 1

        audio:
          $ref: /schemas/sound/apple,aop-audio.yaml#

        als:
          $ref: /schemas/iio/light/apple,aop-als.yaml#

        las:
          $ref: /schemas/iio/position/apple,aop-las.yaml#

        accel:
          $ref: /schemas/iio/imu/apple,aop-motion.yaml#

        gyro:
          $ref: /schemas/iio/imu/apple,aop-motion.yaml#
      required:
        - compatible
        - reg
        - mboxes
        - mbox-names
        - iommus
      additionalProperties: false
```

## Documentation/devicetree/bindings/soc/apple/apple,aop2.yaml
```yaml
# SPDX-License-Identifier: (GPL-2.0-only OR BSD-2-Clause)
%YAML 1.2
---
$id: http://devicetree.org/schemas/soc/apple/apple,aop2.yaml#
$schema: http://devicetree.org/meta-schemas/core.yaml#

title: Apple secondary always-on processor

maintainers:
  - Ryan Murray <81541646+RyanTheTide@users.noreply.github.com>

description: |
  Secondary always-on processor register banks and transport interrupts.
  The processor uses a distinct stream in the primary AOP DART.

properties:
  compatible:
    oneOf:
      - items:
          - enum:
              - apple,t6050-aop2
              - apple,t8140-aop2
          - const: apple,aop2

  reg:
    minItems: 3
    maxItems: 3
    description: Register apertures in hardware-description order.

  interrupts:
    minItems: 4
    maxItems: 4

  power-domains:
    maxItems: 1

  iommus:
    maxItems: 1

required:
  - compatible
  - reg
  - interrupts
  - iommus

allOf:
  - if:
      properties:
        compatible:
          contains:
            const: apple,t8140-aop2
    then:
      required:
        - power-domains

additionalProperties: false
```

## Documentation/devicetree/bindings/soc/apple/apple,atc-dpxbar.yaml
```yaml
# SPDX-License-Identifier: (GPL-2.0-only OR BSD-2-Clause)
%YAML 1.2
---
$id: "http://devicetree.org/schemas/soc/apple/apple,atc-dpxbar.yaml#"
$schema: "http://devicetree.org/meta-schemas/core.yaml#"
title: "Apple type-c displayport crossbar"
maintainers:
  - "Ryan Murray <81541646+RyanTheTide@users.noreply.github.com>"
select:
  properties:
    compatible:
      allOf:
        -
          contains:
            enum:
              - "apple,t8142-atc-dpxbar"
              - "apple,t8152-atc-dpxbar"
              - "apple,t6050-atc-dpxbar"
        -
          contains:
            const: "apple,atc-dpxbar"
  required:
    - "compatible"
description: "Apple type-c displayport crossbar. Initial resource description for an unsupported firmware/backend layout. Register, IRQ and DMA topology can be recorded before a driver exists. This form must stay disabled; it does not substitute for the enabled driver contract or supply firmware, calibration, programming sequences or unresolved providers."
properties:
  compatible:
    items:
      -
        enum:
          - "apple,t8142-atc-dpxbar"
          - "apple,t8152-atc-dpxbar"
          - "apple,t6050-atc-dpxbar"
      -
        const: "apple,atc-dpxbar"
  status:
    const: "disabled"
  reg:
    description: "Register apertures of the complete hardware complex, in hardware interface order."
    maxItems: 1
required:
  - "compatible"
  - "reg"
  - "status"
additionalProperties: false
```

## Documentation/devicetree/bindings/soc/apple/apple,audio-dma-proxy.yaml
```yaml
# SPDX-License-Identifier: (GPL-2.0-only OR BSD-2-Clause)
%YAML 1.2
---
$id: http://devicetree.org/schemas/soc/apple/apple,audio-dma-proxy.yaml#
$schema: http://devicetree.org/meta-schemas/core.yaml#
title: Apple isolated audio dma proxy
maintainers:
  - Ryan Murray <81541646+RyanTheTide@users.noreply.github.com>
select:
  properties:
    compatible:
      allOf:
        -
          contains:
            enum:
              - apple,t8142-audio-dma-proxy
              - apple,t8152-audio-dma-proxy
              - apple,t6050-audio-dma-proxy
        -
          contains:
            const: apple,audio-dma-proxy
  required:
    - compatible
description: |
  Apple isolated audio dma proxy. Initial resource description for an unsupported firmware/backend
  layout. Register, IRQ and DMA topology can be recorded before a driver exists. This form must stay
  disabled; it does not substitute for the enabled driver contract or supply firmware, calibration,
  programming sequences or unresolved providers.
properties:
  compatible:
    items:
      -
        enum:
          - apple,t8142-audio-dma-proxy
          - apple,t8152-audio-dma-proxy
          - apple,t6050-audio-dma-proxy
      -
        const: apple,audio-dma-proxy
  status:
    const: disabled
  reg:
    description: Register apertures of the complete hardware complex, in hardware interface order.
    maxItems: 1
required:
  - compatible
  - reg
  - status
additionalProperties: false
```

## Documentation/devicetree/bindings/soc/apple/apple,cluster-pwrgate.yaml
```yaml
# SPDX-License-Identifier: (GPL-2.0-only OR BSD-2-Clause)
%YAML 1.2
---
$id: http://devicetree.org/schemas/soc/apple/apple,cluster-pwrgate.yaml#
$schema: http://devicetree.org/meta-schemas/core.yaml#

title: Apple SoC CPU cluster power-gate enables

maintainers:
  - Diljit Singh <hey@djdev.me>

description: |
  One PMGR word per CPU cluster, whose top bit lets the cluster's cores power
  down in WFI. A core that PMGR powers on comes up allowed to, but the boot CPU
  was started by the boot ROM and only follows the word, which the boot loader
  may leave clear. The words are set early in boot, in the order listed.

properties:
  compatible:
    items:
      - enum:
          - apple,t8132-cluster-pwrgate
          - apple,t8140-cluster-pwrgate
      - const: apple,cluster-pwrgate

  reg:
    minItems: 1
    maxItems: 8
    description: One word per cluster.

required:
  - compatible
  - reg

additionalProperties: false

examples:
  - |
    soc {
        #address-cells = <2>;
        #size-cells = <2>;

        power-gate@300724000 {
            compatible = "apple,t8140-cluster-pwrgate", "apple,cluster-pwrgate";
            reg = <0x3 0x00724000 0x0 0x4>,
                  <0x3 0x00724040 0x0 0x4>;
        };
    };
```

## Documentation/devicetree/bindings/soc/apple/apple,cpu-coresight.yaml
```yaml
# SPDX-License-Identifier: (GPL-2.0-only OR BSD-2-Clause)
%YAML 1.2
---
$id: http://devicetree.org/schemas/soc/apple/apple,cpu-coresight.yaml#
$schema: http://devicetree.org/meta-schemas/core.yaml#

title: Apple CPU core CoreSight register window

maintainers:
  - Ryan Murray <81541646+RyanTheTide@users.noreply.github.com>

description: |
  Each CPU core of Apple SoCs has a memory-mapped debug window made of
  64 KiB slots: the Arm external debug registers, the cross-trigger
  interface, the performance monitor and, in the fourth slot, a debug
  wrapper register that controls halting the core. One node describes the
  window of one core.

properties:
  compatible:
    items:
      - enum:
          - apple,t6000-cpu-coresight
          - apple,t8112-cpu-coresight
          - apple,t8140-cpu-coresight
      - const: apple,cpu-coresight

  reg:
    maxItems: 1
    description: The external debug slot up to and including the debug
      wrapper registers.

  cpu:
    $ref: /schemas/types.yaml#/definitions/phandle
    description: The CPU core this window belongs to.

required:
  - compatible
  - reg
  - cpu

additionalProperties: false

examples:
  - |
    cpus {
        #address-cells = <2>;
        #size-cells = <0>;

        cpu_e0: cpu@0 {
            compatible = "apple,blizzard";
            device_type = "cpu";
            reg = <0x0 0x0>;
        };
    };

    soc {
        #address-cells = <2>;
        #size-cells = <2>;

        cpu-debug@210010000 {
            compatible = "apple,t8112-cpu-coresight", "apple,cpu-coresight";
            reg = <0x2 0x10010000 0x0 0x300c8>;
            cpu = <&cpu_e0>;
        };
    };
...
```

## Documentation/devicetree/bindings/soc/apple/apple,cpu-debug.yaml
```yaml
# SPDX-License-Identifier: (GPL-2.0-only OR BSD-2-Clause)
%YAML 1.2
---
$id: http://devicetree.org/schemas/soc/apple/apple,cpu-debug.yaml#
$schema: http://devicetree.org/meta-schemas/core.yaml#

title: Apple processor debug interface

maintainers:
  - Ryan Murray <81541646+RyanTheTide@users.noreply.github.com>

description: |
  Processor debug register apertures. Access ownership must be established
  before a debugger accesses this block.

properties:
  compatible:
    oneOf:
      - items:
          - const: apple,t6041-cpu-debug
          - const: apple,cpu-debug

  reg:
    minItems: 2
    maxItems: 2
    description: Register apertures in hardware-description order.

  interrupts:
    maxItems: 1

required:
  - compatible
  - reg
  - interrupts

additionalProperties: false
```
