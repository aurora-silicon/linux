## Documentation/devicetree/bindings/soc/apple/apple,dart-tlbi.yaml
```yaml
# SPDX-License-Identifier: (GPL-2.0-only OR BSD-2-Clause)
%YAML 1.2
---
$id: "http://devicetree.org/schemas/soc/apple/apple,dart-tlbi.yaml#"
$schema: "http://devicetree.org/meta-schemas/core.yaml#"
title: "Apple iommu translation invalidation aperture"
maintainers:
  - "Ryan Murray <81541646+RyanTheTide@users.noreply.github.com>"
select:
  properties:
    compatible:
      allOf:
        -
          contains:
            enum:
              - "apple,t8152-dart-tlbi"
        -
          contains:
            const: "apple,dart-tlbi"
  required:
    - "compatible"
description: "Apple iommu translation invalidation aperture. Initial resource description for an unsupported firmware/backend layout. Register, IRQ and DMA topology can be recorded before a driver exists. This form must stay disabled; it does not substitute for the enabled driver contract or supply firmware, calibration, programming sequences or unresolved providers."
properties:
  compatible:
    items:
      -
        enum:
          - "apple,t8152-dart-tlbi"
      -
        const: "apple,dart-tlbi"
  status:
    const: "disabled"
  reg:
    description: "Register apertures of the complete hardware complex, in hardware interface order."
    maxItems: 1
required:
  - "compatible"
  - "reg"
  - "status"
additionalProperties: false
```

## Documentation/devicetree/bindings/soc/apple/apple,debug-dock.yaml
```yaml
# SPDX-License-Identifier: (GPL-2.0-only OR BSD-2-Clause)
%YAML 1.2
---
$id: http://devicetree.org/schemas/soc/apple/apple,debug-dock.yaml#
$schema: http://devicetree.org/meta-schemas/core.yaml#

title: Apple debug dock connection detector

maintainers:
  - Ryan Murray <81541646+RyanTheTide@users.noreply.github.com>

description: |
  Debug dock connection detector register and interrupt resources.

properties:
  compatible:
    oneOf:
      - items:
          - const: apple,t8140-debug-dock
          - const: apple,debug-dock

  reg:
    maxItems: 1

  interrupts:
    minItems: 2
    maxItems: 2

required:
  - compatible
  - reg
  - interrupts

additionalProperties: false
```

## Documentation/devicetree/bindings/soc/apple/apple,debug-port.yaml
```yaml
# SPDX-License-Identifier: (GPL-2.0-only OR BSD-2-Clause)
%YAML 1.2
---
$id: http://devicetree.org/schemas/soc/apple/apple,debug-port.yaml#
$schema: http://devicetree.org/meta-schemas/core.yaml#

title: Apple auxiliary on-chip debug port

maintainers:
  - Ryan Murray <81541646+RyanTheTide@users.noreply.github.com>

description: |
  Auxiliary on-chip debug port. Firmware describes the port separately
  from the processor debug MMIO apertures. Pin ownership and the debug
  transport must be established before this endpoint is used.

properties:
  compatible:
    oneOf:
      - items:
          - const: apple,t6041-debug-port
          - const: apple,debug-port
      - items:
          - const: apple,t8140-debug-port
          - const: apple,debug-port

  swclk-gpios:
    maxItems: 1
    description: Serial wire clock pin.

  swdio-gpios:
    maxItems: 1
    description: Bidirectional serial wire data pin.

required:
  - compatible

additionalProperties: false
```

## Documentation/devicetree/bindings/soc/apple/apple,display-engine.yaml
```yaml
# SPDX-License-Identifier: (GPL-2.0-only OR BSD-2-Clause)
%YAML 1.2
---
$id: http://devicetree.org/schemas/soc/apple/apple,display-engine.yaml#
$schema: http://devicetree.org/meta-schemas/core.yaml#
title: Apple display scanout engine
maintainers:
  - Ryan Murray <81541646+RyanTheTide@users.noreply.github.com>
select:
  properties:
    compatible:
      allOf:
        -
          contains:
            enum:
              - apple,t8142-display-engine
              - apple,t8152-display-engine
              - apple,t6050-display-engine
        -
          contains:
            const: apple,display-engine
  required:
    - compatible
description: |
  Apple display scanout engine. Initial resource description for an unsupported firmware/backend layout.
  Register, IRQ and DMA topology can be recorded before a driver exists. This form must stay disabled;
  it does not substitute for the enabled driver contract or supply firmware, calibration, programming
  sequences or unresolved providers.
properties:
  compatible:
    items:
      -
        enum:
          - apple,t8142-display-engine
          - apple,t8152-display-engine
          - apple,t6050-display-engine
      -
        const: apple,display-engine
  status:
    const: disabled
  reg:
    description: Register apertures of the complete hardware complex, in hardware interface order.
    minItems: 5
    maxItems: 5
  interrupts:
    description: Interrupt lines wired to the system interrupt controller.
    minItems: 6
    maxItems: 13
  iommus:
    description: DMA translation streams emitted by this hardware.
    minItems: 2
    maxItems: 2
required:
  - compatible
  - reg
  - status
additionalProperties: false
```

## Documentation/devicetree/bindings/soc/apple/apple,dockchannel-complex.yaml
```yaml
# SPDX-License-Identifier: (GPL-2.0-only OR BSD-2-Clause)
%YAML 1.2
---
$id: http://devicetree.org/schemas/soc/apple/apple,dockchannel-complex.yaml#
$schema: http://devicetree.org/meta-schemas/core.yaml#
title: Apple dockchannel fifo and interrupt complex
maintainers:
  - Ryan Murray <81541646+RyanTheTide@users.noreply.github.com>
select:
  properties:
    compatible:
      allOf:
        -
          contains:
            enum:
              - apple,t8142-dockchannel-complex
              - apple,t6050-dockchannel-complex
        -
          contains:
            const: apple,dockchannel-complex
  required:
    - compatible
description: |
  Apple dockchannel fifo and interrupt complex. Initial resource description for an unsupported
  firmware/backend layout. Register, IRQ and DMA topology can be recorded before a driver exists. This
  form must stay disabled; it does not substitute for the enabled driver contract or supply firmware,
  calibration, programming sequences or unresolved providers.
properties:
  compatible:
    items:
      -
        enum:
          - apple,t8142-dockchannel-complex
          - apple,t6050-dockchannel-complex
      -
        const: apple,dockchannel-complex
  status:
    const: disabled
  reg:
    description: Register apertures of the complete hardware complex, in hardware interface order.
    minItems: 6
    maxItems: 6
  interrupts:
    description: Interrupt lines wired to the system interrupt controller.
    maxItems: 1
required:
  - compatible
  - reg
  - status
additionalProperties: false
```

## Documentation/devicetree/bindings/soc/apple/apple,dptx-phy-complex.yaml
```yaml
# SPDX-License-Identifier: (GPL-2.0-only OR BSD-2-Clause)
%YAML 1.2
---
$id: http://devicetree.org/schemas/soc/apple/apple,dptx-phy-complex.yaml#
$schema: http://devicetree.org/meta-schemas/core.yaml#
title: Apple displayport transmitter phy
maintainers:
  - Ryan Murray <81541646+RyanTheTide@users.noreply.github.com>
select:
  properties:
    compatible:
      allOf:
        -
          contains:
            enum:
              - apple,t8152-dptx-phy-complex
        -
          contains:
            const: apple,dptx-phy-complex
  required:
    - compatible
description: |
  Apple displayport transmitter phy. Initial resource description for an unsupported firmware/backend
  layout. Register, IRQ and DMA topology can be recorded before a driver exists. This form must stay
  disabled; it does not substitute for the enabled driver contract or supply firmware, calibration,
  programming sequences or unresolved providers.
properties:
  compatible:
    items:
      -
        enum:
          - apple,t8152-dptx-phy-complex
      -
        const: apple,dptx-phy-complex
  status:
    const: disabled
  reg:
    description: Register apertures of the complete hardware complex, in hardware interface order.
    minItems: 2
    maxItems: 2
  power-domains:
    description: Physical power and combined clock-gate dependencies.
    minItems: 1
    maxItems: 8
required:
  - compatible
  - reg
  - status
additionalProperties: false
```

## Documentation/devicetree/bindings/soc/apple/apple,dwi.yaml
```yaml
# SPDX-License-Identifier: (GPL-2.0-only OR BSD-2-Clause)
%YAML 1.2
---
$id: http://devicetree.org/schemas/soc/apple/apple,dwi.yaml#
$schema: http://devicetree.org/meta-schemas/core.yaml#

title: Apple DWI controller

maintainers:
  - Ryan Murray <81541646+RyanTheTide@users.noreply.github.com>

description: |
  DWI hardware register window and interrupt. Register programming and
  firmware ownership must be qualified before enabling the controller.
  On T6000, T6040, T8112 and T8140 the panel backlight does not use DWI, and the
  node is bound by a read-only register view.

select:
  properties:
    compatible:
      contains:
        enum:
          - apple,t6000-dwi
          - apple,t6020-dwi
          - apple,t6021-dwi
          - apple,t6022-dwi
          - apple,t6030-dwi
          - apple,t6031-dwi
          - apple,t6032-dwi
          - apple,t6041-dwi
          - apple,t8103-dwi
          - apple,t8112-dwi
          - apple,t8122-dwi
          - apple,t8132-dwi
          - apple,t8140-dwi
  required:
    - compatible

properties:
  compatible: true

allOf:
  - if:
      properties:
        compatible:
          contains:
            enum:
              - apple,t8132-dwi
      required:
        - compatible
    then:
      properties:
        compatible:
          items:
            - enum:
                - apple,t8132-dwi
            - const: apple,dwi

        reg:
          maxItems: 1

        interrupts:
          maxItems: 1

        power-domains:
          maxItems: 1

      required:
        - compatible
        - reg
        - interrupts
        - power-domains
    else:
      allOf:
        - if:
            properties:
              compatible:
                contains:
                  enum:
                    - apple,t6032-dwi
            required:
              - compatible
          then:
            properties:
              compatible:
                items:
                  - const: apple,t6032-dwi
                  - const: apple,dwi

              reg:
                maxItems: 1

              interrupts:
                maxItems: 1

              power-domains:
                maxItems: 1

            required:
              - compatible
              - reg
              - interrupts
              - power-domains
          else:
            properties:
              compatible:
                items:
                  - enum:
                      - apple,t6000-dwi
                      - apple,t6020-dwi
                      - apple,t6021-dwi
                      - apple,t6022-dwi
                      - apple,t6030-dwi
                      - apple,t6031-dwi
                      - apple,t6041-dwi
                      - apple,t8103-dwi
                      - apple,t8112-dwi
                      - apple,t8122-dwi
                      - apple,t8140-dwi
                  - const: apple,dwi

              reg:
                maxItems: 1
                description: Register apertures in hardware-description order.

              interrupts:
                maxItems: 1

              power-domains:
                maxItems: 1

            required:
              - compatible
              - reg
              - interrupts
              - power-domains

            additionalProperties: false

unevaluatedProperties: false
```

## Documentation/devicetree/bindings/soc/apple/apple,eic.yaml
```yaml
# SPDX-License-Identifier: (GPL-2.0-only OR BSD-2-Clause)
%YAML 1.2
---
$id: http://devicetree.org/schemas/soc/apple/apple,eic.yaml#
$schema: http://devicetree.org/meta-schemas/core.yaml#

title: Apple secure peripheral controller

maintainers:
  - Ryan Murray <81541646+RyanTheTide@users.noreply.github.com>

description: |
  Secure peripheral controller register apertures. These are absolute
  secure-side aliases published separately from the ordinary AP devices.
  The firmware retains ownership; an AP driver must establish an access
  contract before touching these resources.

properties:
  compatible:
    items:
      - const: apple,t8140-eic
      - const: apple,eic

  reg:
    minItems: 6
    maxItems: 6

  reg-names:
    items:
      - const: ps
      - const: wd-isp
      - const: gpio
      - const: fpwm
      - const: gltb
      - const: wd-e

required:
  - compatible
  - reg
  - reg-names

additionalProperties: false
```

## Documentation/devicetree/bindings/soc/apple/apple,esm.yaml
```yaml
# SPDX-License-Identifier: (GPL-2.0-only OR BSD-2-Clause)
%YAML 1.2
---
$id: http://devicetree.org/schemas/soc/apple/apple,esm.yaml#
$schema: http://devicetree.org/meta-schemas/core.yaml#

title: Apple secure SEP manager transport

maintainers:
  - Ryan Murray <81541646+RyanTheTide@users.noreply.github.com>

description: |
  Secure SEP manager transport register aperture and interrupts. This is
  separate from the ordinary SEP mailbox and has no qualified AP client.

properties:
  compatible:
    oneOf:
      - items:
          - const: apple,t8142-esm
          - const: apple,esm
      - items:
          - const: apple,t8152-esm
          - const: apple,esm
      - items:
          - const: apple,t8140-esm
          - const: apple,esm

  reg:
    maxItems: 1
    description: Register apertures in hardware-description order.

  interrupts:
    minItems: 2
    maxItems: 2

  iommus:
    maxItems: 1

required:
  - compatible
  - reg
  - interrupts
  - iommus

additionalProperties: false
```

## Documentation/devicetree/bindings/soc/apple/apple,exclave-sep-manager.yaml
```yaml
# SPDX-License-Identifier: (GPL-2.0-only OR BSD-2-Clause)
%YAML 1.2
---
$id: "http://devicetree.org/schemas/soc/apple/apple,exclave-sep-manager.yaml#"
$schema: "http://devicetree.org/meta-schemas/core.yaml#"
title: "Apple isolated secure enclave manager"
maintainers:
  - "Ryan Murray <81541646+RyanTheTide@users.noreply.github.com>"
select:
  properties:
    compatible:
      allOf:
        -
          contains:
            enum:
              - "apple,t8142-exclave-sep-manager"
              - "apple,t8152-exclave-sep-manager"
        -
          contains:
            const: "apple,exclave-sep-manager"
  required:
    - "compatible"
description: "Apple isolated secure enclave manager. Initial resource description for an unsupported firmware/backend layout. Register, IRQ and DMA topology can be recorded before a driver exists. This form must stay disabled; it does not substitute for the enabled driver contract or supply firmware, calibration, programming sequences or unresolved providers."
properties:
  compatible:
    items:
      -
        enum:
          - "apple,t8142-exclave-sep-manager"
          - "apple,t8152-exclave-sep-manager"
      -
        const: "apple,exclave-sep-manager"
  status:
    const: "disabled"
  reg:
    description: "Register apertures of the complete hardware complex, in hardware interface order."
    maxItems: 1
  interrupts:
    description: "Interrupt lines wired to the system interrupt controller."
    minItems: 2
    maxItems: 2
  iommus:
    description: "DMA translation streams emitted by this hardware."
    maxItems: 1
required:
  - "compatible"
  - "reg"
  - "status"
additionalProperties: false
```
