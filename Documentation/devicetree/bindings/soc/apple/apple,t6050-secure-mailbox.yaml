## Documentation/devicetree/bindings/soc/apple/apple,t8142-display-engine.yaml
```yaml
# SPDX-License-Identifier: (GPL-2.0-only OR BSD-2-Clause)
%YAML 1.2
---
$id: http://devicetree.org/schemas/soc/apple/apple,t8142-display-engine.yaml#
$schema: http://devicetree.org/meta-schemas/core.yaml#

title: Apple T8142 display scanout engine

maintainers:
  - Ryan Murray <ryan@aurorasilicon.org>

description: |
  Display scanout engine on T8142. This describes the complete register complex,
  including auxiliary control and status apertures shared with firmware.
  It does not imply compatibility with an earlier generation's driver.
  The node remains disabled until ownership of the register windows and
  the firmware handoff have been established. Calibration, firmware and
  programming sequences are supplied separately by the boot environment.

select:
  properties:
    compatible:
      contains:
        const: apple,t8142-display-engine
  required:
    - compatible

properties:
  compatible:
    items:
      - const: apple,t8142-display-engine
      - const: apple,display-engine

  reg:
    description: Controller register apertures, in hardware interface order.
    minItems: 5
    maxItems: 5

  interrupts:
    description: Interrupt lines wired to the system interrupt controller.
    minItems: 7
    maxItems: 9

  iommus:
    description: DMA translation streams used by this controller.
    minItems: 2
    maxItems: 2

required:
  - compatible
  - reg

additionalProperties: false
```

## Documentation/devicetree/bindings/soc/apple/apple,t8142-display-expert.yaml
```yaml
# SPDX-License-Identifier: (GPL-2.0-only OR BSD-2-Clause)
%YAML 1.2
---
$id: http://devicetree.org/schemas/soc/apple/apple,t8142-display-expert.yaml#
$schema: http://devicetree.org/meta-schemas/core.yaml#

title: Apple T8142 display engine control and status windows

maintainers:
  - Ryan Murray <ryan@aurorasilicon.org>

description: |
  Display engine control and status windows on T8142. This describes the complete register complex,
  including auxiliary control and status apertures shared with firmware.
  It does not imply compatibility with an earlier generation's driver.
  The node remains disabled until ownership of the register windows and
  the firmware handoff have been established. Calibration, firmware and
  programming sequences are supplied separately by the boot environment.

select:
  properties:
    compatible:
      contains:
        const: apple,t8142-display-expert
  required:
    - compatible

properties:
  compatible:
    items:
      - const: apple,t8142-display-expert
      - const: apple,display-expert

  reg:
    description: Controller register apertures, in hardware interface order.
    minItems: 3
    maxItems: 10

  interrupts:
    description: Interrupt lines wired to the system interrupt controller.
    minItems: 1
    maxItems: 1

required:
  - compatible
  - reg

additionalProperties: false
```

## Documentation/devicetree/bindings/soc/apple/apple,t8142-dptx-aux.yaml
```yaml
# SPDX-License-Identifier: (GPL-2.0-only OR BSD-2-Clause)
%YAML 1.2
---
$id: http://devicetree.org/schemas/soc/apple/apple,t8142-dptx-aux.yaml#
$schema: http://devicetree.org/meta-schemas/core.yaml#

title: Apple T8142 displayport aux channel controller

maintainers:
  - Ryan Murray <ryan@aurorasilicon.org>

description: |
  DisplayPort AUX channel controller on T8142. This describes the complete register complex,
  including auxiliary control and status apertures shared with firmware.
  It does not imply compatibility with an earlier generation's driver.
  The node remains disabled until ownership of the register windows and
  the firmware handoff have been established. Calibration, firmware and
  programming sequences are supplied separately by the boot environment.

select:
  properties:
    compatible:
      contains:
        const: apple,t8142-dptx-aux
  required:
    - compatible

properties:
  compatible:
    items:
      - const: apple,t8142-dptx-aux
      - const: apple,dptx-aux

  reg:
    description: Controller register apertures, in hardware interface order.
    minItems: 2
    maxItems: 2

  power-domains:
    description: Power and combined clock gates required by the controller.
    minItems: 1
    maxItems: 1

required:
  - compatible
  - reg

additionalProperties: false
```

## Documentation/devicetree/bindings/soc/apple/apple,t8142-error-monitor.yaml
```yaml
# SPDX-License-Identifier: (GPL-2.0-only OR BSD-2-Clause)
%YAML 1.2
---
$id: http://devicetree.org/schemas/soc/apple/apple,t8142-error-monitor.yaml#
$schema: http://devicetree.org/meta-schemas/core.yaml#

title: Apple T8142 soc error monitoring register windows

maintainers:
  - Ryan Murray <ryan@aurorasilicon.org>

description: |
  SoC error monitoring register windows on T8142. This describes the complete register complex,
  including auxiliary control and status apertures shared with firmware.
  It does not imply compatibility with an earlier generation's driver.
  The node remains disabled until ownership of the register windows and
  the firmware handoff have been established. Calibration, firmware and
  programming sequences are supplied separately by the boot environment.

select:
  properties:
    compatible:
      contains:
        const: apple,t8142-error-monitor
  required:
    - compatible

properties:
  compatible:
    items:
      - const: apple,t8142-error-monitor
      - const: apple,error-monitor

  reg:
    description: Controller register apertures, in hardware interface order.
    minItems: 33
    maxItems: 33

  interrupts:
    description: Interrupt lines wired to the system interrupt controller.
    minItems: 31
    maxItems: 31

required:
  - compatible
  - reg

additionalProperties: false
```

## Documentation/devicetree/bindings/soc/apple/apple,t8142-event-monitor.yaml
```yaml
# SPDX-License-Identifier: (GPL-2.0-only OR BSD-2-Clause)
%YAML 1.2
---
$id: http://devicetree.org/schemas/soc/apple/apple,t8142-event-monitor.yaml#
$schema: http://devicetree.org/meta-schemas/core.yaml#

title: Apple T8142 soc event log register windows

maintainers:
  - Ryan Murray <ryan@aurorasilicon.org>

description: |
  SoC event log register windows on T8142. This describes the complete register complex,
  including auxiliary control and status apertures shared with firmware.
  It does not imply compatibility with an earlier generation's driver.
  The node remains disabled until ownership of the register windows and
  the firmware handoff have been established. Calibration, firmware and
  programming sequences are supplied separately by the boot environment.

select:
  properties:
    compatible:
      contains:
        const: apple,t8142-event-monitor
  required:
    - compatible

properties:
  compatible:
    items:
      - const: apple,t8142-event-monitor
      - const: apple,event-monitor

  reg:
    description: Controller register apertures, in hardware interface order.
    minItems: 51
    maxItems: 51

  interrupts:
    description: Interrupt lines wired to the system interrupt controller.
    minItems: 13
    maxItems: 13

required:
  - compatible
  - reg

additionalProperties: false
```

## Documentation/devicetree/bindings/soc/apple/apple,t8142-isp-complex.yaml
```yaml
# SPDX-License-Identifier: (GPL-2.0-only OR BSD-2-Clause)
%YAML 1.2
---
$id: http://devicetree.org/schemas/soc/apple/apple,t8142-isp-complex.yaml#
$schema: http://devicetree.org/meta-schemas/core.yaml#

title: Apple T8142 image signal processor complex

maintainers:
  - Ryan Murray <ryan@aurorasilicon.org>

description: |
  Image signal processor complex on T8142. This describes the complete register complex,
  including auxiliary control and status apertures shared with firmware.
  It does not imply compatibility with an earlier generation's driver.
  The node remains disabled until ownership of the register windows and
  the firmware handoff have been established. Calibration, firmware and
  programming sequences are supplied separately by the boot environment.

select:
  properties:
    compatible:
      contains:
        const: apple,t8142-isp-complex
  required:
    - compatible

properties:
  compatible:
    items:
      - const: apple,t8142-isp-complex
      - const: apple,isp-complex

  reg:
    description: Controller register apertures, in hardware interface order.
    minItems: 3
    maxItems: 3

  interrupts:
    description: Interrupt lines wired to the system interrupt controller.
    minItems: 5
    maxItems: 5

  iommus:
    description: DMA translation streams used by this controller.
    minItems: 10
    maxItems: 10

  power-domains:
    description: Power and combined clock gates required by the controller.
    minItems: 2
    maxItems: 2

required:
  - compatible
  - reg

additionalProperties: false
```

## Documentation/devicetree/bindings/soc/apple/apple,t8142-pmgr-complex.yaml
```yaml
# SPDX-License-Identifier: (GPL-2.0-only OR BSD-2-Clause)
%YAML 1.2
---
$id: http://devicetree.org/schemas/soc/apple/apple,t8142-pmgr-complex.yaml#
$schema: http://devicetree.org/meta-schemas/core.yaml#

title: Apple T8142 power management register complex

maintainers:
  - Ryan Murray <ryan@aurorasilicon.org>

description: |
  Power management register complex on T8142. This describes the complete register complex,
  including auxiliary control and status apertures shared with firmware.
  It does not imply compatibility with an earlier generation's driver.
  The node remains disabled until ownership of the register windows and
  the firmware handoff have been established. Calibration, firmware and
  programming sequences are supplied separately by the boot environment.

select:
  properties:
    compatible:
      contains:
        const: apple,t8142-pmgr-complex
  required:
    - compatible

properties:
  compatible:
    items:
      - const: apple,t8142-pmgr-complex
      - const: apple,pmgr-complex

  reg:
    description: Controller register apertures, in hardware interface order.
    minItems: 54
    maxItems: 54

  interrupts:
    description: Interrupt lines wired to the system interrupt controller.
    minItems: 2
    maxItems: 2

required:
  - compatible
  - reg

additionalProperties: false
```

## Documentation/devicetree/bindings/soc/apple/apple,t8142-pmp-coproc.yaml
```yaml
# SPDX-License-Identifier: (GPL-2.0-only OR BSD-2-Clause)
%YAML 1.2
---
$id: http://devicetree.org/schemas/soc/apple/apple,t8142-pmp-coproc.yaml#
$schema: http://devicetree.org/meta-schemas/core.yaml#

title: Apple T8142 power management processor

maintainers:
  - Ryan Murray <ryan@aurorasilicon.org>

description: |
  Power management processor on T8142. This describes the complete register complex,
  including auxiliary control and status apertures shared with firmware.
  It does not imply compatibility with an earlier generation's driver.
  The node remains disabled until ownership of the register windows and
  the firmware handoff have been established. Calibration, firmware and
  programming sequences are supplied separately by the boot environment.

select:
  properties:
    compatible:
      contains:
        const: apple,t8142-pmp-coproc
  required:
    - compatible

properties:
  compatible:
    items:
      - const: apple,t8142-pmp-coproc
      - const: apple,pmp-coproc

  reg:
    description: Controller register apertures, in hardware interface order.
    minItems: 4
    maxItems: 4

  interrupts:
    description: Interrupt lines wired to the system interrupt controller.
    minItems: 4
    maxItems: 4

  iommus:
    description: DMA translation streams used by this controller.
    minItems: 1
    maxItems: 1

  power-domains:
    description: Power and combined clock gates required by the controller.
    minItems: 2
    maxItems: 2

required:
  - compatible
  - reg

additionalProperties: false
```

## Documentation/devicetree/bindings/soc/apple/apple,t8142-qspi-complex.yaml
```yaml
# SPDX-License-Identifier: (GPL-2.0-only OR BSD-2-Clause)
%YAML 1.2
---
$id: http://devicetree.org/schemas/soc/apple/apple,t8142-qspi-complex.yaml#
$schema: http://devicetree.org/meta-schemas/core.yaml#

title: Apple T8142 quad spi controller and pin interface

maintainers:
  - Ryan Murray <ryan@aurorasilicon.org>

description: |
  Quad SPI controller and pin interface on T8142. This describes the complete register complex,
  including auxiliary control and status apertures shared with firmware.
  It does not imply compatibility with an earlier generation's driver.
  The node remains disabled until ownership of the register windows and
  the firmware handoff have been established. Calibration, firmware and
  programming sequences are supplied separately by the boot environment.

select:
  properties:
    compatible:
      contains:
        const: apple,t8142-qspi-complex
  required:
    - compatible

properties:
  compatible:
    items:
      - const: apple,t8142-qspi-complex
      - const: apple,qspi-complex

  reg:
    description: Controller register apertures, in hardware interface order.
    minItems: 2
    maxItems: 2

  interrupts:
    description: Interrupt lines wired to the system interrupt controller.
    minItems: 1
    maxItems: 1

  power-domains:
    description: Power and combined clock gates required by the controller.
    minItems: 1
    maxItems: 1

required:
  - compatible
  - reg

additionalProperties: false
```

## Documentation/devicetree/bindings/soc/apple/apple,t8142-storage-complex.yaml
```yaml
# SPDX-License-Identifier: (GPL-2.0-only OR BSD-2-Clause)
%YAML 1.2
---
$id: http://devicetree.org/schemas/soc/apple/apple,t8142-storage-complex.yaml#
$schema: http://devicetree.org/meta-schemas/core.yaml#

title: Apple T8142 storage controller and coprocessor

maintainers:
  - Ryan Murray <ryan@aurorasilicon.org>

description: |
  Storage controller and coprocessor on T8142. This describes the complete register complex,
  including auxiliary control and status apertures shared with firmware.
  It does not imply compatibility with an earlier generation's driver.
  The node remains disabled until ownership of the register windows and
  the firmware handoff have been established. Calibration, firmware and
  programming sequences are supplied separately by the boot environment.

select:
  properties:
    compatible:
      contains:
        const: apple,t8142-storage-complex
  required:
    - compatible

properties:
  compatible:
    items:
      - const: apple,t8142-storage-complex
      - const: apple,storage-complex

  reg:
    description: Controller register apertures, in hardware interface order.
    minItems: 10
    maxItems: 10

  interrupts:
    description: Interrupt lines wired to the system interrupt controller.
    minItems: 5
    maxItems: 5

required:
  - compatible
  - reg

additionalProperties: false
```
