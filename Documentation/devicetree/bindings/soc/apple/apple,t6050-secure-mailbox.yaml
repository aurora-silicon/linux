## Documentation/devicetree/bindings/soc/apple/apple,t8140-aop.yaml
```yaml
# SPDX-License-Identifier: (GPL-2.0-only OR BSD-2-Clause)
%YAML 1.2
---
$id: http://devicetree.org/schemas/soc/apple/apple,t8140-aop.yaml#
$schema: http://devicetree.org/meta-schemas/core.yaml#

title: Apple T8140 Always-On Processor

maintainers:
  - Ryan Murray <ryan@aurorasilicon.org>

description:
  The Always-On Processor provides audio and sensor services through firmware
  loaded by the bootloader. The application processor uses a primary mailbox
  and a separate setup-port mailbox. Each mailbox consumer has its own DMA
  allocation window in the inherited AOP DART mappings.

properties:
  compatible:
    const: apple,t8140-aop

  reg:
    items:
      - description: AOP register and boot-argument window
      - description: ASC wrapper and processor control registers

  reg-names:
    items:
      - const: mmio
      - const: asc

  mboxes:
    items:
      - description: Primary firmware transport
      - description: Firmware setup-port transport

  mbox-names:
    items:
      - const: mbox
      - const: setup

  iommus:
    maxItems: 1

  apple,dma-range:
    $ref: /schemas/types.yaml#/definitions/uint64-array
    minItems: 2
    maxItems: 2
    description:
      Host DMA allocation window as a base and nonzero size. The window must
      occupy root slots available to the host on this AOP DART stream.

  power-domains:
    maxItems: 1

  als:
    type: object
    $ref: /schemas/iio/light/apple,t8140-aop-als.yaml#

  audio:
    type: object
    $ref: /schemas/sound/apple,t8140-aop-audio.yaml#

required:
  - compatible
  - reg
  - reg-names
  - mboxes
  - mbox-names
  - iommus
  - apple,dma-range
  - power-domains

additionalProperties: false
```

## Documentation/devicetree/bindings/soc/apple/apple,t8140-mcc.yaml
```yaml
# SPDX-License-Identifier: (GPL-2.0-only OR BSD-2-Clause)
%YAML 1.2
---
$id: http://devicetree.org/schemas/soc/apple/apple,t8140-mcc.yaml#
$schema: http://devicetree.org/meta-schemas/core.yaml#

title: Apple memory cache controller

maintainers:
  - Ryan Murray <ryan@aurorasilicon.org>

description:
  The memory cache controller holds the system level cache in front of DRAM.
  T8140 exposes per-plane allocation and flush controls. T8132 instead has
  two apertures with two planes each and a multicast cache-enable register;
  its enabled cache is retained until a dirty-data drain is qualified.

select:
  properties:
    compatible:
      contains:
        enum:
          - apple,t6000-mcc
          - apple,t6020-mcc
          - apple,t6021-mcc
          - apple,t6022-mcc
          - apple,t6030-mcc
          - apple,t6031-mcc
          - apple,t6032-mcc
          - apple,t6041-mcc
          - apple,t6050-mcc
          - apple,t8103-mcc
          - apple,t8112-mcc
          - apple,t8122-mcc
          - apple,t8132-mcc
          - apple,t8140-mcc
  required:
    - compatible

properties:
  compatible: true

  apple,boot-dma-devices:
    $ref: /schemas/types.yaml#/definitions/phandle-array
    description: Shared hardware resource metadata.
    items:
      maxItems: 1

allOf:
  - if:
      properties:
        compatible:
          contains:
            enum:
              - apple,t6032-mcc
      required:
        - compatible
    then:
      properties:
        compatible:
          items:
            - const: apple,t6032-mcc
            - const: apple,mcc

        reg:
          minItems: 20
          maxItems: 20

      required:
        - compatible
        - reg
    else:
      properties:
        compatible:
          oneOf:
            - enum:
                - apple,t6050-mcc
                - apple,t8132-mcc
                - apple,t8140-mcc
            - items:
                - enum:
                    - apple,t6000-mcc
                    - apple,t6020-mcc
                    - apple,t6021-mcc
                    - apple,t6022-mcc
                    - apple,t6030-mcc
                    - apple,t6031-mcc
                    - apple,t8103-mcc
                    - apple,t8112-mcc
                    - apple,t8122-mcc
                - const: apple,mcc
            - items:
                - enum:
                    - apple,t6041-mcc
                - const: apple,t8140-mcc

        reg:
          description:
            Per-plane blocks or multicast memory-controller apertures. A two-die
            T6050 lists both dies' planes.
          minItems: 1
          maxItems: 64

        nonposted-mmio: true

        apple,boot-dma-devices:
          $ref: /schemas/types.yaml#/definitions/phandle-array
          items:
            maxItems: 1
          description:
            Devices that take over DMA the bootloader left running. Cache allocation
            is enabled only once each of them is bound to its driver.

      required:
        - compatible
        - reg

      additionalProperties: false

unevaluatedProperties: false

examples:
  - |
    soc {
        #address-cells = <2>;
        #size-cells = <2>;

        display: display-subsystem {
        };

        memory-controller@220000000 {
            compatible = "apple,t8140-mcc";
            reg = <0x2 0x20000000 0x0 0x4000>,
                  <0x2 0x20040000 0x0 0x4000>,
                  <0x2 0x20080000 0x0 0x4000>,
                  <0x2 0x200c0000 0x0 0x4000>;
            apple,boot-dma-devices = <&display>;
        };
    };
```

## Documentation/devicetree/bindings/soc/apple/apple,t8140-pmp-v2.yaml
```yaml
# SPDX-License-Identifier: (GPL-2.0 OR BSD-2-Clause)
%YAML 1.2
---
$id: http://devicetree.org/schemas/soc/apple/apple,t8140-pmp-v2.yaml#
$schema: http://devicetree.org/meta-schemas/core.yaml#

title: Apple T8140 preloaded PMP-v2 coprocessor

maintainers:
  - Eryk Wieliczko <eryk@wieliczko.ninja>
  - Ryan Murray <ryan@aurorasilicon.org>

description: |
  Native stopped-epoch owner of the preloaded T8140 PMP. A running processor
  without a transferred session cannot be adopted. The board description
  forwards the actual resident segment metadata and own nub data (on the J700
  they are generated from the machine's ADT); none is a firmware image to be
  loaded. The owner also owns stream 0 of the PMP's retained t8110-model DART
  translation instance and its associated address filter: other streams,
  TRAD tunables and protection state are retained, never reset. The bootloader
  must leave PMP stopped with no valid SID0 root. Firmware quiescence and
  higher CPU frequency admission are separate from the passive registry
  endpoint; the optional thermal policy is a Linux operating policy.

properties:
  compatible:
    const: apple,t8140-pmp-v2

  reg:
    items:
      - description: CPU control register resource, disjoint from the mailbox
      - description: Resident firmware SRAM resource
      - description: PMP DART TRAD translation instance
      - description: PMP DART FPAD address filter instance

  reg-names:
    items:
      - const: control
      - const: firmware
      - const: dart
      - const: apf

  interrupts:
    maxItems: 1
    description: The PMP DART fault interrupt (exclusive).

  interrupt-names:
    items:
      - const: dart

  mboxes:
    maxItems: 1

  power-domains:
    minItems: 2
    maxItems: 2

  power-domain-names:
    items:
      - const: pmp
      - const: sram

  apple,metadata-version:
    $ref: /schemas/types.yaml#/definitions/uint32
    const: 1
    description: Set only after complete metadata forwarding.

  apple,resident-segments:
    $ref: /schemas/types.yaml#/definitions/uint8-array
    minItems: 32
    maxItems: 2048
    description: |
      Original little-endian 32-byte ADT tuples. Each contains physical,
      processor virtual, device address (three u64), byte size and flags
      (two u32). Raw flags bit 0 is inverse writable; bit 1 skips mapping.

  apple,patchbay-values:
    $ref: /schemas/types.yaml#/definitions/uint32-array
    minItems: 20
    maxItems: 20
    description: |
      Bootloader-derived numeric key/value pairs in order BDID, DVID, DCAP,
      DCHD, PMC_, PMCV, PMCB, PMCX, CVAR, PMCM. Own ADT inputs supply these
      values, except the explicit normal non-development PMCM default.
      These do not include a fast-die override or permit inserting a key.

  apple,dma-range:
    $ref: /schemas/types.yaml#/definitions/uint64-array
    minItems: 2
    maxItems: 2
    description: Start and size of the own-device mapper IOVA aperture.

  apple,apf-instance:
    $ref: /schemas/types.yaml#/definitions/uint8-array
    minItems: 48
    maxItems: 48
    description: Exact own ADT dart-pmp instance/resource association records.

  apple,apf-capacity:
    $ref: /schemas/types.yaml#/definitions/uint32
    const: 32
    description: Own ADT filter slot capacity for the admitted instance.

  apple,apf-table:
    $ref: /schemas/types.yaml#/definitions/uint8-array
    minItems: 1404
    maxItems: 1404
    description: |
      Exact 27 own ADT 52-byte APF records (dapf-instance-0). Each contains
      little-endian 64-bit start/end, eight little-endian 32-bit SID bitmap
      words and four descriptor bytes. The native profile admits a qualified
      table hash; these bytes are not permission to initialize unowned SID2
      rows.

  apple,dart-tunables:
    $ref: /schemas/types.yaml#/definitions/uint8-array
    minItems: 216
    maxItems: 216
    description: |
      Exact nine own ADT 24-byte tunables (dart-tunables-instance-0). Each
      contains little-endian 32-bit offset/access width and 64-bit mask/value.
      Used for read-only validation of retained TRAD state, not for writes.

  firmware-data:
    type: object
    description: |
      Exact own PMP nub property bytes. These provide presence-based boot
      classification and optional exact-name registry defaults.
    additionalProperties: true

required:
  - compatible
  - reg
  - reg-names
  - interrupts
  - interrupt-names
  - mboxes
  - power-domains
  - power-domain-names
  - apple,dma-range
  - apple,apf-instance
  - apple,apf-capacity
  - apple,apf-table
  - apple,dart-tunables
  - firmware-data

additionalProperties: false
```

## Documentation/devicetree/bindings/soc/apple/apple,t8140-sleep.yaml
```yaml
# SPDX-License-Identifier: (GPL-2.0-only OR BSD-2-Clause)
%YAML 1.2
---
$id: http://devicetree.org/schemas/soc/apple/apple,t8140-sleep.yaml#
$schema: http://devicetree.org/meta-schemas/core.yaml#

title: Apple SoC system sleep controls

maintainers:
  - Diljit Singh <hey@djdev.me>

description: |
  The registers a kernel running directly at EL2 on an Apple SoC writes to enter
  and return from suspend-to-RAM and to power its secondary CPUs off. They belong
  to several hardware blocks, some of which other drivers also use, so this node
  overlaps those drivers' register ranges and the driver does not claim them.
  Each SoC has its own compatible, as its power domains differ.

properties:
  compatible:
    enum:
      - apple,t8132-sleep
      - apple,t8140-sleep

  reg:
    minItems: 25
    maxItems: 28

  reg-names:
    minItems: 25
    maxItems: 28

  apple,wake-enable:
    $ref: /schemas/types.yaml#/definitions/uint32-array
    description:
      The wake source IDs left enabled across suspend-to-RAM. Every other
      source is masked.

  apple,apcie:
    $ref: /schemas/types.yaml#/definitions/phandle
    description:
      The PCIe host whose shared registers and tunables the storage controller's
      link depends on. They are needed even with that host disabled.

  apple,pinctrl:
    $ref: /schemas/types.yaml#/definitions/phandle
    description:
      The pin controller whose pins a deep sleep resets. Its pins are saved
      before a sleep and put back after it, before the storage controller
      starts.

  apple,pinctrl-skip-pins:
    $ref: /schemas/types.yaml#/definitions/uint32-array
    description:
      Pins of that controller to leave alone across a sleep, neither saved nor
      put back.

  apple,debug-port:
    $ref: /schemas/types.yaml#/definitions/phandle
    description:
      The USB-C port controller that carries the debug link, stopped for a sleep.

  apple,display-coprocessors:
    $ref: /schemas/types.yaml#/definitions/phandle-array
    description:
      The DCP and the external DCPs, which must be off before a commit, in that
      order.

required:
  - compatible
  - reg
  - reg-names
  - apple,display-coprocessors

allOf:
  - if:
      properties:
        compatible:
          contains:
            const: apple,t8140-sleep
    then:
      required:
        - apple,wake-enable
      properties:
        reg:
          minItems: 28
          maxItems: 28
        reg-names:
          items:
            - const: ps
            - const: pwrgate
            - const: cpu-start
            - const: cllt
            - const: cluster
            - const: commit
            - const: wdt
            - const: aon-misc
            - const: wake
            - const: amcc0
            - const: amcc1
            - const: amcc2
            - const: amcc3
            - const: pmc-dcp
            - const: dvfm-e
            - const: dvfm-p
            - const: spmi
            - const: pmc-voters
            - const: dcs
            - const: ps-aon
            - const: spmi-a0
            - const: clk-mux
            - const: mcc0
            - const: mcc1
            - const: mcc2
            - const: ptd
            - const: clk-perf
            - const: cluster-dcs
  - if:
      properties:
        compatible:
          contains:
            const: apple,t8132-sleep
    then:
      properties:
        reg:
          minItems: 25
          maxItems: 26
        reg-names:
          minItems: 25
          items:
            - const: ps
            - const: pwrgate
            - const: cpu-start
            - const: cllt
            - const: cluster
            - const: commit
            - const: wdt
            - const: aon-misc
            - const: wake
            - const: amcc0
            - const: amcc1
            - const: pmc-dcp
            - const: dvfm-e
            - const: dvfm-p
            - const: spmi
            - const: pmc-voters
            - const: dcs
            - const: ps-aon
            - const: spmi-a0
            - const: clk-mux
            - const: mcc0
            - const: mcc1
            - const: ptd
            - const: clk-perf
            - const: cluster-dcs
            - const: ps-prot

additionalProperties: false
```

## Documentation/devicetree/bindings/soc/apple/apple,t8142-aic-timebase.yaml
```yaml
# SPDX-License-Identifier: (GPL-2.0-only OR BSD-2-Clause)
%YAML 1.2
---
$id: http://devicetree.org/schemas/soc/apple/apple,t8142-aic-timebase.yaml#
$schema: http://devicetree.org/meta-schemas/core.yaml#

title: Apple T8142 interrupt controller timebase

maintainers:
  - Ryan Murray <ryan@aurorasilicon.org>

description: |
  Interrupt controller timebase on T8142. This describes the complete register complex,
  including auxiliary control and status apertures shared with firmware.
  It does not imply compatibility with an earlier generation's driver.
  The node remains disabled until ownership of the register windows and
  the firmware handoff have been established. Calibration, firmware and
  programming sequences are supplied separately by the boot environment.

select:
  properties:
    compatible:
      contains:
        const: apple,t8142-aic-timebase
  required:
    - compatible

properties:
  compatible:
    items:
      - const: apple,t8142-aic-timebase
      - const: apple,aic-timebase

  reg:
    description: Controller register apertures, in hardware interface order.
    minItems: 1
    maxItems: 1

required:
  - compatible
  - reg

additionalProperties: false
```
