## Documentation/devicetree/bindings/soc/apple/apple,rtk-helper-asc4.yaml
```yaml
# SPDX-License-Identifier: (GPL-2.0-only OR BSD-2-Clause)
%YAML 1.2
---
$id: http://devicetree.org/schemas/soc/apple/apple,rtk-helper-asc4.yaml#
$schema: http://devicetree.org/meta-schemas/core.yaml#

title: Apple ASC4 RTKit helper coprocessor

maintainers:
  - Ryan Murray <ryan@aurorasilicon.org>

description:
  Apple SoCs contain a number of ASC coprocessors that run RTKit firmware.
  For some of them the operating system only has to boot the coprocessor and
  keep it running, while the devices it serves are described by other nodes.
  The MTP (multi-touch processor) ASC of Apple laptops is one of these. It
  serves the built-in keyboard and trackpad over DockChannel, and the
  DockChannel HID transport refers to this node through its apple,helper-cpu
  property.

properties:
  compatible:
    items:
      - enum:
          - apple,t6020-mtp
          - apple,t6030-mtp
          - apple,t6031-mtp
          - apple,t6041-mtp
          - apple,t8112-mtp
          - apple,t8122-mtp
          - apple,t8132-mtp
          - apple,t8140-mtp
          - apple,t8142-mtp
      - enum:
          - apple,t6020-rtk-helper-asc4
          - apple,t6030-rtk-helper-asc4
          - apple,t6041-rtk-helper-asc4
          - apple,t8112-rtk-helper-asc4
          - apple,t8122-rtk-helper-asc4
          - apple,t8132-rtk-helper-asc4
          - apple,t8140-rtk-helper-asc4
          - apple,t8142-rtk-helper-asc4
      - const: apple,mtp
      - const: apple,rtk-helper-asc4

  reg:
    minItems: 1
    items:
      - description: ASC control registers
      - description:
          Coprocessor SRAM, from which the firmware may ask the host to map
          buffers instead of allocating them from system memory

  reg-names:
    minItems: 1
    items:
      - const: asc
      - const: sram

  mboxes:
    maxItems: 1

  iommus:
    maxItems: 1

  apple,rtkit-handoff:
    enum:
      - mtp-live-v1
    description: |
      The producer reserves firmware-visible buffers and retains their DART
      mappings, and transfers a running RTKit session without renegotiation.
      On T8132 it also supplies apple,rtkit-buffers, leaves the initial
      DockChannel HID header unread, and retains the helper's identity DART
      bypass. The host continues servicing system endpoints without restarting
      the coprocessor or taking it to QUIESCED.

  apple,rtkit-buffers:
    oneOf:
      - type: boolean
      - $ref: /schemas/types.yaml#/definitions/uint32-array
        minItems: 5
        maxItems: 20
    description: |
      An empty property records that no shared buffers were negotiated.
      Otherwise this is the inventory of every shared buffer negotiated,
      in groups of five cells: system endpoint number, device address high
      cell, device address low cell, exact protocol size in bytes, and the
      original request's is-mapped flag (0 or 1). Endpoint numbers are 1 for
      crashlog, 2 for syslog, 4 for IOReport, and 8 for OSLog, each at most once.
      The last cell records whether firmware supplied the original address;
      it does not classify the backing memory as SRAM or DRAM. Device
      addresses are physical addresses under the retained identity bypass.
      SRAM buffers must lie inside the sram register resource. Every DRAM
      buffer must lie inside a no-map reserved-memory region referenced by
      memory-region. The inventory is installed before mailbox RX is enabled;
      repeating an existing request cannot replace a live allocation.

  memory-region:
    minItems: 1
    maxItems: 4
    description:
      Reserved no-map DRAM buffers held by the running coprocessor. This
      excludes buffers inside its SRAM register resource.

  linux-enablement-mac,rtkit-inherited:
    deprecated: true
    description: |
      Legacy J713 preservation contract. An empty property or one 32-bit
      cell containing 1 retains the running helper. A cell containing 0
      selects ordinary startup. This carries no buffer inventory or verified
      reservation record; the consumer can service system notifications but
      cannot reconstruct or replace the existing shared buffers. New
      producers use mtp-live-v1 and may retain this marker for older kernels.
    oneOf:
      - type: boolean
      - $ref: /schemas/types.yaml#/definitions/uint32
        enum: [0, 1]

  '#helper-cells':
    const: 0
    description:
      Present in existing device trees. Nothing references the helper with
      argument cells; the DockChannel HID transport uses a plain phandle.

required:
  - compatible
  - reg
  - reg-names
  - mboxes
  - iommus

allOf:
  - if:
      properties:
        compatible:
          contains:
            const: apple,t8132-mtp
      required:
        - apple,rtkit-handoff
    then:
      required:
        - apple,rtkit-buffers

additionalProperties: false

examples:
  - |
    soc {
        #address-cells = <2>;
        #size-cells = <2>;

        mtp@314600000 {
            compatible = "apple,t8140-mtp", "apple,t8140-rtk-helper-asc4",
                         "apple,mtp", "apple,rtk-helper-asc4";
            reg = <0x3 0x14600000 0x0 0x4000>,
                  <0x3 0x14050000 0x0 0x4000>;
            reg-names = "asc", "sram";
            mboxes = <&mtp_mbox>;
            iommus = <&mtp_dart 0>;
        };
    };
```

## Documentation/devicetree/bindings/soc/apple/apple,sac-manager.yaml
```yaml
# SPDX-License-Identifier: (GPL-2.0-only OR BSD-2-Clause)
%YAML 1.2
---
$id: http://devicetree.org/schemas/soc/apple/apple,sac-manager.yaml#
$schema: http://devicetree.org/meta-schemas/core.yaml#

title: Apple display SAC manager

maintainers:
  - Ryan Murray <81541646+RyanTheTide@users.noreply.github.com>

description: |
  Firmware display SAC manager. It has no independent register aperture
  in the hardware description.

properties:
  compatible:
    oneOf:
      - items:
          - const: apple,t6041-sac-manager
          - const: apple,sac-manager
      - items:
          - const: apple,t8140-sac-manager
          - const: apple,sac-manager

      - items:
          - const: apple,t8103-sac-manager
          - const: apple,sac-manager
      - items:
          - const: apple,t6000-sac-manager
          - const: apple,sac-manager

required:
  - compatible

additionalProperties: false
```

## Documentation/devicetree/bindings/soc/apple/apple,sart-apif.yaml
```yaml
# SPDX-License-Identifier: GPL-2.0-only
%YAML 1.2
---
$id: http://devicetree.org/schemas/soc/apple/apple,sart-apif.yaml#
$schema: http://devicetree.org/meta-schemas/core.yaml#

title: Apple SART mediated through Aura APIF

maintainers:
  - Dj <hey@djdev.me>

description: |
  SART provider using native SPTM table-5 calls. Existing consumers reference
  this provider through their apple,sart phandle. Linux tracks only its own
  regions; unknown firmware grants are not reported as inherited regions.

properties:
  compatible:
    const: apple,sart-apif
  aurora,apif:
    $ref: /schemas/types.yaml#/definitions/phandle
    description: APIF version-2 transport provider.

required:
  - compatible
  - aurora,apif

additionalProperties: false

examples:
  - |
    sart {
        compatible = "apple,sart-apif";
        aurora,apif = <&apif>;
    };
```

## Documentation/devicetree/bindings/soc/apple/apple,scdc-coproc.yaml
```yaml
# SPDX-License-Identifier: (GPL-2.0-only OR BSD-2-Clause)
%YAML 1.2
---
$id: http://devicetree.org/schemas/soc/apple/apple,scdc-coproc.yaml#
$schema: http://devicetree.org/meta-schemas/core.yaml#
title: Apple camera processing coprocessor
maintainers:
  - Ryan Murray <81541646+RyanTheTide@users.noreply.github.com>
select:
  properties:
    compatible:
      allOf:
        -
          contains:
            enum:
              - apple,t8142-scdc-coproc
        -
          contains:
            const: apple,scdc-coproc
  required:
    - compatible
description: |
  Apple camera processing coprocessor. Initial resource description for an unsupported firmware/backend
  layout. Register, IRQ and DMA topology can be recorded before a driver exists. This form must stay
  disabled; it does not substitute for the enabled driver contract or supply firmware, calibration,
  programming sequences or unresolved providers.
properties:
  compatible:
    items:
      -
        enum:
          - apple,t8142-scdc-coproc
      -
        const: apple,scdc-coproc
  status:
    const: disabled
  reg:
    description: Register apertures of the complete hardware complex, in hardware interface order.
    minItems: 8
    maxItems: 8
  interrupts:
    description: Interrupt lines wired to the system interrupt controller.
    minItems: 5
    maxItems: 5
  iommus:
    description: DMA translation streams emitted by this hardware.
    minItems: 2
    maxItems: 2
  power-domains:
    description: Power and combined clock gates required by this hardware.
    maxItems: 1
required:
  - compatible
  - reg
  - status
additionalProperties: false
```

## Documentation/devicetree/bindings/soc/apple/apple,secure-repair.yaml
```yaml
# SPDX-License-Identifier: (GPL-2.0-only OR BSD-2-Clause)
%YAML 1.2
---
$id: http://devicetree.org/schemas/soc/apple/apple,secure-repair.yaml#
$schema: http://devicetree.org/meta-schemas/core.yaml#
title: Apple secure repair mailbox
maintainers:
  - Ryan Murray <81541646+RyanTheTide@users.noreply.github.com>
select:
  properties:
    compatible:
      allOf:
        -
          contains:
            enum:
              - apple,t8142-secure-repair
              - apple,t8152-secure-repair
              - apple,t6050-secure-repair
        -
          contains:
            const: apple,secure-repair
  required:
    - compatible
description: |
  Apple secure repair mailbox. Initial resource description for an unsupported firmware/backend layout.
  Register, IRQ and DMA topology can be recorded before a driver exists. This form must stay disabled;
  it does not substitute for the enabled driver contract or supply firmware, calibration, programming
  sequences or unresolved providers.
properties:
  compatible:
    items:
      -
        enum:
          - apple,t8142-secure-repair
          - apple,t8152-secure-repair
          - apple,t6050-secure-repair
      -
        const: apple,secure-repair
  status:
    const: disabled
  reg:
    description: Register apertures of the complete hardware complex, in hardware interface order.
    maxItems: 1
  interrupts:
    description: Interrupt lines wired to the system interrupt controller.
    minItems: 7
    maxItems: 7
required:
  - compatible
  - reg
  - status
additionalProperties: false
```

## Documentation/devicetree/bindings/soc/apple/apple,sep.yaml
```yaml
# SPDX-License-Identifier: (GPL-2.0-only OR BSD-2-Clause)
%YAML 1.2
---
$id: http://devicetree.org/schemas/soc/apple/apple,sep.yaml#

$schema: http://devicetree.org/meta-schemas/core.yaml#

title: Apple Secure Enclave Processor

maintainers:
  - Ryan Murray <ryan@aurorasilicon.org>

description:
  The Secure Enclave Processor (SEP) is a coprocessor on Apple SoCs that
  holds device keys, provides a hardware random number generator and runs
  the Touch ID matcher. The bootloader starts it. The operating system talks
  to it through an ASC mailbox and through shared memory that the SEP
  reaches via its own DART.

select:
  anyOf:
    -
      properties:
        compatible:
          contains:
            enum:
              - "apple,sep"
              - "apple,t6030-sep"
              - "apple,t6031-sep"
      required:
        - "compatible"
    -
      properties:
        compatible:
          items:
            -
              const: "apple,t6050-sep"
            -
              const: "apple,sep"
      required:
        - "compatible"

properties:
  compatible: true
  reg: true
  mboxes:
    maxItems: 1
  mbox-names:
    const: mbox
  iommus: true
  power-domains: true
  memory-region: true
  iboot-manifest:
    $ref: /schemas/types.yaml#/definitions/uint8-array
    description:
      The signed iBoot manifest of the running boot, added by the bootloader.
      The SEP needs it to open the machine's secure storage.
  local-policy-manifest:
    $ref: /schemas/types.yaml#/definitions/uint8-array
    description:
      The signed local boot policy of the running boot, added by the
      bootloader, for the same purpose.
  interrupts: true
  clocks: true
  resets: true
  status: true

additionalProperties: true

allOf:
  - if:
      anyOf:
        -
          properties:
            compatible:
              items:
                -
                  const: "apple,t6050-sep"
                -
                  const: "apple,sep"
            status:
              const: "disabled"
          required:
            - "compatible"
            - "status"
    then:
      oneOf:
        -
          description: "T6050 native resource description. Firmware ownership, backend support and enables require separate qualification. This variant remains disabled and contains no programming sequences or firmware data."
          properties:
            compatible:
              items:
                -
                  const: "apple,t6050-sep"
                -
                  const: "apple,sep"
            status:
              const: "disabled"
            reg:
              minItems: 2
              maxItems: 2
              description: "Native register apertures in hardware-interface order, including shared auxiliary views."
            interrupts:
              minItems: 4
              maxItems: 4
            iommus:
              maxItems: 1
            power-domains:
              maxItems: 1
            clocks:
              maxItems: 1
          required:
            - "compatible"
            - "reg"
            - "status"
            - "interrupts"
            - "iommus"
            - "power-domains"
            - "clocks"
          additionalProperties: false
    else:
      properties:
        compatible:
          oneOf:
            - const: apple,sep
            - items:
                - enum:
                    - apple,t6030-sep
                    - apple,t6031-sep
                - const: apple,sep

        reg:
          minItems: 1
          items:
            - description: Coprocessor control registers
            - description: Coprocessor boot interface

        mboxes:
          maxItems: 1

        mbox-names:
          const: mbox

        iommus:
          maxItems: 1

        power-domains:
          minItems: 1
          items:
            - description: The SEP's own power state.
            - description:
                A power state the SEP depends on while it runs. On T8140 this is
                the GPIO power state; the SEP stops servicing its mailbox for good
                once that is switched off.

        memory-region:
          maxItems: 1
          description:
            The SEP firmware carveout, added by the bootloader.

        iboot-manifest:
          $ref: /schemas/types.yaml#/definitions/uint8-array
          description:
            The signed iBoot manifest of the running boot, added by the bootloader.
            The SEP needs it to open the machine's secure storage.

        local-policy-manifest:
          $ref: /schemas/types.yaml#/definitions/uint8-array
          description:
            The signed local boot policy of the running boot, added by the
            bootloader, for the same purpose.
      required:
        - compatible
        - reg
        - mboxes
        - mbox-names
        - iommus
      additionalProperties: false

examples:
  - |
    soc {
        #address-cells = <2>;
        #size-cells = <2>;

        sep@282600000 {
            compatible = "apple,sep";
            reg = <0x2 0x82600000 0x0 0x88000>;
            mboxes = <&sep_mbox>;
            mbox-names = "mbox";
            iommus = <&sep_dart 0>;
            power-domains = <&ps_sep>;
        };
    };
```
