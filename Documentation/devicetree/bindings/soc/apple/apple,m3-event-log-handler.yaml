## Documentation/devicetree/bindings/soc/apple/apple,m3-event-log-handler.yaml
```yaml
# SPDX-License-Identifier: (GPL-2.0-only OR BSD-2-Clause)
%YAML 1.2
---
$id: http://devicetree.org/schemas/soc/apple/apple,m3-event-log-handler.yaml#
$schema: http://devicetree.org/meta-schemas/core.yaml#

title: Apple M3 family event log interrupt interface

maintainers:
  - Ryan Murray <81541646+RyanTheTide@users.noreply.github.com>

description: |
  Hardware resources of the M3 family event log interrupt interface.
  The interface is described for discovery and must remain disabled until
  its ownership, initialization and shutdown are supported. Register windows
  are listed in hardware resource order; firmware configuration and tuning
  data are supplied by the boot firmware rather than this binding.

select:
  properties:
    compatible:
      contains:
        enum:
          - apple,t8122-event-log-handler
          - apple,t6030-event-log-handler
          - apple,t6031-event-log-handler
  required:
    - compatible

properties:
  compatible:
    items:
      - enum:
          - apple,t8122-event-log-handler
          - apple,t6030-event-log-handler
          - apple,t6031-event-log-handler
      - const: apple,event-log-handler

  reg:
    minItems: 13
    maxItems: 26

  interrupts:
    minItems: 13
    maxItems: 26

required:
  - compatible
  - reg
  - interrupts

additionalProperties: false
```

## Documentation/devicetree/bindings/soc/apple/apple,m3-rsm.yaml
```yaml
# SPDX-License-Identifier: (GPL-2.0-only OR BSD-2-Clause)
%YAML 1.2
---
$id: http://devicetree.org/schemas/soc/apple/apple,m3-rsm.yaml#
$schema: http://devicetree.org/meta-schemas/core.yaml#

title: Apple M3 family remote service manager

maintainers:
  - Ryan Murray <81541646+RyanTheTide@users.noreply.github.com>

description: |
  Hardware resources of the M3 family remote service manager.
  The interface is described for discovery and must remain disabled until
  its ownership, initialization and shutdown are supported. Register windows
  are listed in hardware resource order; firmware configuration and tuning
  data are supplied by the boot firmware rather than this binding.

select:
  properties:
    compatible:
      contains:
        enum:
          - apple,t8122-rsm
          - apple,t6030-rsm
          - apple,t6031-rsm
  required:
    - compatible

properties:
  compatible:
    items:
      - enum:
          - apple,t8122-rsm
          - apple,t6030-rsm
          - apple,t6031-rsm
      - const: apple,rsm

  reg:
    minItems: 2
    maxItems: 2

  interrupts:
    minItems: 1
    maxItems: 1

  power-domains:
    minItems: 1
    maxItems: 1

  iommus:
    minItems: 1
    maxItems: 1

required:
  - compatible
  - reg
  - interrupts
  - iommus

additionalProperties: false
```

## Documentation/devicetree/bindings/soc/apple/apple,msg.yaml
```yaml
# SPDX-License-Identifier: (GPL-2.0-only OR BSD-2-Clause)
%YAML 1.2
---
$id: http://devicetree.org/schemas/soc/apple/apple,msg.yaml#
$schema: http://devicetree.org/meta-schemas/core.yaml#

title: Apple MSG block

maintainers:
  - Ryan Murray <81541646+RyanTheTide@users.noreply.github.com>

description: |
  A T6050 block described from the ADT so that the device tree lists all of
  the SoC's hardware. No driver uses it yet: the node stays disabled until
  one does and the block is brought up on hardware.

properties:
  compatible:
    items:
      - const: apple,t6050-msg
      - const: apple,msg

  reg:
    minItems: 2
    maxItems: 2
    description: Register windows in the ADT's order, including views shared with other blocks.

  interrupts:
    minItems: 41
    maxItems: 41

  power-domains:
    maxItems: 1

required:
  - compatible
  - reg
  - interrupts
  - power-domains

additionalProperties: false
```

## Documentation/devicetree/bindings/soc/apple/apple,phy-coproc.yaml
```yaml
# SPDX-License-Identifier: (GPL-2.0-only OR BSD-2-Clause)
%YAML 1.2
---
$id: http://devicetree.org/schemas/soc/apple/apple,phy-coproc.yaml#
$schema: http://devicetree.org/meta-schemas/core.yaml#

title: Apple Type-C PHY coprocessor

maintainers:
  - Ryan Murray <81541646+RyanTheTide@users.noreply.github.com>

description: |
  A T6050 block described from the ADT so that the device tree lists all of
  the SoC's hardware. No driver uses it yet: the node stays disabled until
  one does and the block is brought up on hardware.

properties:
  compatible:
    items:
      - const: apple,t6050-phy-coproc
      - const: apple,phy-coproc

  reg:
    minItems: 2
    maxItems: 2
    description: Register windows in the ADT's order, including views shared with other blocks.

  interrupts:
    minItems: 4
    maxItems: 4

required:
  - compatible
  - reg
  - interrupts

additionalProperties: false
```

## Documentation/devicetree/bindings/soc/apple/apple,pmp.yaml
```yaml
# SPDX-License-Identifier: (GPL-2.0-only OR BSD-2-Clause)
%YAML 1.2
---
$id: http://devicetree.org/schemas/soc/apple/apple,pmp.yaml#
$schema: http://devicetree.org/meta-schemas/core.yaml#

title: Apple power management co-processor

maintainers:
  - Ryan Murray <ryan@aurorasilicon.org>

description: |
  The PMP runs firmware loaded by the bootloader. Linux starts it through
  RTKit and supplies calibration copied from the Apple device tree. The
  bootloader must initialize the PMP DART address protection filter before
  Linux starts the firmware. Firmware-owned PMC power state must be retained.
  On T6000 and T8112 the board and DRAM vendor identifiers are required at
  runtime, together with the firmware-requested calibration. They are supplied
  from the current boot's Apple device tree, not from static board DTS values.

properties:
  compatible:
    oneOf:
      - items:
          - const: apple,t6020-pmp-v2
          - const: apple,t6000-pmp-v2
      - const: apple,t6000-pmp-v2
      - items:
          - enum:
              - apple,t6030-pmp-v2
              - apple,t6031-pmp-v2
              - apple,t8112-pmp-v2
              - apple,t6041-pmp-v2
              - apple,t6050-pmp-v2
              - apple,t8122-pmp-v2
              - apple,t8132-pmp-v2
              - apple,t8140-pmp-v2
          - const: apple,t6000-pmp-v2
      - items:
          - const: apple,t8142-pmp-v2
          - const: apple,t8140-pmp-v2
      - items:
          - const: apple,t8103-pmp
          - const: apple,pmp

  reg:
    minItems: 2
    maxItems: 37
    description:
      Coprocessor and peripheral register views. First-generation firmware
      views include shared apertures; a driver must coordinate ownership
      rather than claim every view as an exclusive resource.

  reg-names:
    items:
      - const: pmp
      - const: asc

  mboxes:
    maxItems: 1

  mbox-names:
    const: mbox

  interrupts:
    maxItems: 4
    description: Coprocessor mailbox and status interrupts.

  iommus:
    maxItems: 1

  power-domains:
    minItems: 1
    maxItems: 2

  apple,pmp-report:
    $ref: /schemas/types.yaml#/definitions/phandle
    description: Report provider whose running state qualifies device-power requests.

  apple,board-id:
    $ref: /schemas/types.yaml#/definitions/uint32
    description: Required runtime board identifier copied from ADT /chosen/board-id.

  apple,dram-vendor-id:
    $ref: /schemas/types.yaml#/definitions/uint32
    description: Required runtime DRAM vendor identifier copied from ADT /chosen/dram-vendor-id.

  apple,dram-capacity:
    $ref: /schemas/types.yaml#/definitions/uint32
    description: Firmware DRAM capacity value copied by the bootloader.

  apple,dram-channel-disable:
    $ref: /schemas/types.yaml#/definitions/uint32
    description: Disabled DRAM channel mask (boot argument DCHD), copied by the bootloader.

  apple,pmc:
    $ref: /schemas/types.yaml#/definitions/uint32
    description: Boot argument PMC_, the PMGR's pmc value in the Apple device tree.

  apple,pmc-pmgr:
    $ref: /schemas/types.yaml#/definitions/uint32
    description:
      PMGR PMC configuration word from the Apple device tree. Bits 0 and 3
      are passed as the boot arguments PMCV and PMCB.

  status: true

  apple,pmc-msg-disabled:
    $ref: /schemas/types.yaml#/definitions/uint32
    description: Boot argument PMCX, from the Apple device tree.

  apple,soc-chip-variant:
    $ref: /schemas/types.yaml#/definitions/uint32
    description: SoC chip variant (boot argument CVAR), copied by the bootloader.

  apple,pio-ranges:
    $ref: /schemas/types.yaml#/definitions/uint64-array
    minItems: 2
    maxItems: 36
    description: |
      Host physical address and size pairs mapped into firmware PIO space.
      T6000 supplies its SoC-specific mapper ranges; T8112 has no PIO table.

  apple,tunable-segment-names:
    $ref: /schemas/types.yaml#/definitions/string
    description:
      The firmware's segment names from the Apple device tree, separated by
      semicolons. The firmware reads them as the raw string.

patternProperties:
  '^apple,tunable-(?!segment-names$)':
    $ref: /schemas/types.yaml#/definitions/uint8-array
    description: Opaque firmware calibration copied from the Apple device tree.

required:
  - compatible
  - reg
  - iommus

allOf:
  - if:
      properties:
        compatible:
          contains:
            const: apple,t8103-pmp
    then:
      properties:
        reg:
          minItems: 37
        power-domains:
          minItems: 2
      required:
        - power-domains
        - mboxes
        - mbox-names
    else:
      if:
        properties:
          compatible:
            contains:
              const: apple,t6050-pmp-v2
      then:
        description:
          The T6050 PMP's firmware SRAM and ASC views and its ASC mailbox. It
          also holds the PMS SRAM's power domain.
        properties:
          reg:
            maxItems: 2
          power-domains:
            minItems: 2
          interrupts: false
        required:
          - reg-names
          - mboxes
          - mbox-names
          - power-domains
      else:
        properties:
          reg:
            maxItems: 2
          power-domains:
            maxItems: 1
          interrupts: false
        required:
          - reg-names
          - mboxes
          - mbox-names

additionalProperties: false

examples:
  - |
    soc {
        #address-cells = <2>;
        #size-cells = <2>;

        pmp@300500000 {
            compatible = "apple,t8140-pmp-v2", "apple,t6000-pmp-v2";
            reg = <3 0x00500000 0 0xa0000>, <3 0x00e00000 0 0x4000>;
            reg-names = "pmp", "asc";
            mboxes = <&pmp_mbox>;
            mbox-names = "mbox";
            iommus = <&pmp_dart 0>;
        };
    };
```

## Documentation/devicetree/bindings/soc/apple/apple,processor-trace.yaml
```yaml
# SPDX-License-Identifier: (GPL-2.0-only OR BSD-2-Clause)
%YAML 1.2
---
$id: http://devicetree.org/schemas/soc/apple/apple,processor-trace.yaml#
$schema: http://devicetree.org/meta-schemas/core.yaml#
title: Apple cpu processor trace windows
maintainers:
  - Ryan Murray <81541646+RyanTheTide@users.noreply.github.com>
select:
  properties:
    compatible:
      allOf:
        -
          contains:
            enum:
              - apple,t8142-processor-trace
              - apple,t8152-processor-trace
              - apple,t6050-processor-trace
        -
          contains:
            const: apple,processor-trace
  required:
    - compatible
description: |
  Apple cpu processor trace windows. Initial resource description for an unsupported firmware/backend
  layout. Register, IRQ and DMA topology can be recorded before a driver exists. This form must stay
  disabled; it does not substitute for the enabled driver contract or supply firmware, calibration,
  programming sequences or unresolved providers.
properties:
  compatible:
    items:
      -
        enum:
          - apple,t8142-processor-trace
          - apple,t8152-processor-trace
          - apple,t6050-processor-trace
      -
        const: apple,processor-trace
  status:
    const: disabled
  reg:
    description: Register apertures of the complete hardware complex, in hardware interface order.
    minItems: 20
    maxItems: 33
  power-domains:
    description: Physical power and combined clock-gate dependencies.
    minItems: 1
    maxItems: 8
required:
  - compatible
  - reg
  - status
additionalProperties: false
```

## Documentation/devicetree/bindings/soc/apple/apple,rsm.yaml
```yaml
# SPDX-License-Identifier: (GPL-2.0-only OR BSD-2-Clause)
%YAML 1.2
---
$id: http://devicetree.org/schemas/soc/apple/apple,rsm.yaml#
$schema: http://devicetree.org/meta-schemas/core.yaml#

title: Apple remote service manager

maintainers:
  - Ryan Murray <81541646+RyanTheTide@users.noreply.github.com>

description: |
  Remote service manager register banks, interrupt and DART stream.

select:
  properties:
    compatible:
      contains:
        enum:
          - apple,t6030-rsm
          - apple,t6031-rsm
          - apple,t6032-rsm
          - apple,t6050-rsm
          - apple,t8122-rsm
          - apple,t8140-rsm
          - apple,t8142-rsm
          - apple,t8152-rsm
  required:
    - compatible

properties:
  compatible: true

allOf:
  - if:
      properties:
        compatible:
          contains:
            enum:
              - apple,t6032-rsm
              - apple,t6050-rsm
      required:
        - compatible
    then:
      properties:
        compatible:
          items:
            - enum:
                - apple,t6032-rsm
                - apple,t6050-rsm
            - const: apple,rsm

        reg:
          minItems: 2
          maxItems: 2

        interrupts:
          maxItems: 1

        power-domains:
          maxItems: 1

        iommus:
          maxItems: 1

      required:
        - compatible
        - reg
        - interrupts
        - power-domains
        - iommus
    else:
      properties:
        compatible:
          items:
            - enum:
                - apple,t6030-rsm
                - apple,t6031-rsm
                - apple,t8122-rsm
                - apple,t8140-rsm
                - apple,t8142-rsm
                - apple,t8152-rsm
            - const: apple,rsm

        reg:
          minItems: 2
          maxItems: 2
          description: Register apertures in hardware-description order.

        interrupts:
          maxItems: 1

        iommus:
          maxItems: 1

        power-domains:
          maxItems: 1

      required:
        - compatible
        - reg
        - interrupts
        - iommus

      additionalProperties: false

unevaluatedProperties: false
```
