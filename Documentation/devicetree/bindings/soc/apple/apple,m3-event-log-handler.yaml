## Documentation/devicetree/bindings/soc/apple/apple,t6050-pciec-piodma.yaml
```yaml
# SPDX-License-Identifier: (GPL-2.0-only OR BSD-2-Clause)
%YAML 1.2
---
$id: http://devicetree.org/schemas/soc/apple/apple,t6050-pciec-piodma.yaml#
$schema: http://devicetree.org/meta-schemas/core.yaml#

title: Apple T6050 pcie tunnel programmed i/o dma engine

maintainers:
  - Ryan Murray <ryan@aurorasilicon.org>

description: |
  PCIe tunnel programmed I/O DMA engine on T6050. This describes the complete register complex,
  including auxiliary control and status apertures shared with firmware.
  It does not imply compatibility with an earlier generation's driver.
  The node remains disabled until ownership of the register windows and
  the firmware handoff have been established. Calibration, firmware and
  programming sequences are supplied separately by the boot environment.

select:
  properties:
    compatible:
      contains:
        const: apple,t6050-pciec-piodma
  required:
    - compatible

properties:
  compatible:
    items:
      - const: apple,t6050-pciec-piodma
      - const: apple,pciec-piodma

  reg:
    description: Controller register apertures, in hardware interface order.
    minItems: 4
    maxItems: 4

  interrupts:
    description: Interrupt lines wired to the system interrupt controller.
    minItems: 1
    maxItems: 1

  iommus:
    description: DMA translation streams used by this controller.
    minItems: 1
    maxItems: 1

required:
  - compatible
  - reg

additionalProperties: false
```
