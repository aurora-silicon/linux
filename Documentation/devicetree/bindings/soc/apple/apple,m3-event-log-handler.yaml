## Documentation/devicetree/bindings/soc/apple/apple,t6040-sleep.yaml
```yaml
# SPDX-License-Identifier: (GPL-2.0-only OR BSD-2-Clause)
%YAML 1.2
---
$id: http://devicetree.org/schemas/soc/apple/apple,t6040-sleep.yaml#
$schema: http://devicetree.org/meta-schemas/core.yaml#

title: Apple T6040 system sleep controller

maintainers:
  - František Balázsy <frantisekbalazsy@gmail.com>

description: |
  What an operating system that runs at EL2, with no firmware below it to ask,
  drives itself to suspend the T6040 to RAM and to bring it back: the CPU
  start block, the always-on watchdog, the complex and power-gate words, the
  PMU's SPMI controllers and the always-on timer that starts the SoC's sleep
  engine. All of these register blocks are shared with the devices that own
  them. Without the blocks a suspend can be checked, and not entered.

  The sleep engine waits for the display pipes, so the node lists the power
  states that have to be off before a sleep, as the ADT's
  device-check-ps-b4-sleep table does. Each entry names a PMGR register block,
  the offset of a display pipe's CPU power state and the offset of its last
  sub-block; the states in between are 8 bytes apart.

properties:
  compatible:
    const: apple,t6040-sleep

  reg:
    minItems: 2
    items:
      - description: CPU start/stop block (pmgr + 0x88000)
      - description: AON watchdog
      - description: control words of the three CPU complexes
      - description: SoC power gate, wake and retention voters
      - description: clock generator, the clock mux park words
      - description: SPMI controller of the PMU (boot stage, notify, hibernate)
      - description: second SPMI controller's notify word
      - description: MasterMini block with the S2R timer
      - description: SOC-East retention and power words
      - description: PMGR power words of the west axi2af bridges
      - description: AOP global block, S2R control and wake masks

  reg-names:
    minItems: 2
    items:
      - const: cpu-start
      - const: wdt
      - const: cluster-ctl
      - const: soc-pwrgate
      - const: clkgen
      - const: spmi0
      - const: spmi-a0
      - const: mastermini
      - const: soc-east
      - const: soc-ps
      - const: aop-global

  apple,check-ps-b4-sleep:
    $ref: /schemas/types.yaml#/definitions/phandle-array
    description:
      The display pipes whose power states have to be off before a sleep, one
      entry per pipe.
    items:
      items:
        - description: PMGR syscon
        - description: offset of the pipe's CPU power state
        - description: offset of its last sub-block's power state

  apple,check-ps-b4-sleep-names:
    $ref: /schemas/types.yaml#/definitions/string-array
    description: One name per apple,check-ps-b4-sleep entry.

  apple,apcie:
    $ref: /schemas/types.yaml#/definitions/phandle
    description:
      The PCIe host whose shared registers and tunables the storage controller's
      link depends on. The boot loader adds it, with those registers and
      tunables on the host's node. Without it the storage controller can't be
      stopped for a sleep.

required:
  - compatible
  - apple,check-ps-b4-sleep
  - apple,check-ps-b4-sleep-names

additionalProperties: false

examples:
  - |
    sleep-controller {
        compatible = "apple,t6040-sleep";
        apple,check-ps-b4-sleep = <&pmgr_disp 0x0 0x58>;
        apple,check-ps-b4-sleep-names = "disp";
    };
```

## Documentation/devicetree/bindings/soc/apple/apple,t6041-aop.yaml
```yaml
# SPDX-License-Identifier: (GPL-2.0-only OR BSD-2-Clause)
%YAML 1.2
---
$id: http://devicetree.org/schemas/soc/apple/apple,t6041-aop.yaml#

$schema: http://devicetree.org/meta-schemas/core.yaml#

title: Apple T604x and T8132 Always-On Processor

maintainers:
  - Jonathan Goyvaerts <jonathan.goyvaerts@gmail.com>

description:
  The Always-On Processor provides audio and sensor services through firmware
  loaded by the bootloader. The application processor patches the firmware's
  boot arguments in the AOP SRAM, starts it through RTKit over one mailbox and
  reaches its services through the RTKit endpoints. The firmware's external
  code and log segments live in DRAM, and the bootloader reserves them.

  On T8132 the bootloader also programs the AOP DART's address filter (DAPF)
  and reserves its windows, which the firmware reaches through its DART at
  their physical addresses.

select:
  anyOf:
    -
      properties:
        compatible:
          contains:
            enum:
              - "apple,t6041-aop"
              - "apple,t8132-aop"
      required:
        - "compatible"
    -
      properties:
        compatible:
          allOf:
            -
              contains:
                enum:
                  - "apple,t8142-aop"
                  - "apple,t8152-aop"
                  - "apple,t6050-aop"
            -
              contains:
                const: "apple,aop"
      required:
        - "compatible"
allOf:
  -
    if:
      anyOf:
        -
          properties:
            compatible:
              allOf:
                -
                  contains:
                    enum:
                      - "apple,t8142-aop"
                      - "apple,t8152-aop"
                      - "apple,t6050-aop"
                -
                  contains:
                    const: "apple,aop"
            status:
              const: "disabled"
          required:
            - "compatible"
            - "status"
          not:
            required:
              - "mboxes"
    then:
      oneOf:
        -
          description: "Apple always-on processor. Initial resource description for an unsupported firmware/backend layout. Register, IRQ and DMA topology can be recorded before a driver exists. This form must stay disabled; it does not substitute for the enabled driver contract or supply firmware, calibration, programming sequences or unresolved providers."
          properties:
            compatible:
              items:
                -
                  enum:
                    - "apple,t8142-aop"
                    - "apple,t8152-aop"
                    - "apple,t6050-aop"
                -
                  const: "apple,aop"
            status:
              const: "disabled"
            reg:
              description: "Register apertures of the complete hardware complex, in hardware interface order."
              minItems: 3
              maxItems: 6
            interrupts:
              description: "Interrupt lines wired to the system interrupt controller."
              minItems: 3
              maxItems: 4
            iommus:
              description: "DMA translation streams emitted by this hardware."
              maxItems: 1
          required:
            - "compatible"
            - "reg"
            - "status"
          additionalProperties: false
    else:
      $ref: "#/$defs/legacy-driver"

$defs:
  legacy-driver:
    properties:
      compatible:
        enum:
          - apple,t6041-aop
          - apple,t8132-aop

      reg:
        minItems: 2
        items:
          - description: AOP SRAM, holding the boot-argument table
          - description: ASC wrapper and processor control registers
          - description: Second ASC register window
          - description: AOP configuration registers

      reg-names:
        minItems: 2
        items:
          - const: firmware
          - const: asc
          - const: asc-aux
          - const: config

      mboxes:
        maxItems: 1

      mbox-names:
        const: mbox

      nonposted-mmio: true

      iommus:
        maxItems: 1

      memory-region:
        minItems: 1
        maxItems: 18
        description:
          The firmware segments in DRAM (its external code and its log) and, on
          T8132, the DAPF windows, filled in by the bootloader from the ADT. The
          iommu-addresses property of each region gives the address the firmware
          uses for it.

      audio:
        type: object
        $ref: /schemas/sound/apple,t6041-aop-audio.yaml#
        description: The audio service.

      als:
        type: object
        description: The ambient light sensor service.
        additionalProperties: false

        properties:
          compatible:
            items:
              - const: apple,t6041-aop-als
              - const: apple,aop-als

        required:
          - compatible

      las:
        type: object
        description: The lid angle sensor service.
        additionalProperties: false

        properties:
          compatible:
            items:
              - const: apple,t6041-aop-las
              - const: apple,aop-las

        required:
          - compatible

      accel:
        type: object
        $ref: /schemas/iio/imu/apple,aop-motion.yaml#
        description: The accelerometer service.
        unevaluatedProperties: false

      gyro:
        type: object
        $ref: /schemas/iio/imu/apple,aop-motion.yaml#
        description: The gyroscope service.
        unevaluatedProperties: false
    required:
      - compatible
      - reg
      - mboxes
      - mbox-names
      - iommus
    allOf:
      - if:
          properties:
            compatible:
              const: apple,t6041-aop
        then:
          properties:
            memory-region:
              maxItems: 4
    additionalProperties: false

examples:
  - |
    soc {
        #address-cells = <2>;
        #size-cells = <2>;

        aop@510c10000 {
            compatible = "apple,t6041-aop";
            reg = <0x5 0x10c10000 0x0 0x2e0000>,
                  <0x5 0x10600000 0x0 0x88000>,
                  <0x5 0x10050000 0x0 0x4000>,
                  <0x5 0x08328000 0x0 0x24>;
            reg-names = "firmware", "asc", "asc-aux", "config";
            mboxes = <&aop_mbox>;
            mbox-names = "mbox";
            iommus = <&aop_dart 0>;
            memory-region = <&aop_etext>, <&aop_oslog>; /* Filled by the bootloader */

            als {
                compatible = "apple,t6041-aop-als", "apple,aop-als";
            };

            las {
                compatible = "apple,t6041-aop-las", "apple,aop-las";
            };

            accel {
                compatible = "apple,t6041-aop-accel", "apple,aop-accel";
            };

            gyro {
                compatible = "apple,t6041-aop-gyro", "apple,aop-gyro";
            };
        };
    };
```

## Documentation/devicetree/bindings/soc/apple/apple,t6050-atc-phy-complex.yaml
```yaml
# SPDX-License-Identifier: (GPL-2.0-only OR BSD-2-Clause)
%YAML 1.2
---
$id: http://devicetree.org/schemas/soc/apple/apple,t6050-atc-phy-complex.yaml#
$schema: http://devicetree.org/meta-schemas/core.yaml#

title: Apple T6050 type-c phy complex

maintainers:
  - Ryan Murray <ryan@aurorasilicon.org>

description: |
  Type-C PHY complex on T6050. This describes the complete register complex,
  including auxiliary control and status apertures shared with firmware.
  It does not imply compatibility with an earlier generation's driver.
  The node remains disabled until ownership of the register windows and
  the firmware handoff have been established. Calibration, firmware and
  programming sequences are supplied separately by the boot environment.

select:
  properties:
    compatible:
      contains:
        const: apple,t6050-atc-phy-complex
  required:
    - compatible

properties:
  compatible:
    items:
      - const: apple,t6050-atc-phy-complex
      - const: apple,atc-phy-complex

  reg:
    description: Controller register apertures, in hardware interface order.
    minItems: 44
    maxItems: 44

required:
  - compatible
  - reg

additionalProperties: false
```

## Documentation/devicetree/bindings/soc/apple/apple,t6050-dp-in.yaml
```yaml
# SPDX-License-Identifier: (GPL-2.0-only OR BSD-2-Clause)
%YAML 1.2
---
$id: http://devicetree.org/schemas/soc/apple/apple,t6050-dp-in.yaml#
$schema: http://devicetree.org/meta-schemas/core.yaml#

title: Apple T6050 displayport input adapter

maintainers:
  - Ryan Murray <ryan@aurorasilicon.org>

description: |
  DisplayPort input adapter on T6050. This describes the complete register complex,
  including auxiliary control and status apertures shared with firmware.
  It does not imply compatibility with an earlier generation's driver.
  The node remains disabled until ownership of the register windows and
  the firmware handoff have been established. Calibration, firmware and
  programming sequences are supplied separately by the boot environment.

select:
  properties:
    compatible:
      contains:
        const: apple,t6050-dp-in
  required:
    - compatible

properties:
  compatible:
    items:
      - const: apple,t6050-dp-in
      - const: apple,dp-in

  reg:
    description: Controller register apertures, in hardware interface order.
    minItems: 1
    maxItems: 1

  interrupts:
    description: Interrupt lines wired to the system interrupt controller.
    minItems: 1
    maxItems: 1

required:
  - compatible
  - reg

additionalProperties: false
```

## Documentation/devicetree/bindings/soc/apple/apple,t6050-gpu-complex.yaml
```yaml
# SPDX-License-Identifier: (GPL-2.0-only OR BSD-2-Clause)
%YAML 1.2
---
$id: http://devicetree.org/schemas/soc/apple/apple,t6050-gpu-complex.yaml#
$schema: http://devicetree.org/meta-schemas/core.yaml#

title: Apple T6050 graphics processor register complex

maintainers:
  - Ryan Murray <ryan@aurorasilicon.org>

description: |
  Graphics processor register complex on T6050. This describes the complete register complex,
  including auxiliary control and status apertures shared with firmware.
  It does not imply compatibility with an earlier generation's driver.
  The node remains disabled until ownership of the register windows and
  the firmware handoff have been established. Calibration, firmware and
  programming sequences are supplied separately by the boot environment.

select:
  properties:
    compatible:
      contains:
        const: apple,t6050-gpu-complex
  required:
    - compatible

properties:
  compatible:
    items:
      - const: apple,t6050-gpu-complex
      - const: apple,gpu-complex

  reg:
    description: Controller register apertures, in hardware interface order.
    minItems: 2
    maxItems: 2

  interrupts:
    description: Interrupt lines wired to the system interrupt controller.
    minItems: 8
    maxItems: 8

required:
  - compatible
  - reg

additionalProperties: false
```

## Documentation/devicetree/bindings/soc/apple/apple,t6050-pciec-complex.yaml
```yaml
# SPDX-License-Identifier: (GPL-2.0-only OR BSD-2-Clause)
%YAML 1.2
---
$id: http://devicetree.org/schemas/soc/apple/apple,t6050-pciec-complex.yaml#
$schema: http://devicetree.org/meta-schemas/core.yaml#

title: Apple T6050 pcie tunnel controller

maintainers:
  - Ryan Murray <ryan@aurorasilicon.org>

description: |
  PCIe tunnel controller on T6050. This describes the complete register complex,
  including auxiliary control and status apertures shared with firmware.
  It does not imply compatibility with an earlier generation's driver.
  The node remains disabled until ownership of the register windows and
  the firmware handoff have been established. Calibration, firmware and
  programming sequences are supplied separately by the boot environment.

select:
  properties:
    compatible:
      contains:
        const: apple,t6050-pciec-complex
  required:
    - compatible

properties:
  compatible:
    items:
      - const: apple,t6050-pciec-complex
      - const: apple,pciec-complex

  reg:
    description: Controller register apertures, in hardware interface order.
    minItems: 8
    maxItems: 8

  interrupts:
    description: Interrupt lines wired to the system interrupt controller.
    minItems: 6
    maxItems: 6

required:
  - compatible
  - reg

additionalProperties: false
```
