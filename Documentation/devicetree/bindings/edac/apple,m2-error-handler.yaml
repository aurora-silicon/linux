## Documentation/devicetree/bindings/edac/apple,m2-error-handler.yaml
```yaml
# SPDX-License-Identifier: (GPL-2.0-only OR BSD-2-Clause)
%YAML 1.2
---
$id: http://devicetree.org/schemas/edac/apple,m2-error-handler.yaml#
$schema: http://devicetree.org/meta-schemas/core.yaml#

title: Apple M2 generation platform error interrupt collector

maintainers:
  - Ryan Murray <81541646+RyanTheTide@users.noreply.github.com>

description: |
  Platform error interrupt collector resources on M2 generation SoCs. The register apertures
  follow hardware resource order. Firmware configuration and tuning are
  supplied by the bootloader and are not part of this binding. Unqualified
  instances must remain disabled.

select:
  properties:
    compatible:
      contains:
        enum:
          - apple,t6020-error-handler
          - apple,t6021-error-handler
          - apple,t6022-error-handler
          - apple,t8112-error-handler
  required:
    - compatible

properties:
  compatible:
    items:
      - enum:
          - apple,t6020-error-handler
          - apple,t6021-error-handler
          - apple,t6022-error-handler
          - apple,t8112-error-handler
      - const: apple,error-handler

  reg:
    minItems: 18
    maxItems: 255

  interrupts:
    minItems: 19
    maxItems: 322

  power-domains:
    maxItems: 1

required:
  - compatible
  - reg
  - interrupts

additionalProperties: false
```

## Documentation/devicetree/bindings/edac/apple,m2-event-log.yaml
```yaml
# SPDX-License-Identifier: (GPL-2.0-only OR BSD-2-Clause)
%YAML 1.2
---
$id: http://devicetree.org/schemas/edac/apple,m2-event-log.yaml#
$schema: http://devicetree.org/meta-schemas/core.yaml#

title: Apple M2 generation platform event interrupt collector

maintainers:
  - Ryan Murray <81541646+RyanTheTide@users.noreply.github.com>

description: |
  Platform event interrupt collector resources on M2 generation SoCs. The register apertures
  follow hardware resource order. Firmware configuration and tuning are
  supplied by the bootloader and are not part of this binding. Unqualified
  instances must remain disabled.

select:
  properties:
    compatible:
      contains:
        enum:
          - apple,t6020-event-log
          - apple,t6021-event-log
          - apple,t6022-event-log
          - apple,t8112-event-log
  required:
    - compatible

properties:
  compatible:
    items:
      - enum:
          - apple,t6020-event-log
          - apple,t6021-event-log
          - apple,t6022-event-log
          - apple,t8112-event-log
      - const: apple,event-log

  reg:
    minItems: 16
    maxItems: 86

  interrupts:
    minItems: 16
    maxItems: 56

required:
  - compatible
  - reg
  - interrupts

additionalProperties: false
```
