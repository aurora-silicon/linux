## Documentation/devicetree/bindings/firmware/aurora,apif-mmio.yaml
```yaml
# SPDX-License-Identifier: GPL-2.0-only
%YAML 1.2
---
$id: http://devicetree.org/schemas/firmware/aurora,apif-mmio.yaml#
$schema: http://devicetree.org/meta-schemas/core.yaml#

title: Aurora Platform Interface over Memory-Mapped I/O

maintainers:
  - Dj <hey@djdev.me>

description: |
  Synthetic MMIO transport supplied by Aura's EL2-resident monitor. Version 2
  forwards native SPTM selectors and arguments and provides memory-ownership
  services. Peripheral policy belongs to consumers, which reference this node
  through the aurora,apif phandle. The register page must be absent from the
  guest stage-2 mappings so accesses reach Aura.

properties:
  compatible:
    const: aurora,apif-mmio
  reg:
    maxItems: 1

required:
  - compatible
  - reg

additionalProperties: false

examples:
  - |
    apif: firmware@61ff0000 {
        compatible = "aurora,apif-mmio";
        reg = <0x61ff0000 0x4000>;
    };
```

## Documentation/devicetree/bindings/gpio/apple,smc-gpio.yaml
```yaml
# SPDX-License-Identifier: (GPL-2.0-only OR BSD-2-Clause)
%YAML 1.2
---
$id: http://devicetree.org/schemas/gpio/apple,smc-gpio.yaml#
$schema: http://devicetree.org/meta-schemas/core.yaml#

title: Apple Mac System Management Controller GPIO

maintainers:
  - Sven Peter <sven@kernel.org>

description:
  Apple Mac System Management Controller GPIO block.

properties:
  compatible:
    enum:
      - apple,smc-gpio
      - apple,smc-low-gpio

  gpio-controller: true

  '#gpio-cells':
    const: 2

  apple,output-templates:
    $ref: /schemas/types.yaml#/definitions/uint32-array
    minItems: 2
    maxItems: 128
    description: Pairs of GPIO number and native four-byte output template.

  apple,pcio-templates:
    $ref: /schemas/types.yaml#/definitions/uint32-array
    minItems: 3
    maxItems: 192
    description: Triples of GPIO number and native pcIO low/high word templates.

required:
  - compatible
  - gpio-controller
  - '#gpio-cells'

additionalProperties: false
```

## Documentation/devicetree/bindings/gpio/apple,smc-pcio-gpio.yaml
```yaml
# SPDX-License-Identifier: GPL-2.0-only
%YAML 1.2
---
$id: http://devicetree.org/schemas/gpio/apple,smc-pcio-gpio.yaml#
$schema: http://devicetree.org/meta-schemas/core.yaml#

title: Apple SMC pcIO output GPIOs

maintainers:
  - Dj <hey@djdev.me>

description: |
  The writable eight-byte pcIO SMC key controls outputs through board
  command templates. Each template has its low 16 bits clear; the driver
  inserts a boolean output level and sends the little-endian command.
  Input reads and mode changes are not supported by this interface.

properties:
  compatible:
    const: apple,smc-pcio-gpio

  gpio-controller: true

  '#gpio-cells':
    const: 2

  apple,output-commands:
    $ref: /schemas/types.yaml#/definitions/uint64-array
    minItems: 1
    maxItems: 64
    uniqueItems: true
    description: Unique command templates with low 16 bits clear, in GPIO order

required:
  - compatible
  - gpio-controller
  - '#gpio-cells'
  - apple,output-commands

additionalProperties: false
```

## Documentation/devicetree/bindings/gpu/apple,agx.yaml
```yaml
# SPDX-License-Identifier: (GPL-2.0 OR BSD-2-Clause)
%YAML 1.2
---
$id: http://devicetree.org/schemas/gpu/apple,agx.yaml#
$schema: http://devicetree.org/meta-schemas/core.yaml#

title: Apple SoC GPU

maintainers:
  - Sasha Finkelstein <k@chaosmail.tech>

properties:
  compatible:
    oneOf:
      - enum:
          - apple,agx-g13g
          - apple,agx-g13s
          - apple,agx-g14g
          - apple,agx-g14s
          - apple,agx-t6040
          - apple,agx-t8132
          - apple,agx-t8140
      - items:
          - enum:
              - apple,agx-g13c
              - apple,agx-g13d
          - const: apple,agx-g13s
      - items:
          - enum:
              - apple,agx-g14c
              - apple,agx-g14d
          - const: apple,agx-g14s

  reg:
    maxItems: 2

  reg-names:
    maxItems: 2

  power-domains:
    maxItems: 1

  mboxes:
    minItems: 1
    maxItems: 2

  memory-region:
    minItems: 3
    items:
      - description: Region containing GPU MMU TTBs
      - description: Region containing GPU MMU page tables
      - description:
          Region containing a shared handoff structure for VM
          management coordination
      - description:
          Power calibration blob, firmware shared-L2 page or firmware data
          segment
      - description:
          GPU calibration blob, preserved firmware text or firmware
          kernel-window page tables
      - description:
          Shared global variables, preserved firmware data or text segment of
          the loaded GPU firmware

  memory-region-names:
    minItems: 3
    items:
      - const: ttbs
      - const: pagetables
      - const: handoff
      - enum: [hw-cal-a, shared-l2, fw-data]
      - enum: [hw-cal-b, fw-text, l2-pagetables]
      - enum: [globals, fw-data, fw-text]

  apple,pmp:
    $ref: /schemas/types.yaml#/definitions/phandle
    description: PMP firmware provider owning the GPU power vote and telemetry

  operating-points-v2: true

  apple,firmware-version:
    $ref: /schemas/types.yaml#/definitions/uint32-array
    minItems: 3
    maxItems: 3
    description:
      macOS version (major, minor, patch) whose boot firmware loaded the GPU
      firmware, which identifies the firmware build. Filled in by the boot
      loader.

  apple,cs-opp:
    $ref: /schemas/types.yaml#/definitions/phandle
    description:
      Operating-point table of the GPU's CS clock domain, one voltage cell per
      state.

  apple,afr-opp:
    $ref: /schemas/types.yaml#/definitions/phandle
    description:
      Operating-point table of the GPU's AFR clock domain, one voltage cell
      per state.

  apple,firmware-abi:
    $ref: /schemas/types.yaml#/definitions/uint32-array
    minItems: 3
    description:
      macOS version the current firmware is paired with, used to pick
      the version of firmware ABI to be used.
      Bootloader will overwrite this

required:
  - compatible
  - reg
  - mboxes
  - memory-region

allOf:
  - if:
      properties:
        compatible:
          contains:
            const: apple,agx-t8132
    then:
      properties:
        reg:
          items:
            - description: GPU coprocessor control registers
            - description: GPU block MMIO registers
        mboxes:
          maxItems: 1
        reg-names:
          items:
            - const: asc
            - const: sgx
        memory-region:
          minItems: 6
        memory-region-names:
          items:
            - const: ttbs
            - const: pagetables
            - const: handoff
            - const: shared-l2
            - const: fw-text
            - const: fw-data
      required:
        - apple,pmp
        - power-domains
        - reg-names
        - memory-region-names
    else:
      properties:
        apple,pmp: false
  - if:
      properties:
        compatible:
          contains:
            const: apple,agx-t8140
    then:
      properties:
        reg:
          items:
            - description: GFX coprocessor control registers
            - description: GPU block MMIO registers
        reg-names:
          items:
            - const: asc
            - const: sgx
        mboxes:
          items:
            - description: GFX coprocessor mailbox
            - description: GFX1 coprocessor mailbox
        memory-region:
          items:
            - description: Region containing GPU MMU TTBs
            - description: Region containing GPU MMU page tables
            - description:
                Region containing a shared handoff structure for VM
                management coordination
        memory-region-names:
          items:
            - const: ttbs
            - const: pagetables
            - const: handoff
      required:
        - power-domains
        - operating-points-v2
  - if:
      properties:
        compatible:
          contains:
            const: apple,agx-t6040
    then:
      properties:
        reg:
          items:
            - description: GFX coprocessor control registers
            - description: GPU block MMIO registers
        reg-names:
          items:
            - const: asc
            - const: sgx
        mboxes:
          items:
            - description: GFX coprocessor mailbox
        memory-region:
          items:
            - description: Region containing GPU MMU TTBs
            - description: Region containing GPU MMU page tables
            - description:
                Region containing a shared handoff structure for VM
                management coordination
            - description:
                Data segment of the loaded GPU firmware, where the firmware
                places its crash log
            - description:
                Region in which the GPU firmware builds the page tables of
                its kernel window
            - description:
                Text segment of the loaded GPU firmware, which identifies the
                firmware build
        memory-region-names:
          items:
            - const: ttbs
            - const: pagetables
            - const: handoff
            - const: fw-data
            - const: l2-pagetables
            - const: fw-text
      required:
        - power-domains
        - operating-points-v2
        - apple,cs-opp
        - apple,afr-opp
  - if:
      not:
        properties:
          compatible:
            contains:
              enum:
                - apple,agx-t6040
                - apple,agx-t8132
                - apple,agx-t8140
    then:
      properties:
        reg:
          items:
            - description: GPU coprocessor control registers
            - description: GPU block MMIO registers
        reg-names:
          items:
            - const: asc
            - const: sgx
        mboxes:
          maxItems: 1
        memory-region:
          minItems: 6
        memory-region-names:
          items:
            - const: ttbs
            - const: pagetables
            - const: handoff
            - const: hw-cal-a
            - const: hw-cal-b
            - const: globals
      required:
        - apple,firmware-abi

additionalProperties: false

examples:
  - |
    gpu@6400000 {
        compatible = "apple,agx-g13g";
        reg = <0x6400000 0x40000>,
              <0x4000000 0x1000000>;
        reg-names = "asc", "sgx";
        mboxes = <&agx_mbox>;
        power-domains = <&ps_gfx>;
        memory-region = <&uat_ttbs>, <&uat_pagetables>, <&uat_handoff>,
                        <&gpu_hw_cal_a>, <&gpu_hw_cal_b>, <&gpu_globals>;
        memory-region-names = "ttbs", "pagetables", "handoff",
                              "hw-cal-a", "hw-cal-b", "globals";

        apple,firmware-abi = <0 0 0>;
    };
...
```

## Documentation/devicetree/bindings/hwmon/apple,smc-hwmon.yaml
```yaml
# SPDX-License-Identifier: (GPL-2.0-only OR BSD-2-Clause)
%YAML 1.2
---
$id: http://devicetree.org/schemas/hwmon/apple,smc-hwmon.yaml#
$schema: http://devicetree.org/meta-schemas/core.yaml#

title: Apple SMC Hardware Monitoring

description:
  Apple's System Management Controller (SMC) exposes a vast array of
  hardware monitoring sensors, including temperature probes, current and
  voltage sense, power meters, and fan speeds. It also provides endpoints
  to manually control the speed of each fan individually. Each Apple
  Silicon device exposes a different set of endpoints via SMC keys. This
  is true even when two machines share an SoC. The CPU core temperature
  sensor keys on an M1 Mac mini are different to those on an M1 MacBook
  Pro, for example.

maintainers:
  - James Calligeros <jcalligeros99@gmail.com>

$defs:
  sensor:
    type: object

    properties:
      apple,key-id:
        $ref: /schemas/types.yaml#/definitions/string
        pattern: "^[A-Za-z0-9]{4}$"
        description: The SMC FourCC key of the desired sensor.
          Must match the node's suffix.

      label:
        description: Human-readable name for the sensor

    required:
      - apple,key-id

properties:
  compatible:
    const: apple,smc-hwmon

  apple,soc-die-keys:
    $ref: /schemas/types.yaml#/definitions/string-array
    minItems: 1
    maxItems: 32
    items:
      pattern: "^[A-Za-z0-9]{4}$"
    description:
      SMC FourCC keys for SoC die temperature sensors. Each key must report a
      readable four-byte floating-point temperature in degrees Celsius. The
      hottest reading supplies the macsmc_soc_die thermal zone. These channels
      follow the temperature-* children in the listed order and are labelled
      "SoC die <key>". Keys absent from the running firmware or with an
      unsupported format are skipped. These channels do not change the indices
      used by thermal-sensors references to temperature-* children.

  apple,thermal-pressure-key:
    $ref: /schemas/types.yaml#/definitions/string
    pattern: "^[A-Za-z0-9]{4}$"
    description:
      SMC FourCC key reporting the firmware thermal pressure level as a
      readable signed 32-bit integer. This is exposed for monitoring only.

  apple,discover-temperatures:
    type: boolean
    description:
      Enumerate readable, non-function temperature keys from the running SMC
      instead of providing a board-specific temperature table. Only keys
      beginning with T and reporting a four-byte floating-point value are
      exposed. Labels are the key identifiers, without inferred locations.
      Channels are reporting-only; their indices depend on the firmware and
      must not be used by a static thermal policy.

  "#thermal-sensor-cells":
    const: 1
    description:
      The cell is the zero-based index of a temperature channel, counting
      the temperature-* child nodes in order.

  "#cooling-cells":
    const: 3
    deprecated: true
    description:
      Former fan cooling-device specifier. Fan policy is handled by the SMC
      firmware; the driver no longer registers fan cooling devices.

patternProperties:
  "^current-[A-Za-z0-9]{4}$":
    $ref: "#/$defs/sensor"
    unevaluatedProperties: false

  "^fan-[A-Za-z0-9]{4}$":
    $ref: "#/$defs/sensor"
    unevaluatedProperties: false

    properties:
      apple,fan-minimum:
        $ref: /schemas/types.yaml#/definitions/string
        pattern: "^[A-Za-z0-9]{4}$"
        description: SMC key containing the fan's minimum speed

      apple,fan-maximum:
        $ref: /schemas/types.yaml#/definitions/string
        pattern: "^[A-Za-z0-9]{4}$"
        description: SMC key containing the fan's maximum speed

      apple,fan-target:
        $ref: /schemas/types.yaml#/definitions/string
        pattern: "^[A-Za-z0-9]{4}$"
        description: Writeable endpoint for setting desired fan speed

      apple,fan-mode:
        $ref: /schemas/types.yaml#/definitions/string
        pattern: "^[A-Za-z0-9]{4}$"
        description: Writeable key to enable/disable manual fan control

      apple,fan-manual-control:
        type: boolean
        description:
          The SMC firmware of this machine accepts a manual speed for this
          fan from the host and returns it to firmware control when asked,
          so the fan's target speed can be set from the OS. Requires
          apple,fan-target and apple,fan-mode. Without it the fan is only
          monitored, and driven by the thermal framework where the SMC
          node is a cooling device.

  "^power-[A-Za-z0-9]{4}$":
    $ref: "#/$defs/sensor"
    unevaluatedProperties: false

  "^temperature-[A-Za-z0-9]{4}$":
    $ref: "#/$defs/sensor"
    unevaluatedProperties: false

  "^voltage-[A-Za-z0-9]{4}$":
    $ref: "#/$defs/sensor"
    unevaluatedProperties: false

allOf:
  - if:
      required:
        - apple,discover-temperatures
    then:
      patternProperties:
        "^temperature-": false

additionalProperties: false
```
