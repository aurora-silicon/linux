## Documentation/devicetree/bindings/input/apple,dockchannel-hid.yaml
```yaml
# SPDX-License-Identifier: (GPL-2.0-only OR BSD-2-Clause)
%YAML 1.2
---
$id: http://devicetree.org/schemas/input/apple,dockchannel-hid.yaml#
$schema: http://devicetree.org/meta-schemas/core.yaml#

title: Apple DockChannel HID transport

maintainers:
  - Ryan Murray <ryan@aurorasilicon.org>

description: |
  Apple laptops from the M2 generation on connect the built-in keyboard and
  trackpad to the MTP (multi-touch processor) coprocessor, which exposes them
  as HID devices over a DockChannel FIFO pair. The coprocessor announces its
  interfaces by name when it boots. Each interface that the operating system
  should use has a child node of the same name; announced interfaces without
  a node are ignored.

  The multi-touch interface may need firmware that the host sends after the
  coprocessor has booted, followed by a power cycle of the trackpad. Two
  power methods exist. With power method 1 the coprocessor sequences the
  trackpad itself and asks the host to pulse a reset line when it needs one.
  With power method 2 the host announces each power transition to the
  coprocessor, drives the reset line of the trackpad analog front end (AFE)
  itself and then confirms the transition.

properties:
  compatible:
    const: apple,dockchannel-hid

  reg:
    minItems: 4
    maxItems: 4
    description:
      Host and remote FIFO configuration and data windows, in the order
      given by reg-names.

  reg-names:
    oneOf:
      - items:
          - const: config
          - const: data
          - const: rmt-config
          - const: rmt-data
      - items:
          - const: rmt-config
          - const: rmt-data
          - const: config
          - const: data

  interrupts:
    items:
      - description: Transmit FIFO threshold
      - description: Receive FIFO threshold

  interrupt-names:
    items:
      - const: tx
      - const: rx

  iommus:
    maxItems: 1

  apple,fifo-size:
    $ref: /schemas/types.yaml#/definitions/uint32
    minimum: 1
    description: Capacity in bytes of each DockChannel FIFO.

  apple,helper-cpu:
    $ref: /schemas/types.yaml#/definitions/phandle
    description:
      The RTKit helper node of the coprocessor at the remote end of the FIFO.

  apple,afe-reset-gpios:
    maxItems: 1
    description:
      Reset line of the trackpad analog front end, described with the level
      that asserts the reset as its active level. With power method 1 the
      coprocessor asks the host to pulse it. With power method 2 the host
      asserts it while the multi-touch interface is powered off and releases
      it when the interface is powered on.

  apple,stm-reset-gpios:
    maxItems: 1
    description:
      Reset line of the STM interface, pulsed on the coprocessor's request.

  apple,no-stm:
    type: boolean
    description:
      The coprocessor firmware has no STM interface. The STM normally reports
      the machine's USB vendor and product identifiers, keyboard type and
      serial number before the other interfaces are started; without it the
      HID devices are registered with the Apple vendor identifier and no
      product identifier.

  keyboard:
    type: object
    additionalProperties: false
    description: The built-in keyboard.

    properties:
      hid-country-code:
        $ref: /schemas/types.yaml#/definitions/uint32
        maximum: 255
        description:
          HID country code of the keyboard, which the coprocessor does not
          report. The bootloader fills it in from the machine's own device
          tree.

      apple,keyboard-layout-id:
        $ref: /schemas/types.yaml#/definitions/uint32
        description:
          Apple's keyboard layout identifier, exposed to user space through
          the HID device's apple_layout_id attribute.

  multi-touch:
    type: object
    additionalProperties: false
    description: The built-in trackpad.

    properties:
      compatible:
        const: apple,j700-multitouch
        description:
          The trackpad sends the report layout of the J700 (MacBook Neo), a
          32-byte header followed by the contacts and an 8-byte trailer,
          instead of the 38-byte header layout of the earlier laptops.

      firmware-name:
        maxItems: 1
        description:
          Name of the trackpad firmware that the host sends to the
          coprocessor when the interface is first opened.

      apple,power-method:
        $ref: /schemas/types.yaml#/definitions/uint32
        enum: [1, 2]
        default: 1
        description:
          The power sequencing protocol of the coprocessor firmware, as
          described above. Power method 2 requires apple,afe-reset-gpios.

  stm:
    type: object
    additionalProperties: false
    description:
      The system management interface, which reports the machine
      identifiers.

  actuator:
    type: object
    additionalProperties: false
    description: The trackpad haptic actuator.

  tp_accel:
    type: object
    additionalProperties: false
    description: The trackpad accelerometer.

required:
  - compatible
  - reg
  - reg-names
  - interrupts
  - interrupt-names
  - iommus
  - apple,fifo-size
  - apple,helper-cpu

additionalProperties: false

examples:
  - |
    #include <dt-bindings/gpio/gpio.h>
    #include <dt-bindings/interrupt-controller/irq.h>

    // MacBook Air (M2, 2022)
    input@8000 {
        compatible = "apple,dockchannel-hid";
        reg = <0x8000 0x4000>,
              <0xc000 0x4000>,
              <0x0000 0x4000>,
              <0x4000 0x4000>;
        reg-names = "config", "data", "rmt-config", "rmt-data";
        iommus = <&mtp_dart 1>;
        interrupts = <2 IRQ_TYPE_LEVEL_HIGH>,
                     <3 IRQ_TYPE_LEVEL_HIGH>;
        interrupt-names = "tx", "rx";
        apple,fifo-size = <0x800>;
        apple,helper-cpu = <&mtp>;
        apple,afe-reset-gpios = <&smc_gpio 8 GPIO_ACTIVE_LOW>;
        apple,stm-reset-gpios = <&smc_gpio 24 GPIO_ACTIVE_LOW>;

        multi-touch {
            firmware-name = "apple/tpmtfw-j413.bin";
        };

        keyboard {
            hid-country-code = <0>;
            apple,keyboard-layout-id = <0>;
        };

        stm {
        };

        actuator {
        };

        tp_accel {
        };
    };
  - |
    #include <dt-bindings/gpio/gpio.h>
    #include <dt-bindings/interrupt-controller/irq.h>

    // MacBook Neo (J700)
    input@8000 {
        compatible = "apple,dockchannel-hid";
        reg = <0x8000 0x4000>,
              <0xc000 0x4000>,
              <0x0000 0x4000>,
              <0x4000 0x4000>;
        reg-names = "config", "data", "rmt-config", "rmt-data";
        iommus = <&mtp_dart 0>;
        interrupts = <2 IRQ_TYPE_LEVEL_HIGH>,
                     <3 IRQ_TYPE_LEVEL_HIGH>;
        interrupt-names = "tx", "rx";
        apple,fifo-size = <0x800>;
        apple,helper-cpu = <&mtp>;
        apple,no-stm;
        /* SMC pcIO output 19; level 1 asserts the reset */
        apple,afe-reset-gpios = <&smc_gpio 19 GPIO_ACTIVE_HIGH>;

        multi-touch {
            compatible = "apple,j700-multitouch";
            firmware-name = "apple/tpmtfw-j700.bin";
            apple,power-method = <2>;
        };

        keyboard {
            hid-country-code = <0>;
            apple,keyboard-layout-id = <0>;
        };
    };
```

## Documentation/devicetree/bindings/input/apple,mesa-fingerprint.yaml
```yaml
# SPDX-License-Identifier: (GPL-2.0-only OR BSD-2-Clause)
%YAML 1.2
---
$id: http://devicetree.org/schemas/input/apple,mesa-fingerprint.yaml#
$schema: http://devicetree.org/meta-schemas/core.yaml#

title: Apple Mesa fingerprint sensor

maintainers:
  - Chromatischer <dominik@hildania.de>

description: |
  Fingerprint sensor on an SPI bus of an Apple SoC, normally owned by the
  Secure Enclave Processor.  The chip-select setup and hold delays have to be
  produced by the controller, so the device must use the native chip select of
  its parent controller and not a GPIO one.

  The SPI mode is not given a default here because the boards that carry this
  sensor have not been observed to agree on one, so each board description has
  to state the mode it needs.

allOf:
  - $ref: /schemas/spi/spi-peripheral-props.yaml#

properties:
  compatible:
    const: apple,mesa-fingerprint

  reg:
    maxItems: 1

  interrupts:
    maxItems: 1
    description: Data-ready line from the sensor.

  enable-gpios:
    maxItems: 1
    description: Power line to the sensor, asserted to power it up.

  apple,smc:
    $ref: /schemas/types.yaml#/definitions/phandle
    description:
      The System Management Controller that switches the rails named by
      apple,smc-power-key and apple,smc-power-rails.

  apple,smc-power-key:
    $ref: /schemas/types.yaml#/definitions/string
    description:
      Four-character SMC key used by boards with SMC-switched sensor rails.
      The rail operation is an eight-byte little-endian pair of an on/off
      value and a rail selector word.

  apple,smc-power-rails:
    $ref: /schemas/types.yaml#/definitions/uint32-array
    minItems: 1
    maxItems: 4
    description: Rail selector words, in power-on order.

  firmware-name:
    maxItems: 1
    description:
      Calibration blob for this sensor.  It is per-device factory data written
      at manufacture, so it is neither redistributable nor derivable from the
      compatible; the board description has to name it.

  spi-cpha: true

  spi-cpol: true

required:
  - compatible
  - reg
  - firmware-name

oneOf:
  - required:
      - enable-gpios
  - required:
      - apple,smc
      - apple,smc-power-key
      - apple,smc-power-rails

unevaluatedProperties: false

examples:
  - |
    #include <dt-bindings/gpio/gpio.h>

    spi {
        #address-cells = <1>;
        #size-cells = <0>;

        fingerprint@0 {
            compatible = "apple,mesa-fingerprint";
            reg = <0>;
            spi-max-frequency = <8000000>;
            spi-cpha;
            spi-cs-setup-delay-ns = <20>;
            spi-cs-hold-delay-ns = <20>;
            enable-gpios = <&pinctrl_ap 108 GPIO_ACTIVE_HIGH>;
            firmware-name = "apple/mesacal-j313.bin";
        };
    };

  - |
    #include <dt-bindings/interrupt-controller/irq.h>

    spi {
        #address-cells = <1>;
        #size-cells = <0>;

        fingerprint@0 {
            compatible = "apple,mesa-fingerprint";
            reg = <0>;
            spi-max-frequency = <8000000>;
            spi-cpol;
            spi-cs-setup-delay-ns = <20>;
            spi-cs-hold-delay-ns = <20>;
            interrupt-parent = <&pinctrl_ap>;
            interrupts = <135 IRQ_TYPE_EDGE_RISING>;
            apple,smc = <&smc>;
            apple,smc-power-key = "pcLD";
            apple,smc-power-rails = <0x01010000 0x01020000>;
            firmware-name = "apple/mesacal-j700.bin";
        };
    };
```

## Documentation/devicetree/bindings/interrupt-controller/apple,m3-aon-ptd.yaml
```yaml
# SPDX-License-Identifier: (GPL-2.0-only OR BSD-2-Clause)
%YAML 1.2
---
$id: http://devicetree.org/schemas/interrupt-controller/apple,m3-aon-ptd.yaml#
$schema: http://devicetree.org/meta-schemas/core.yaml#

title: Apple M3 family always-on interrupt distributor

maintainers:
  - Ryan Murray <81541646+RyanTheTide@users.noreply.github.com>

description: |
  Hardware resources of the M3 family always-on interrupt distributor.
  The interface is described for discovery and must remain disabled until
  its ownership, initialization and shutdown are supported. Register windows
  are listed in hardware resource order; firmware configuration and tuning
  data are supplied by the boot firmware rather than this binding.

select:
  properties:
    compatible:
      contains:
        enum:
          - apple,t6031-aon-ptd
  required:
    - compatible

properties:
  compatible:
    items:
      - enum:
          - apple,t6031-aon-ptd
      - const: apple,aon-ptd

  reg:
    minItems: 4
    maxItems: 4

  interrupts:
    minItems: 32
    maxItems: 32

  '#address-cells':
    const: 0
  '#interrupt-cells':
    const: 1
  interrupt-controller: true

required:
  - compatible
  - reg
  - interrupts
  - interrupt-controller
  - '#interrupt-cells'
  - '#address-cells'

additionalProperties: false
```

## Documentation/devicetree/bindings/interrupt-controller/apple,pcie-msi.yaml
```yaml
# SPDX-License-Identifier: (GPL-2.0-only OR BSD-2-Clause)
%YAML 1.2
---
$id: http://devicetree.org/schemas/interrupt-controller/apple,pcie-msi.yaml#
$schema: http://devicetree.org/meta-schemas/core.yaml#

title: Apple PCIe port MSI controller

maintainers:
  - Thomas Glanzmann <thomas@glanzmann.de>

description: |
  The MSI map of one Apple PCIe root port, for a port that the bootloader
  trained and that Linux drives as a generic ECAM host. Endpoint MSI writes
  to the doorbell are routed by this map to a contiguous range of AIC
  interrupts.

allOf:
  - $ref: /schemas/interrupt-controller/msi-controller.yaml#

properties:
  compatible:
    const: apple,t8142-pcie-msi

  reg:
    maxItems: 1
    description: The port's MSI map registers.

  msi-controller: true

  msi-ranges:
    maxItems: 1

required:
  - compatible
  - reg
  - msi-controller
  - msi-ranges

unevaluatedProperties: false

examples:
  - |
    #include <dt-bindings/interrupt-controller/apple-aic.h>
    #include <dt-bindings/interrupt-controller/irq.h>

    soc {
        #address-cells = <2>;
        #size-cells = <2>;

        msi-controller@488028000 {
            compatible = "apple,t8142-pcie-msi";
            reg = <0x4 0x88028000 0x0 0x8000>;
            msi-controller;
            msi-ranges = <&aic AIC_IRQ 1741 IRQ_TYPE_EDGE_RISING 32>;
        };
    };
```

## Documentation/devicetree/bindings/interrupt-controller/apple,t6032-aon-ptd.yaml
```yaml
# SPDX-License-Identifier: (GPL-2.0-only OR BSD-2-Clause)
%YAML 1.2
---
$id: http://devicetree.org/schemas/interrupt-controller/apple,t6032-aon-ptd.yaml#
$schema: http://devicetree.org/meta-schemas/core.yaml#

title: Apple T6032 always-on interrupt distributor

maintainers:
  - Ryan Murray <81541646+RyanTheTide@users.noreply.github.com>

description: |
  Hardware resources of the T6032 always-on interrupt distributor. The package contains two
  peripheral dies. Register banks follow hardware resource order. The block
  remains disabled until its ownership and lifecycle are supported; firmware
  data and tuning are supplied separately by the boot firmware.

select:
  properties:
    compatible:
      contains:
        const: apple,t6032-aon-ptd
  required:
    - compatible

properties:
  compatible:
    items:
      - const: apple,t6032-aon-ptd
      - const: apple,aon-ptd

  reg:
    minItems: 4
    maxItems: 4

  interrupts:
    minItems: 32
    maxItems: 32

  interrupt-controller: true
  '#address-cells':
    const: 0
  '#interrupt-cells':
    const: 1

required:
  - compatible
  - reg
  - interrupts

additionalProperties: false
```

## Documentation/devicetree/bindings/iommu/apple,ane-dma.yaml
```yaml
# SPDX-License-Identifier: (GPL-2.0-only OR BSD-2-Clause)
%YAML 1.2
---
$id: http://devicetree.org/schemas/iommu/apple,ane-dma.yaml#
$schema: http://devicetree.org/meta-schemas/core.yaml#

title: Apple M1 Neural Engine auxiliary DMA aperture

maintainers:
  - Ryan Murray <81541646+RyanTheTide@users.noreply.github.com>

description: |
  An auxiliary address-translation aperture accompanies the three Neural
  Engine DART register banks. It is described separately because it is
  not an instance of the general-purpose DART programming model.
  Its interrupt is shared with the DART banks.

properties:
  compatible:
    items:
      - enum:
          - apple,t6000-ane-dma
      - const: apple,ane-dma

  reg:
    maxItems: 1

  interrupts:
    maxItems: 1

  power-domains:
    maxItems: 1

required:
  - compatible
  - reg
  - interrupts
  - power-domains

additionalProperties: false
```
