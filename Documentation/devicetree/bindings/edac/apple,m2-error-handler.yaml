## Documentation/devicetree/bindings/iommu/apple,ave-dma.yaml
```yaml
# SPDX-License-Identifier: (GPL-2.0-only OR BSD-2-Clause)
%YAML 1.2
---
$id: http://devicetree.org/schemas/iommu/apple,ave-dma.yaml#
$schema: http://devicetree.org/meta-schemas/core.yaml#

title: Apple video encoder auxiliary DMA apertures

maintainers:
  - Ryan Murray <81541646+RyanTheTide@users.noreply.github.com>

description: |
  Auxiliary translation and protection apertures accompany the video
  encoder DMA DARTs. They are described separately because they do not
  implement the programming model of the general-purpose DART driver.
  The interrupt is shared with the codec DART instances.

properties:
  compatible:
    oneOf:
      - items:
          - enum:
              - apple,t8103-ave-dma
          - const: apple,ave-dma
      - items:
          - const: apple,t6000-ave-dma
          - const: apple,ave-dma

  reg:
    minItems: 2
    maxItems: 2

  interrupts:
    maxItems: 1

  power-domains:
    maxItems: 1

required:
  - compatible
  - reg
  - interrupts
  - power-domains

additionalProperties: false
```

## Documentation/devicetree/bindings/iommu/apple,dapf.yaml
```yaml
# SPDX-License-Identifier: (GPL-2.0-only OR BSD-2-Clause)
%YAML 1.2
---
$id: http://devicetree.org/schemas/iommu/apple,dapf.yaml#
$schema: http://devicetree.org/meta-schemas/core.yaml#

title: Apple DMA address protection filter

maintainers:
  - Ryan Murray <81541646+RyanTheTide@users.noreply.github.com>

description: |
  Hardware resources of the Apple Silicon DMA address protection filter.
  The interface is described for discovery and must remain disabled until
  its ownership, initialization and shutdown are supported. Register windows
  are listed in hardware resource order; firmware configuration and tuning
  data are supplied by the boot firmware rather than this binding.

select:
  properties:
    compatible:
      contains:
        enum:
          - apple,t6030-dapf
          - apple,t6031-dapf
          - apple,t6032-dapf
          - apple,t8122-dapf
          - apple,t8132-dapf
  required:
    - compatible

properties:
  compatible:
    items:
      - enum:
          - apple,t8122-dapf
          - apple,t6030-dapf
          - apple,t6031-dapf
          - apple,t6032-dapf
          - apple,t8132-dapf
      - const: apple,dapf

  reg:
    maxItems: 1

required:
  - compatible
  - reg

additionalProperties: false
```

## Documentation/devicetree/bindings/iommu/apple,dart-apif.yaml
```yaml
# SPDX-License-Identifier: GPL-2.0-only
%YAML 1.2
---
$id: http://devicetree.org/schemas/iommu/apple,dart-apif.yaml#
$schema: http://devicetree.org/meta-schemas/core.yaml#

title: Apple DART mediated through Aura APIF

maintainers:
  - Dj <43033058+DjDeveloperr@users.noreply.github.com>

description: |
  A DART instance accessed through native SPTM calls rather than guest MMIO.
  Linux owns stream grouping, table setup, mapping rollback and DMA apertures.
  Firmware-owned streams are adopted without replacing their roots or replaying
  retained mappings. Unit identifiers are firmware metadata, not chip IDs.

properties:
  compatible:
    const: apple,dart-apif
  '#iommu-cells':
    const: 1
    description: Stream identifier.
  aurora,apif:
    $ref: /schemas/types.yaml#/definitions/phandle
    description: APIF version-2 transport provider.
  apple,apif-dart-id:
    $ref: /schemas/types.yaml#/definitions/uint32
    maximum: 255
    description: Native SPTM DART unit identifier.
  apple,apif-num-streams:
    $ref: /schemas/types.yaml#/definitions/uint32
    minimum: 1
    maximum: 256
    default: 256
    description: Number of streams supported by this unit.
  apple,apif-retained-sids:
    $ref: /schemas/types.yaml#/definitions/uint32-array
    minItems: 1
    maxItems: 256
    uniqueItems: true
    items:
      maximum: 255
    description: Firmware-owned stream IDs which Aura adopted at bootstrap.
  apple,apif-iova-force:
    $ref: /schemas/types.yaml#/definitions/uint64
    enum: [0, 1099511627776]
    description: |
      Optional native bit-40 force mask for a low-address device DMA view.
      Must not overlap apple,dma-range. Omit for a native DVA aperture.
  apple,apif-reserve-last-page:
    type: boolean
    description: Native aperture forbids allocating its final 16 KiB granule.
  apple,dma-range:
    $ref: /schemas/types.yaml#/definitions/uint64-array
    minItems: 2
    maxItems: 2
    description: |
      Device-visible DMA aperture base and size, aligned to 16 KiB and within
      42 bits. Defaults to the low 4 GiB. This is not a CPU mapping.

required:
  - compatible
  - '#iommu-cells'
  - aurora,apif
  - apple,apif-dart-id

additionalProperties: false

examples:
  - |
    iommu {
        compatible = "apple,dart-apif";
        #iommu-cells = <1>;
        aurora,apif = <&apif>;
        apple,apif-dart-id = <5>;
        apple,apif-num-streams = <16>;
    };
```

## Documentation/devicetree/bindings/iommu/apple,dart-smmu.yaml
```yaml
# SPDX-License-Identifier: (GPL-2.0-only OR BSD-2-Clause)
%YAML 1.2
---
$id: http://devicetree.org/schemas/iommu/apple,dart-smmu.yaml#
$schema: http://devicetree.org/meta-schemas/core.yaml#

title: Apple system MMU companion interface

maintainers:
  - Ryan Murray <81541646+RyanTheTide@users.noreply.github.com>

description: |
  Hardware resources of the Apple Silicon system MMU companion interface.
  The interface is described for discovery and must remain disabled until
  its ownership, initialization and shutdown are supported. Register windows
  are listed in hardware resource order; firmware configuration and tuning
  data are supplied by the boot firmware rather than this binding.

select:
  properties:
    compatible:
      contains:
        enum:
          - apple,t6030-dart-smmu
          - apple,t6031-dart-smmu
          - apple,t6032-dart-smmu
          - apple,t8122-dart-smmu
          - apple,t8132-dart-smmu
  required:
    - compatible

properties:
  compatible:
    items:
      - enum:
          - apple,t8122-dart-smmu
          - apple,t6030-dart-smmu
          - apple,t6031-dart-smmu
          - apple,t6032-dart-smmu
          - apple,t8132-dart-smmu
      - const: apple,dart-smmu

  reg:
    maxItems: 1

required:
  - compatible
  - reg

additionalProperties: false
```
