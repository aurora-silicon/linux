## Documentation/devicetree/bindings/hwmon/ti,tmp103.yaml
```yaml
# SPDX-License-Identifier: (GPL-2.0-only OR BSD-2-Clause)
%YAML 1.2
---
$id: http://devicetree.org/schemas/hwmon/ti,tmp103.yaml#
$schema: http://devicetree.org/meta-schemas/core.yaml#

title: TI TMP103 temperature sensor

maintainers:
  - Ryan Murray <81541646+RyanTheTide@users.noreply.github.com>

description: |
  Low power digital temperature sensor with a two-wire interface.

  Datasheet: https://www.ti.com/product/TMP103

properties:
  compatible:
    const: ti,tmp103

  reg:
    maxItems: 1

  "#thermal-sensor-cells":
    const: 0

  read-only:
    type: boolean
    description:
      The sensor is configured by another owner. The operating system only
      reads the temperature register and never writes the configuration or
      limit registers, including across system sleep.

required:
  - compatible
  - reg

additionalProperties: false

examples:
  - |
    i2c {
        #address-cells = <1>;
        #size-cells = <0>;

        temperature-sensor@70 {
            compatible = "ti,tmp103";
            reg = <0x70>;
            read-only;
        };
    };
```

## Documentation/devicetree/bindings/iio/imu/apple,aop-devmotion.yaml
```yaml
# SPDX-License-Identifier: (GPL-2.0-only OR BSD-2-Clause)
%YAML 1.2
---
$id: http://devicetree.org/schemas/iio/imu/apple,aop-devmotion.yaml#
$schema: http://devicetree.org/meta-schemas/core.yaml#

title: Apple AOP device-motion fusion service

maintainers:
  - Ryan Murray <ryan@aurorasilicon.org>

description:
  The Always-On Processor of Apple laptops fuses the machine's inertial
  sensors and reports an orientation quaternion through this service. The
  service has no application-processor MMIO or interrupt resource of its own.

properties:
  compatible:
    items:
      - const: apple,t6041-aop-devmotion6
      - const: apple,aop-devmotion6

required:
  - compatible

additionalProperties: false

examples:
  - |
    devmotion6 {
        compatible = "apple,t6041-aop-devmotion6", "apple,aop-devmotion6";
    };
```

## Documentation/devicetree/bindings/iio/imu/apple,aop-motion.yaml
```yaml
# SPDX-License-Identifier: (GPL-2.0-only OR BSD-2-Clause)
%YAML 1.2
---
$id: http://devicetree.org/schemas/iio/imu/apple,aop-motion.yaml#
$schema: http://devicetree.org/meta-schemas/core.yaml#

title: Apple AOP accelerometer and gyroscope

maintainers:
  - Ryan Murray <ryan@aurorasilicon.org>

description: |
  The Always-On Processor of Apple laptops reads the machine's inertial
  sensor and reports acceleration and angular rate as two of its services.
  Each node identifies one of those services. It has no application
  processor MMIO or interrupt resource of its own.

  A service starts reporting only once it has been sent the machine's three
  calibration packets. The bootloader copies them from the Apple device tree
  into the calibration properties below at every boot, so they are absent
  from the device tree sources. Without them the sensor stays off.

properties:
  compatible:
    oneOf:
      - items:
          - enum:
              - apple,t6041-aop-accel
              - apple,t8132-aop-accel
          - const: apple,aop-accel
      - items:
          - enum:
              - apple,t6041-aop-gyro
              - apple,t8132-aop-gyro
          - const: apple,aop-gyro

  label:
    description:
      Where the sensor sits, "accel-base" for an accelerometer in the base
      of a laptop.

  apple,range-intrinsic-cal:
    $ref: /schemas/types.yaml#/definitions/uint8-array
    description:
      The sensor's range calibration container, filled in by the bootloader.

  apple,nominal-extrinsic-cal:
    $ref: /schemas/types.yaml#/definitions/uint8-array
    description:
      The calibration container for the sensor's nominal mounting, filled in
      by the bootloader.

  apple,range-extrinsic-cal:
    $ref: /schemas/types.yaml#/definitions/uint8-array
    description:
      The sensor's range mounting calibration container, filled in by the
      bootloader.

required:
  - compatible

additionalProperties: false

examples:
  - |
    accel {
        compatible = "apple,t6041-aop-accel", "apple,aop-accel";
        label = "accel-base";
    };
```

## Documentation/devicetree/bindings/iio/light/apple,aop-als.yaml
```yaml
# SPDX-License-Identifier: (GPL-2.0-only OR BSD-2-Clause)
%YAML 1.2
---
$id: http://devicetree.org/schemas/iio/light/apple,aop-als.yaml#
$schema: http://devicetree.org/meta-schemas/core.yaml#

title: Apple AOP ambient light sensor service

maintainers:
  - Ryan Murray <81541646+RyanTheTide@users.noreply.github.com>

description: |
  The service is supplied by the parent Always-On Processor. Firmware and
  calibration handoff determine its availability. It has no independent
  application-processor register window or interrupt.

select:
  properties:
    compatible:
      contains:
        enum:
          - apple,t6020-aop-als
          - apple,t8112-aop-als
  required:
    - compatible

properties:
  compatible:
    items:
      - enum:
          - apple,t6020-aop-als
          - apple,t8112-aop-als
      - const: apple,aop-als

required:
  - compatible

additionalProperties: false
```

## Documentation/devicetree/bindings/iio/light/apple,t8140-aop-als.yaml
```yaml
# SPDX-License-Identifier: (GPL-2.0-only OR BSD-2-Clause)
%YAML 1.2
---
$id: http://devicetree.org/schemas/iio/light/apple,t8140-aop-als.yaml#
$schema: http://devicetree.org/meta-schemas/core.yaml#

title: Apple T8140 AOP ambient light sensor

maintainers:
  - Ryan Murray <ryan@aurorasilicon.org>

description:
  Ambient light measurements are reported by a service of the Always-On
  Processor. This child node identifies that service; it has no separate
  application-processor MMIO or interrupt resource. Machine calibration is
  supplied separately through the firmware loader, not inline in this node.

  The AOP firmware does not start the sensor until the application processor
  has handed it the sensor's calibration over the AOP's setup-port mailbox.
  The calibration is an 80-byte message that is specific to the machine and
  is not part of the operating system; the machine's own firmware sends the
  same message to the AOP.

select:
  properties:
    compatible:
      contains:
        const: apple,t8140-aop-als
  required:
    - compatible

properties:
  compatible:
    items:
      - const: apple,t8140-aop-als
      - const: apple,aop-als

  firmware-name:
    maxItems: 1
    description:
      Name of the file that holds the sensor's 80-byte setup-port calibration
      message, to be loaded through the firmware loader and passed to the AOP
      unchanged. Without it the sensor stays unstarted and reports nothing.

required:
  - compatible

additionalProperties: false
```

## Documentation/devicetree/bindings/iio/position/apple,aop-las.yaml
```yaml
# SPDX-License-Identifier: (GPL-2.0-only OR BSD-2-Clause)
%YAML 1.2
---
$id: http://devicetree.org/schemas/iio/position/apple,aop-las.yaml#
$schema: http://devicetree.org/meta-schemas/core.yaml#

title: Apple AOP lid angle sensor service

maintainers:
  - Ryan Murray <81541646+RyanTheTide@users.noreply.github.com>

description: |
  The service is supplied by the parent Always-On Processor. Firmware and
  calibration handoff determine its availability. It has no independent
  application-processor register window or interrupt.

select:
  properties:
    compatible:
      contains:
        enum:
          - apple,t6020-aop-las
          - apple,t6050-aop-las
          - apple,t8112-aop-las
          - apple,t8142-aop-las
  required:
    - compatible

properties:
  compatible:
    items:
      - enum:
          - apple,t6020-aop-las
          - apple,t6050-aop-las
          - apple,t8112-aop-las
          - apple,t8142-aop-las
      - const: apple,aop-las

required:
  - compatible

additionalProperties: false
```

## Documentation/devicetree/bindings/iio/temperature/apple,aop-temp.yaml
```yaml
# SPDX-License-Identifier: (GPL-2.0-only OR BSD-2-Clause)
%YAML 1.2
---
$id: http://devicetree.org/schemas/iio/temperature/apple,aop-temp.yaml#
$schema: http://devicetree.org/meta-schemas/core.yaml#

title: Apple AOP board temperature sensor service

maintainers:
  - Ryan Murray <ryan@aurorasilicon.org>

description: |
  The Always-On Processor of Apple laptops reads a board temperature sensor
  and reports it through this service. The bootloader may copy per-machine
  calibration containers into the optional properties below. Their payloads
  are opaque to the operating system and are sent unchanged to the firmware.

properties:
  compatible:
    items:
      - enum:
          - apple,t6041-aop-als-temp
          - apple,t8132-aop-als-temp
      - const: apple,aop-als-temp

  apple,temp-offset-calibration:
    $ref: /schemas/types.yaml#/definitions/uint8-array
    description: Sensor offset calibration container from the bootloader.

  apple,absolute-temp-offset-cal:
    $ref: /schemas/types.yaml#/definitions/uint8-array
    description: Absolute temperature offset container from the bootloader.

  apple,absolute-temp-offset-fcm-cal:
    $ref: /schemas/types.yaml#/definitions/uint8-array
    description: Front-compensation absolute offset container.

  apple,absolute-temp-offset-bcm-cal:
    $ref: /schemas/types.yaml#/definitions/uint8-array
    description: Back-compensation absolute offset container.

required:
  - compatible

additionalProperties: false

examples:
  - |
    als-temp {
        compatible = "apple,t6041-aop-als-temp", "apple,aop-als-temp";
    };
```
