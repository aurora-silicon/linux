## Documentation/devicetree/bindings/power/apple,pmc.yaml
```yaml
# SPDX-License-Identifier: (GPL-2.0-only OR BSD-2-Clause)
%YAML 1.2
---
$id: http://devicetree.org/schemas/power/apple,pmc.yaml#
$schema: http://devicetree.org/meta-schemas/core.yaml#

title: Apple SoC PMC voter interface

maintainers:
  - Diljit Singh <hey@djdev.me>

description: |
  The PMC arbitrates the performance states of shared rails, such as the
  DRAM controller and the SoC fabric, between voter agents. Each agent has a
  perf-state floor word with one 4-bit state per rail, and each rail has an
  interface enable word with one bit per agent. The PMC only honours an
  agent's floor on rails where its interface is enabled.

  Static agents are enabled for as long as the PMC is bound. A dynamic
  agent is a power domain: it is enabled after its parent domain powers on
  and disabled before its parent domain powers off. The host performance
  controller's agent is described by a child node that raises its floor
  while the CPU clusters or the GPU are busy.

properties:
  compatible:
    enum:
      - apple,t6041-pmc
      - apple,t6050-pmc
      - apple,t8132-pmc
      - apple,t8140-pmc
      - apple,t8142-pmc
      - apple,t8152-pmc

  reg:
    minItems: 2
    maxItems: 3
    description: |
      The perf-state floor words of the voter agents ("voters"), and the
      per-agent words holding the floor the PMC honours for each agent with
      the per-rail interface enable words ("rails"); on T8132 the rails
      block also holds the bandwidth request and boost interface enable
      words. Optionally, the cluster enable control word followed by its
      status word ("clusters").

  reg-names:
    description: |
      The rails block may come first, so that the node's unit address does
      not collide with a node covering the voters block.
    oneOf:
      - minItems: 2
        items:
          - const: voters
          - const: rails
          - const: clusters
      - minItems: 2
        items:
          - const: rails
          - const: voters
          - const: clusters

  nonposted-mmio: true

  power-domains:
    maxItems: 1

  '#address-cells':
    const: 1

  '#size-cells':
    const: 0

  apple,pmp:
    $ref: /schemas/types.yaml#/definitions/phandle
    description: PMP firmware owner that initializes the voter interface.

  apple,static-voters:
    $ref: /schemas/types.yaml#/definitions/uint32-array
    description: Voter agents to enable on every rail.
    minItems: 1
    maxItems: 32
    items:
      maximum: 31

  '#cooling-cells':
    const: 2
    description: |
      The PMC can limit the DRAM controller (DCS) rail. Cooling state 0 leaves
      the rail to the agents' votes; each further state lowers the highest
      DCS state the PMC honours for them by one, down to the lowest state.

  apple,dcs-power-microwatt:
    description: |
      Power the system draws at each DCS performance state above what it
      draws at the lowest one, from the lowest state up, measured under a
      load whose speed follows the DCS state. With it, the DCS limit is a
      power actor that the power allocator thermal governor can drive.
    minItems: 2
    maxItems: 16

patternProperties:
  '^voter@[0-9a-f]+$':
    type: object
    description: A dynamic voter agent, provided as a power domain.
    additionalProperties: false

    properties:
      reg:
        maxItems: 1
        description: Voter agent index.

      label:
        description: Name of the power domain.

      '#power-domain-cells':
        const: 0

      power-domains:
        maxItems: 1
        description: Domain that must be powered while the agent is enabled.

    required:
      - reg
      - '#power-domain-cells'

  '^floor-[a-z0-9-]+$':
    type: object
    description: |
      A rail floor, provided as a power domain. While the domain is powered,
      the AP's voter agent holds the rail at least at the given performance
      state. Floors on the same rail combine to the highest powered one. The
      AP agent must be a static voter. A floor on the DCS rail shares the AP
      agent's DCS vote with the DCS limit, which caps it.
    additionalProperties: false

    properties:
      label:
        description: Name of the power domain.

      '#power-domain-cells':
        const: 0

      apple,rail:
        $ref: /schemas/types.yaml#/definitions/uint32
        description: Rail index.

      apple,level:
        $ref: /schemas/types.yaml#/definitions/uint32
        minimum: 1
        maximum: 15
        description: Performance state held while the domain is powered.

    required:
      - '#power-domain-cells'
      - apple,rail
      - apple,level

  '^cluster-[a-z0-9-]+$':
    type: object
    description: |
      A cluster enable bit in the "clusters" words, provided as a power
      domain. The bit is set, and its status awaited, while the domain is
      powered. The T8140 video encoder cluster must be enabled for the PMP to
      raise the encoder's performance state.
    additionalProperties: false

    properties:
      label:
        description: Name of the power domain.

      '#power-domain-cells':
        const: 0

      power-domains:
        maxItems: 1

      apple,cluster-bit:
        $ref: /schemas/types.yaml#/definitions/uint32
        maximum: 31
        description: Bit of the cluster in the control and status words.

    required:
      - '#power-domain-cells'
      - apple,cluster-bit

  '^interface-[a-z0-9-]+$':
    type: object
    description: |
      A display pipe's interface enables, provided as a power domain. The
      bandwidth request (BWR) and boost interfaces each have an enable word
      with one bit per agent, and the PMC ignores the pipe's bandwidth and
      boost votes while its bits are clear. Both bits are set after the
      parent domain powers on, and cleared before it powers off.
    additionalProperties: false

    properties:
      label:
        description: Name of the power domain.

      '#power-domain-cells':
        const: 0

      power-domains:
        maxItems: 1
        description: Domain that must be powered while the enables are set.

      apple,bwr-bit:
        $ref: /schemas/types.yaml#/definitions/uint32
        maximum: 31
        description: Bit of the pipe in the BWR interface enable word.

      apple,boost-bit:
        $ref: /schemas/types.yaml#/definitions/uint32
        maximum: 31
        description: Bit of the pipe in the boost interface enable word.

      apple,consumer-switched:
        type: boolean
        description: |
          Not a power domain. The pipe's power is firmware-owned, and the
          display coprocessor that refers to this node (apple,pmc-interface)
          clears the bits before it powers the pipe down and gives them back
          the values they had after it powers the pipe up again.

    required:
      - apple,bwr-bit
      - apple,boost-bit

    oneOf:
      - required:
          - '#power-domain-cells'
          - power-domains
      - required:
          - apple,consumer-switched
        properties:
          '#power-domain-cells': false
          power-domains: false

  '^performance-controller@[0-9a-f]+$':
    type: object
    description: The host performance controller's voter agent.
    additionalProperties: false

    properties:
      compatible:
        oneOf:
          - items:
              - const: apple,t6050-clpc
              - const: apple,t6041-clpc
          - enum:
              - apple,t6041-clpc
              - apple,t8132-clpc
              - apple,t8140-clpc
              - apple,t8142-clpc
              - apple,t8152-clpc

      reg:
        maxItems: 1
        description: Voter agent index.

      apple,gpu-power-state:
        $ref: /schemas/types.yaml#/definitions/phandle
        description: PMGR power state of the GPU, used as a demand input.

    required:
      - compatible
      - reg

required:
  - compatible
  - reg
  - reg-names

allOf:
  - if:
      properties:
        compatible:
          not:
            contains:
              const: apple,t8132-pmc
    then:
      patternProperties:
        '^interface-[a-z0-9-]+$': false

additionalProperties: false

examples:
  - |
    soc {
        #address-cells = <2>;
        #size-cells = <2>;

        power-management@302800000 {
            compatible = "apple,t8140-pmc";
            reg = <0x3 0x02800000 0x0 0x10000>,
                  <0x3 0x028aa000 0x0 0x3000>;
            reg-names = "voters", "rails";
            #address-cells = <1>;
            #size-cells = <0>;
            #cooling-cells = <2>;
            apple,static-voters = <0 1 3>;
            apple,dcs-power-microwatt = <0 919000 1453000 2058000 2407000>;

            performance-controller@1 {
                compatible = "apple,t8140-clpc";
                reg = <1>;
            };

            voter@2 {
                reg = <2>;
                label = "gfx";
                #power-domain-cells = <0>;
            };

            floor-soc-max {
                label = "soc-max";
                #power-domain-cells = <0>;
                apple,rail = <1>;
                apple,level = <2>;
            };
        };
    };

  - |
    soc {
        #address-cells = <2>;
        #size-cells = <2>;

        power-management@382800000 {
            compatible = "apple,t8132-pmc";
            reg = <0x3 0x82800000 0x0 0x10000>,
                  <0x3 0x828aa000 0x0 0x3000>;
            reg-names = "voters", "rails";
            #address-cells = <1>;
            #size-cells = <0>;
            apple,static-voters = <3>;

            interface-dispext0 {
                label = "dispext0-interface";
                #power-domain-cells = <0>;
                power-domains = <&ps_dispext0_sys>;
                apple,bwr-bit = <3>;
                apple,boost-bit = <1>;
            };
        };
    };
```
