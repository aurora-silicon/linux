## Documentation/devicetree/bindings/power/apple,pmgr-pwrstate.yaml
```yaml
# SPDX-License-Identifier: (GPL-2.0-only OR BSD-2-Clause)
%YAML 1.2
---
$id: http://devicetree.org/schemas/power/apple,pmgr-pwrstate.yaml#
$schema: http://devicetree.org/meta-schemas/core.yaml#

title: Apple SoC PMGR Power States

maintainers:
  - Hector Martin <marcan@marcan.st>

allOf:
  - $ref: power-domain.yaml#
  - if:
      properties:
        compatible:
          contains:
            const: apple,t8132-pmgr-pwrstate
      required:
        - compatible
        - apple,inherited-on
    then:
      properties:
        apple,firmware-owned: false
        apple,sleep-retained: false
        apple,sleep-driver-owned: false
        apple,always-on: false
        apple,min-state: false
        apple,force-disable: false
        apple,force-reset: false
        apple,externally-clocked: false
        apple,consumer-switched: false
  - if:
      required:
        - apple,consumer-switched
    then:
      required:
        - apple,firmware-owned
  - if:
      required:
        - apple,retention-workaround
    then:
      required:
        - apple,consumer-switched

description: |
  Apple SoCs include PMGR blocks responsible for power management,
  which can control various clocks, resets, power states, and
  performance features. This binding describes the device power
  state registers, which control power states and resets.

  Each instance of a power controller within the PMGR syscon node
  represents a generic power domain provider, as documented in
  Documentation/devicetree/bindings/power/power-domain.yaml.
  The provider controls a single SoC block. The power hierarchy is
  represented via power-domains relationships between these nodes.

  See Documentation/devicetree/bindings/arm/apple/apple,pmgr.yaml
  for the top-level PMGR node documentation.

properties:
  compatible:
    oneOf:
      - items:
          - enum:
              # Do not add additional SoC to this list.
              - apple,s5l8960x-pmgr-pwrstate
              - apple,t7000-pmgr-pwrstate
              - apple,s8000-pmgr-pwrstate
              - apple,t8010-pmgr-pwrstate
              - apple,t8015-pmgr-pwrstate
              - apple,t8103-pmgr-pwrstate
              - apple,t8112-pmgr-pwrstate
              - apple,t6000-pmgr-pwrstate
          - const: apple,pmgr-pwrstate
      - items:
          - enum:
              - apple,t6020-pmgr-pwrstate
              - apple,t6030-pmgr-pwrstate
              - apple,t6031-pmgr-pwrstate
              - apple,t6041-pmgr-pwrstate
              - apple,t6050-pmgr-pwrstate
              - apple,t8122-pmgr-pwrstate
              - apple,t8132-pmgr-pwrstate
              - apple,t8140-pmgr-pwrstate
              - apple,t8142-pmgr-pwrstate
          - const: apple,t8103-pmgr-pwrstate

  reg:
    maxItems: 1

  "#power-domain-cells":
    const: 0

  "#reset-cells":
    const: 0

  power-domains:
    description:
      Reference to parent power domains. A domain may have multiple parents,
      and all will be powered up when it is powered.
    minItems: 1
    maxItems: 8 # Arbitrary, should be enough

  label:
    description:
      Specifies the name of the SoC domain being controlled. This is used to
      name the power/reset domains.

  apple,always-on:
    description:
      Forces this power domain to always be powered up.
    type: boolean

  apple,externally-clocked:
    description:
      The domain's clock comes from outside the PMGR, such as an MCA
      cluster clocked by its NCO. Until that clock runs the domain only
      reaches the clock-gated state, which then counts as powered up.
    type: boolean

  apple,no-auto-pm:
    description: |
      Never enables automatic power management (auto-enable) for this
      domain: once powered up it stays at its requested state until
      Linux changes it. Required for a coprocessor CPU domain whose
      firmware is started cold by Linux and must not be clock or power
      gated behind its back, such as the T6030 external display
      coprocessors' CPU domains.
    type: boolean

  apple,sleep-retained:
    description:
      A coprocessor keeps running in this domain across system sleep with no
      system-sleep callbacks of its own. The OS keeps the domain on during
      system sleep. Runtime power management is unaffected.
    type: boolean

  apple,sleep-driver-owned:
    description:
      The driver behind this domain lowers it before a system sleep and brings
      it back afterwards, in an order its hardware needs. The power controller
      leaves it alone after a wake.
    type: boolean

  apple,firmware-owned:
    description:
      The boot loader hands over active hardware whose power domain remains
      under firmware control. Its state register may not be CPU-accessible.
      The OS keeps the domain on and never accesses its state register,
      including reads, power target, automatic gating and reset. Availability
      is supplied by the firmware handoff rather than determined by probing
      the power-state register.
    type: boolean

  apple,consumer-switched:
    description:
      With apple,firmware-owned, the consumer of this domain may power it
      off and on again around stopping its coprocessor, through the PMGR
      driver, which then writes the state register. The OS otherwise treats
      the domain as firmware-owned and always on. A chain of such domains
      (this one and its consumer-switched parents) is powered off child first
      and on parent first.
    type: boolean

  apple,retention-workaround:
    description:
      PMGR registers to set while this consumer-switched domain is off, and
      to restore afterwards, as triplets of the offset in the PMGR register
      block, a mask and the masked value while the domain is off. They are
      set after automatic power management of the domain is disabled and
      before it powers off, and restored after it powers on and before
      automatic power management is enabled again.
    $ref: /schemas/types.yaml#/definitions/uint32-matrix
    items:
      items:
        - description: register offset
        - description: mask
        - description: value while the domain is off
    maxItems: 4

  apple,inherited-on:
    description: |
      On T8132, the boot loader hands over an active domain whose state
      register can be read, but whose power and reset transitions have not
      been handed over. Both target and actual state must already be active,
      with reset, auto-enable, reset-state, busy and device-disable clear.
      The OS verifies that state, retains an always-on domain, and refuses
      power-off and reset without writing the register.

      On T6030, T6031 and T8122, this marks the internal display chain left
      running by the boot loader. The display handoff requires the marker
      before adding the PMP and setting apple,min-state on that chain.
      These older domains retain their normal PMGR transition ownership;
      unlike apple,firmware-owned, their registers remain writable.
    type: boolean

  apple,min-state:
    description:
      Specifies the minimum power state for auto-PM.
      0 = power gated, 4 = clock gated, 15 = on.
    $ref: /schemas/types.yaml#/definitions/uint32
    minimum: 0
    maximum: 15

  apple,force-disable:
    description:
      Forces this device to be disabled (bus access blocked) when the power
      domain is powered down.
    type: boolean

  apple,force-reset:
    description:
      Forces a reset/error recovery of the power control logic when the power
      domain is powered down.
    type: boolean

required:
  - compatible
  - reg
  - "#power-domain-cells"
  - "#reset-cells"
  - label

additionalProperties: false
```

## Documentation/devicetree/bindings/power/apple,pmp-dram.yaml
```yaml
# SPDX-License-Identifier: (GPL-2.0-only OR BSD-2-Clause)
%YAML 1.2
---
$id: http://devicetree.org/schemas/power/apple,pmp-dram.yaml#
$schema: http://devicetree.org/meta-schemas/core.yaml#

title: Apple PMP DRAM reporting properties

maintainers:
  - Ryan Murray <ryan@aurorasilicon.org>

description: |
  Static description of the firmware-managed DRAM interface. These properties
  reside on the existing PMP report provider, which is available independently
  of a Linux PMP firmware start. No extra MMIO resource or ownership change is
  implied. The bus width and maximum data rate are inferred physical classes.

  The observed LPDDR5 family string does not distinguish LPDDR5X. Do not
  report an inferred X suffix as an observed memory type. Bandwidth is in
  decimal bytes per second; usable data width excludes ECC/check bits.

  The OPP table must contain exactly apple,dcs-state-count available entries,
  with unique opp-level values covering zero through count minus one. Only
  the highest state must have a rate. Peak bandwidth must equal that state's
  apple,data-rate multiplied by apple,data-bus-width divided by eight.
  The published bandwidth class may be rounded (for example 200 GB/s for
  an inferred physical peak of 204.8 GB/s).

  This description does not identify an achieved-state register. PMGR desired
  states and PMC floor/ceiling votes are not achieved memory states. The
  T6000/T8112 PMP DRAM State/FxS reporter has bucket 3*S+M, where S is DCS
  state and M is self-refresh (0), power-down (1), or active (2). That encoding
  alone does not specify a transport or a readable register resource. No
  current clock may be claimed from a low-power bucket or unknown state.

select: false

properties:
  operating-points-v2:
    description: Reference to an operating-points-v2-apple-dram table.
    maxItems: 1

  apple,dram-type:
    $ref: /schemas/types.yaml#/definitions/string
    const: lpddr5
    description: Observed DRAM family, without an inferred LPDDR5X suffix.

  apple,data-bus-width:
    $ref: /schemas/types.yaml#/definitions/uint32
    minimum: 8
    multipleOf: 8
    description: Usable data bits, excluding ECC/check bits.

  apple,dcs-state-count:
    $ref: /schemas/types.yaml#/definitions/uint32
    minimum: 1
    maximum: 32
    description: Number of firmware DCS states.

  apple,peak-bandwidth-bytes-per-second:
    $ref: /schemas/types.yaml#/definitions/uint64
    minimum: 1
    description: Physical maximum bandwidth calculated from the highest OPP and data width.

  apple,bandwidth-class-bytes-per-second:
    $ref: /schemas/types.yaml#/definitions/uint64
    minimum: 1
    description: Published, potentially rounded, maximum bandwidth class.

dependencies:
  operating-points-v2:
    - apple,dram-type
  apple,data-bus-width:
    - apple,dram-type
  apple,dcs-state-count:
    - apple,dram-type
  apple,peak-bandwidth-bytes-per-second:
    - apple,dram-type
  apple,bandwidth-class-bytes-per-second:
    - apple,dram-type

allOf:
  - if:
      required:
        - apple,dram-type
    then:
      required:
        - operating-points-v2
        - apple,data-bus-width
        - apple,dcs-state-count
        - apple,peak-bandwidth-bytes-per-second
        - apple,bandwidth-class-bytes-per-second

additionalProperties: true
```

## Documentation/devicetree/bindings/power/apple,t6040-sleep.yaml
```yaml
# SPDX-License-Identifier: (GPL-2.0-only OR BSD-2-Clause)
%YAML 1.2
---
$id: http://devicetree.org/schemas/power/apple,t6040-sleep.yaml#
$schema: http://devicetree.org/meta-schemas/core.yaml#

title: Apple T6040 system sleep controller

maintainers:
  - František Balázsy <frantisekbalazsy@gmail.com>

description:
  The power states macOS checks before it lets the T6040 sleep engine take
  the SoC down (the ADT's device-check-ps-b4-sleep table). Each entry names a
  PMGR register block, the offset of a display pipe's CPU power state and the
  offset of its last sub-block; the states in between are 8 bytes apart.

  The optional register blocks are the SoC words the entry and the wake write.
  All of them are shared with the drivers that own them, and are touched only
  once nothing blocks the sleep any more.

properties:
  compatible:
    const: apple,t6040-sleep

  reg:
    minItems: 2
    items:
      - description: CPU start/stop block (pmgr + 0x88000)
      - description: AON watchdog
      - description: control words of the three CPU complexes
      - description: SoC power gate, wake and retention voters
      - description: clock generator, the clock mux park words
      - description: SPMI controller of the PMU (boot stage, notify, hibernate)
      - description: second SPMI controller's notify word
      - description: MasterMini block with the S2R timer
      - description: SOC-East retention and power words
      - description: PMGR power words of the west axi2af bridges
      - description: AOP global block, S2R control and wake masks

  reg-names:
    minItems: 2
    items:
      - const: cpu-start
      - const: wdt
      - const: cluster-ctl
      - const: soc-pwrgate
      - const: clkgen
      - const: spmi0
      - const: spmi-a0
      - const: mastermini
      - const: soc-east
      - const: soc-ps
      - const: aop-global

  apple,check-ps-b4-sleep:
    $ref: /schemas/types.yaml#/definitions/phandle-array
    items:
      items:
        - description: PMGR syscon
        - description: offset of the pipe's CPU power state
        - description: offset of its last sub-block's power state

  apple,check-ps-b4-sleep-names:
    description: One name per apple,check-ps-b4-sleep entry.

required:
  - compatible
  - apple,check-ps-b4-sleep
  - apple,check-ps-b4-sleep-names

additionalProperties: false

examples:
  - |
    sleep-controller {
        compatible = "apple,t6040-sleep";
        apple,check-ps-b4-sleep = <&pmgr_disp 0x0 0x58>;
        apple,check-ps-b4-sleep-names = "disp";
    };
```

## Documentation/devicetree/bindings/power/apple,t8132-gfx-tvm.yaml
```yaml
# SPDX-License-Identifier: (GPL-2.0-only OR BSD-2-Clause)
%YAML 1.2
---
$id: http://devicetree.org/schemas/power/apple,t8132-gfx-tvm.yaml#
$schema: http://devicetree.org/meta-schemas/core.yaml#

title: Apple T8132 GFX TVM gate

maintainers:
  - Eryk Wieliczko <github@wieliczko.ninja>

description: |
  The T8132 GFX TVM enable bit must be set before powering the PMGR GFX
  domain. It is described as a parent domain so the generic power-domain
  framework orders power-on and power-off around PMGR and its consumers.
  The resource covers the GFX control word only; adjacent TVM registers
  and display power gates are not part of this device.

allOf:
  - $ref: power-domain.yaml#

properties:
  compatible:
    oneOf:
      - const: apple,t8132-gfx-tvm
      - items:
          - const: apple,t8122-gfx-tvm
          - const: apple,t8132-gfx-tvm

  reg:
    maxItems: 1

  '#power-domain-cells':
    const: 0

required:
  - compatible
  - reg
  - '#power-domain-cells'

additionalProperties: false
```
