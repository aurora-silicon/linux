## Documentation/devicetree/bindings/serial/apple,dockchannel-uart.yaml
```yaml
# SPDX-License-Identifier: (GPL-2.0-only OR BSD-2-Clause)
%YAML 1.2
---
$id: http://devicetree.org/schemas/serial/apple,dockchannel-uart.yaml#
$schema: http://devicetree.org/meta-schemas/core.yaml#

title: Apple DockChannel UART

maintainers:
  - Ryan Murray <ryan@aurorasilicon.org>

description: |
  Apple SoCs provide UART-compatible byte streams over DockChannel. Each
  channel uses separate data and FIFO-configuration windows and shares an
  interrupt-controller window with the other DockChannel functions.

allOf:
  - $ref: serial.yaml#

properties:
  compatible:
    oneOf:
      - const: apple,dockchannel-uart
      - items:
          - enum:
              - apple,t6000-dockchannel-uart
              - apple,t8112-dockchannel-uart
              - apple,t6020-dockchannel-uart
              - apple,t6021-dockchannel-uart
              - apple,t6022-dockchannel-uart
          - const: apple,dockchannel-uart

  reg:
    items:
      - description: Channel data registers
      - description: Channel FIFO configuration registers
      - description: DockChannel interrupt registers

  reg-names:
    items:
      - const: data
      - const: config
      - const: irq

  interrupts:
    maxItems: 1

  apple,channel:
    $ref: /schemas/types.yaml#/definitions/uint32
    minimum: 0
    maximum: 15
    default: 0
    description:
      Index of this channel within its DockChannel block. Channel n owns
      bits 2n (TX) and 2n + 1 (RX) of the shared interrupt mask and flag
      registers.

  apple,tx-never-wait:
    type: boolean
    description:
      Transmit completes without waiting for a reader to drain the channel,
      so a console with nobody attached does not stall.

  apple,sw-drain:
    type: boolean
    description:
      The channel does not raise an interrupt when data arrives, and its RX
      FIFO is drained in software instead. This mirrors the enable-sw-drain
      property of the channel's Apple device tree node. The interrupt, if
      described, is not used.

required:
  - compatible
  - reg
  - reg-names

if:
  not:
    required:
      - apple,sw-drain
then:
  required:
    - interrupts

unevaluatedProperties: false

examples:
  - |
    #include <dt-bindings/interrupt-controller/apple-aic.h>
    #include <dt-bindings/interrupt-controller/irq.h>

    soc {
        #address-cells = <2>;
        #size-cells = <2>;

        serial@30812c000 {
            compatible = "apple,dockchannel-uart";
            reg = <0x3 0x0812c000 0x0 0x4000>,
                  <0x3 0x08128000 0x0 0x4000>,
                  <0x3 0x0810c000 0x0 0x4000>;
            reg-names = "data", "config", "irq";
            interrupts = <AIC_IRQ 470 IRQ_TYPE_LEVEL_HIGH>;
        };
    };

...
```

## Documentation/devicetree/bindings/serial/apple,m2-dockchannel-debug.yaml
```yaml
# SPDX-License-Identifier: (GPL-2.0-only OR BSD-2-Clause)
%YAML 1.2
---
$id: http://devicetree.org/schemas/serial/apple,m2-dockchannel-debug.yaml#
$schema: http://devicetree.org/meta-schemas/core.yaml#

title: Apple M2 generation debug DockChannel

maintainers:
  - Ryan Murray <81541646+RyanTheTide@users.noreply.github.com>

description: |
  Debug DockChannel resources on M2 generation SoCs. The register apertures
  follow hardware resource order. Firmware configuration and tuning are
  supplied by the bootloader and are not part of this binding. Unqualified
  instances must remain disabled.

select:
  properties:
    compatible:
      contains:
        enum:
          - apple,t6020-dockchannel-debug
          - apple,t6021-dockchannel-debug
          - apple,t6022-dockchannel-debug
          - apple,t8112-dockchannel-debug
  required:
    - compatible

properties:
  compatible:
    items:
      - enum:
          - apple,t6020-dockchannel-debug
          - apple,t6021-dockchannel-debug
          - apple,t6022-dockchannel-debug
          - apple,t8112-dockchannel-debug
      - const: apple,dockchannel-debug

  reg:
    maxItems: 2

  interrupts:
    maxItems: 1

required:
  - compatible
  - reg

additionalProperties: false
```

## Documentation/devicetree/bindings/serial/apple,uart.yaml
```yaml
# SPDX-License-Identifier: (GPL-2.0-only OR BSD-2-Clause)
%YAML 1.2
---
$id: "http://devicetree.org/schemas/serial/apple,uart.yaml#"
$schema: "http://devicetree.org/meta-schemas/core.yaml#"
title: "Apple uart hardware resources"
maintainers:
  - "Ryan Murray <81541646+RyanTheTide@users.noreply.github.com>"
description: "T6050 native resource description. Firmware ownership, backend support and enables require separate qualification. This variant remains disabled and contains no programming sequences or firmware data."
properties:
  compatible:
    items:
      -
        const: "apple,t6050-uart"
      -
        const: "apple,uart"
  status:
    const: "disabled"
  reg:
    maxItems: 1
    description: "Native register apertures in hardware-interface order, including shared auxiliary views."
  interrupts:
    maxItems: 1
  power-domains:
    maxItems: 1
  clocks:
    maxItems: 2
required:
  - "compatible"
  - "reg"
  - "status"
  - "interrupts"
  - "power-domains"
  - "clocks"
additionalProperties: false
```

## Documentation/devicetree/bindings/soc/apple/apple,admac-control.yaml
```yaml
# SPDX-License-Identifier: (GPL-2.0-only OR BSD-2-Clause)
%YAML 1.2
---
$id: "http://devicetree.org/schemas/soc/apple/apple,admac-control.yaml#"
$schema: "http://devicetree.org/meta-schemas/core.yaml#"
title: "Apple audio dma clock and event distribution"
maintainers:
  - "Ryan Murray <81541646+RyanTheTide@users.noreply.github.com>"
select:
  properties:
    compatible:
      allOf:
        -
          contains:
            enum:
              - "apple,t8142-admac-control"
              - "apple,t8152-admac-control"
              - "apple,t6050-admac-control"
        -
          contains:
            const: "apple,admac-control"
  required:
    - "compatible"
description: "Apple audio dma clock and event distribution. Initial resource description for an unsupported firmware/backend layout. Register, IRQ and DMA topology can be recorded before a driver exists. This form must stay disabled; it does not substitute for the enabled driver contract or supply firmware, calibration, programming sequences or unresolved providers."
properties:
  compatible:
    items:
      -
        enum:
          - "apple,t8142-admac-control"
          - "apple,t8152-admac-control"
          - "apple,t6050-admac-control"
      -
        const: "apple,admac-control"
  status:
    const: "disabled"
  reg:
    description: "Register apertures of the complete hardware complex, in hardware interface order."
    minItems: 2
    maxItems: 2
  interrupts:
    description: "Interrupt lines wired to the system interrupt controller."
    maxItems: 1
required:
  - "compatible"
  - "reg"
  - "status"
additionalProperties: false
```

## Documentation/devicetree/bindings/soc/apple/apple,aft.yaml
```yaml
# SPDX-License-Identifier: (GPL-2.0-only OR BSD-2-Clause)
%YAML 1.2
---
$id: http://devicetree.org/schemas/soc/apple/apple,aft.yaml#
$schema: http://devicetree.org/meta-schemas/core.yaml#

title: Apple fabric trace controller

maintainers:
  - Ryan Murray <81541646+RyanTheTide@users.noreply.github.com>

description: |
  The fabric trace controller exposes a register aperture used by the
  processor debug infrastructure. Trace programs and debug sequences are
  firmware policy and are not part of this hardware description.

select:
  properties:
    compatible:
      contains:
        enum: ['apple,t8103-aft', 'apple,t8112-aft']
  required:
    - compatible

properties:
  compatible:
    items:
      - enum:
          - apple,t8103-aft
          - apple,t8112-aft
      - const: apple,aft

  reg:
    maxItems: 1

required:
  - compatible
  - reg

additionalProperties: false
```
