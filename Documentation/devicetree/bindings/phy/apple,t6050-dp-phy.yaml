## Documentation/devicetree/bindings/pwm/apple,s5l-fpwm.yaml
```yaml
# SPDX-License-Identifier: GPL-2.0-only OR BSD-2-Clause
%YAML 1.2
---
$id: http://devicetree.org/schemas/pwm/apple,s5l-fpwm.yaml#

$schema: http://devicetree.org/meta-schemas/core.yaml#

title: Apple FPWM controller

maintainers:
  - asahi@lists.linux.dev
  - Sasha Finkelstein <k@chaosmail.tech>

description: PWM controller used for keyboard backlight on ARM Macs

select:
  anyOf:
    -
      properties:
        compatible:
          contains:
            enum:
              - "apple,s5l-fpwm"
              - "apple,t6000-fpwm"
              - "apple,t6020-fpwm"
              - "apple,t6030-fpwm"
              - "apple,t6031-fpwm"
              - "apple,t6041-fpwm"
              - "apple,t8103-fpwm"
              - "apple,t8112-fpwm"
              - "apple,t8122-fpwm"
              - "apple,t8132-fpwm"
              - "apple,t8140-fpwm"
              - "apple,t8142-fpwm"
      required:
        - "compatible"
    -
      properties:
        compatible:
          items:
            -
              const: "apple,t6050-fpwm"
            -
              const: "apple,s5l-fpwm"
      required:
        - "compatible"

properties:
  compatible: true
  reg: true
  clocks: true
  power-domains: true
  "#pwm-cells": true
  interrupts: true
  iommus: true
  resets: true
  status: true

additionalProperties: true

allOf:
  - if:
      anyOf:
        -
          properties:
            compatible:
              items:
                -
                  const: "apple,t6050-fpwm"
                -
                  const: "apple,s5l-fpwm"
            status:
              const: "disabled"
          required:
            - "compatible"
            - "status"
    then:
      oneOf:
        -
          description: "T6050 native resource description. Firmware ownership, backend support and enables require separate qualification. This variant remains disabled and contains no programming sequences or firmware data."
          properties:
            compatible:
              items:
                -
                  const: "apple,t6050-fpwm"
                -
                  const: "apple,s5l-fpwm"
            status:
              const: "disabled"
            reg:
              maxItems: 1
              description: "Native register apertures in hardware-interface order, including shared auxiliary views."
            interrupts:
              maxItems: 1
            power-domains:
              maxItems: 1
            "#pwm-cells":
              const: 2
          required:
            - "compatible"
            - "reg"
            - "status"
            - "interrupts"
            - "power-domains"
            - "#pwm-cells"
          additionalProperties: false
    else:
      properties:
        compatible:
          items:
            - enum:
                - apple,t8103-fpwm
                - apple,t8112-fpwm
                - apple,t8122-fpwm
                - apple,t8142-fpwm
                - apple,t8132-fpwm
                - apple,t8140-fpwm
                - apple,t6000-fpwm
                - apple,t6020-fpwm
                - apple,t6030-fpwm
                - apple,t6031-fpwm
                - apple,t6041-fpwm
            - const: apple,s5l-fpwm

        reg:
          maxItems: 1

        clocks:
          maxItems: 1

        power-domains:
          maxItems: 1

        "#pwm-cells":
          const: 2
      required:
        - compatible
        - reg
        - clocks
      additionalProperties: false

examples:
  - |
    pwm@235044000 {
      compatible = "apple,t8103-fpwm", "apple,s5l-fpwm";
      reg = <0x35044000 0x4000>;
      power-domains = <&ps_fpwm1>;
      clocks = <&clkref>;
      #pwm-cells = <2>;
    };
```

## Documentation/devicetree/bindings/pwm/apple,t8132-pwm.yaml
```yaml
# SPDX-License-Identifier: (GPL-2.0-only OR BSD-2-Clause)
%YAML 1.2
---
$id: http://devicetree.org/schemas/pwm/apple,t8132-pwm.yaml#
$schema: http://devicetree.org/meta-schemas/core.yaml#

title: Apple M4 base SoC PWM controller

maintainers:
  - Ryan Murray <81541646+RyanTheTide@users.noreply.github.com>

description: |
  Hardware resources of the M4 base SoC PWM controller.
  The interface is described for discovery and must remain disabled until
  its ownership, initialization and shutdown are supported. Register windows
  are listed in hardware resource order; firmware configuration and tuning
  data are supplied by the boot firmware rather than this binding.

select:
  properties:
    compatible:
      contains:
        enum:
          - apple,t8132-pwm
  required:
    - compatible

properties:
  compatible:
    items:
      - enum:
          - apple,t8132-pwm
      - const: apple,pwm

  reg:
    minItems: 1
    maxItems: 1

  interrupts:
    minItems: 1
    maxItems: 1

  power-domains:
    minItems: 1
    maxItems: 1

required:
  - compatible
  - reg
  - interrupts
  - power-domains

additionalProperties: false
```

## Documentation/devicetree/bindings/reserved-memory/apple,asc-mem.yaml
```yaml
# SPDX-License-Identifier: (GPL-2.0-only OR BSD-2-Clause)
%YAML 1.2
---
$id: http://devicetree.org/schemas/reserved-memory/apple,asc-mem.yaml#
$schema: http://devicetree.org/meta-schemas/core.yaml#

title: Apple coprocessor reserved memory

maintainers:
  - Ryan Murray <ryan@aurorasilicon.org>

description:
  Memory retained for a bootloader-loaded Apple coprocessor, including the
  ISP firmware heap. The bootloader supplies the physical address and size
  from its firmware handoff and records any associated device IOVA mappings
  in iommu-addresses. Static board sources may carry an empty placeholder
  that is filled before entering the kernel. The region is not a generic
  allocatable DMA pool and this binding specifies no fixed address or size.

allOf:
  - $ref: reserved-memory.yaml#

properties:
  compatible:
    const: apple,asc-mem

  reg:
    maxItems: 1

  no-map: true

  iommu-addresses: true

  apple,firmware-read-only:
    type: boolean
    description: |
      Map this reserved firmware region read-only in each device IOMMU
      mapping described by iommu-addresses. Cache/coherency attributes
      are unchanged. This describes immutable firmware text; it does not
      restrict CPU access. If absent, existing read/write mappings remain
      the default. The bootloader derives this from the firmware segment
      permissions rather than a fixed physical address.

required:
  - compatible
  - reg

unevaluatedProperties: false
```

## Documentation/devicetree/bindings/reset/apple,t8103-cio-reset.yaml
```yaml
# SPDX-License-Identifier: (GPL-2.0-only OR BSD-2-Clause)
%YAML 1.2
---
$id: http://devicetree.org/schemas/reset/apple,t8103-cio-reset.yaml#
$schema: http://devicetree.org/meta-schemas/core.yaml#

title: Apple SoC CIO (USB4/Thunderbolt) block reset controller

maintainers:
  - Sven Peter <sven@kernel.org>

description: |
  The CIO (Converged I/O) blocks on Apple Silicon SoCs have a reset
  inside the power manager (PMGR) that has to be deasserted before
  their co-processor can be booted. On t8103 each port comes with a
  dedicated register page, represented as a standalone node. On t600x a
  single register shared by all ports of a die with one request bit per
  port is used instead. Since this register is located in the middle of
  the PMGR MMIO region it is represented as a sub-node of the PMGR
  syscon with reg used as an offset into it.

  On t8142, a standalone register page contains a shared request register
  with alternating request and busy bits for four ports.

  On t6050 the same request register sits at offset 0x60 of a page in the
  die's PMGR block.

  On t6041, a PMGR child register contains one request bit per CIO port and
  the corresponding busy bit at 16 plus the port index. The controller waits
  up to 192 ms for that busy bit to clear both before and after its
  read-modify-write request.

  In all cases the reset id is the CIO port index on the die.

properties:
  compatible:
    oneOf:
      - enum:
          - apple,t8103-cio-reset
          - apple,t8142-cio-reset
          - apple,t6050-cio-reset
          - apple,t6000-cio-reset
          - apple,t6041-cio-reset
      - items:
          - const: apple,t8112-cio-reset
          - const: apple,t8103-cio-reset
      - items:
          - enum:
              - apple,t6020-cio-reset
              - apple,t6030-cio-reset
              - apple,t6031-cio-reset
              - apple,t8122-cio-reset
              - apple,t8132-cio-reset
          - const: apple,t6000-cio-reset

  reg:
    maxItems: 1

  '#reset-cells':
    const: 1

required:
  - compatible
  - reg
  - '#reset-cells'

additionalProperties: false

examples:
  - |
    soc {
        #address-cells = <2>;
        #size-cells = <2>;

        reset-controller@23b784000 {
            compatible = "apple,t8103-cio-reset";
            reg = <0x2 0x3b784000 0x0 0x8000>;
            #reset-cells = <1>;
        };
    };
```

## Documentation/devicetree/bindings/rtc/apple,abbey-pmu-rtc.yaml
```yaml
# SPDX-License-Identifier: GPL-2.0-only
%YAML 1.2
---
$id: http://devicetree.org/schemas/rtc/apple,abbey-pmu-rtc.yaml#
$schema: http://devicetree.org/meta-schemas/core.yaml#

title: Apple Abbey SPMI PMU real-time clock

maintainers:
  - Dj <hey@djdev.me>

description: |
  The Abbey PMU exposes a 48-bit 65536 Hz counter and a signed 48-bit
  wall-clock offset in units of 1/32768 second. Its alarm comparator uses
  32-bit counter seconds. NVMEM cells use little-endian byte order.
  The one-byte alarm control has event bit 1, monitor bit 0 and enable
  bit 6. The one-byte interrupt mask has the alarm mask in bit 0.
  This layout is distinct from the Baku PMU RTC.

allOf:
  - $ref: rtc.yaml#

properties:
  compatible:
    const: apple,abbey-pmu-rtc

  interrupts:
    maxItems: 1
    description: Alarm event interrupt from the SPMI controller

  nvmem-cells:
    minItems: 5
    maxItems: 5
    description: Counter (6), offset (6), alarm (4), control (1), mask (1) bytes

  nvmem-cell-names:
    items:
      - const: counter
      - const: rtc_offset
      - const: alarm
      - const: alarm_ctrl
      - const: irq_mask

  wakeup-source: true

required:
  - compatible
  - nvmem-cells
  - nvmem-cell-names

unevaluatedProperties: false
```

## Documentation/devicetree/bindings/rtc/apple,j700-pmu-rtc.yaml
```yaml
# SPDX-License-Identifier: (GPL-2.0-only OR BSD-2-Clause)
%YAML 1.2
---
$id: http://devicetree.org/schemas/rtc/apple,j700-pmu-rtc.yaml#
$schema: http://devicetree.org/meta-schemas/core.yaml#

title: Apple Baku and Abbey PMU real-time clocks

maintainers:
  - Ryan Murray <ryan@aurorasilicon.org>

description: |
  The PMU exposes a 65536 Hz counter and an alarm comparator over SPMI.
  The clock's offset is shared with the SMC RTC through a little-endian
  NVMEM cell: eight bytes of whole seconds on Baku, or six bytes of signed
  33.15 fixed-point seconds on Abbey. This function is a child of the
  PMIC NVMEM provider and uses that provider's SPMI register map.

allOf:
  - $ref: rtc.yaml#

properties:
  compatible:
    enum:
      - apple,j700-pmu-rtc
      - apple,t6041-pmu-rtc

  interrupts:
    maxItems: 1

  nvmem-cells:
    maxItems: 1
    description: The shared RTC offset, in the format described above.

  nvmem-cell-names:
    items:
      - const: rtc_offset

  wakeup-source: true

required:
  - compatible
  - interrupts
  - nvmem-cells
  - nvmem-cell-names

unevaluatedProperties: false

examples:
  - |
    #include <dt-bindings/interrupt-controller/irq.h>
    #include <dt-bindings/spmi/spmi.h>

    pmic@e {
        compatible = "apple,baku-pmic", "apple,spmi-nvmem";
        reg = <0xe SPMI_USID>;

        rtc {
            compatible = "apple,j700-pmu-rtc";
            interrupt-parent = <&spmi>;
            interrupts = <2 IRQ_TYPE_EDGE_RISING>;
            nvmem-cells = <&rtc_offset>;
            nvmem-cell-names = "rtc_offset";
            wakeup-source;
        };
    };
```

## Documentation/devicetree/bindings/rtc/apple,smc-rtc.yaml
```yaml
# SPDX-License-Identifier: (GPL-2.0-only OR BSD-2-Clause)
%YAML 1.2
---
$id: http://devicetree.org/schemas/rtc/apple,smc-rtc.yaml#
$schema: http://devicetree.org/meta-schemas/core.yaml#

title: Apple SMC RTC

description:
  Apple Silicon Macs (M1, etc.) have an RTC that is part of the PMU IC,
  but most of the PMU functionality is abstracted out by the SMC.
  An additional RTC offset stored inside NVMEM is required to compute
  the current date/time.

maintainers:
  - Sven Peter <sven@kernel.org>

properties:
  compatible:
    const: apple,smc-rtc

  nvmem-cells:
    items:
      - description:
          RTC offset. By default a 48bit value, specified in 32768 (2^15) Hz
          clock ticks. With apple,rtc-offset-seconds, a 64bit little-endian
          count of whole seconds.

  nvmem-cell-names:
    items:
      - const: rtc_offset

  apple,rtc-offset-seconds:
    type: boolean
    description:
      The RTC offset cell holds whole seconds rather than 32768 Hz ticks. The
      current time is the SMC RTC counter's integer seconds plus the offset.
      Used where the system firmware keeps the offset in a PMU scratchpad
      register in this format, such as on the t8140 (A18 Pro).

required:
  - compatible
  - nvmem-cells
  - nvmem-cell-names

additionalProperties: false
```
