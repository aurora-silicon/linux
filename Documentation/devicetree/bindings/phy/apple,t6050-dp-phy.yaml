## Documentation/devicetree/bindings/power/apple,t8132-pmp-report.yaml
```yaml
# SPDX-License-Identifier: (GPL-2.0-only OR BSD-2-Clause)
%YAML 1.2
---
$id: http://devicetree.org/schemas/power/apple,t8132-pmp-report.yaml#
$schema: http://devicetree.org/meta-schemas/core.yaml#

title: Apple T8132 PMP telemetry SRAM

maintainers:
  - Eryk Wieliczko <eryk@wieliczko.ninja>

description:
  Read-only telemetry SRAM of the bootloader-started PMP on T8132. The PMP
  provider validates report geometry before exposing GPU thermal and power data.

properties:
  compatible:
    const: apple,t8132-pmp-v2-report
  reg:
    maxItems: 1
  power-domains:
    maxItems: 1
  '#address-cells':
    const: 1
  '#size-cells':
    const: 0

patternProperties:
  '^report@[0-9a-f]+$':
    type: object
    description:
      A device whose power state the host reports to the PMP, provided as a
      power domain.
    additionalProperties: false

    properties:
      compatible:
        const: apple,t6000-pmp-v2-report-entry
      reg:
        maxItems: 1
        description: PMP soc-device index of the device.
      label:
        description: Name of the power domain.
      '#power-domain-cells':
        const: 0
      power-domains:
        minItems: 1
        maxItems: 2
      apple,always-on:
        type: boolean
        description: Report the device as on from probe.
      apple,release-for-sleep:
        type: boolean
        description: Release the request while the system is suspended.
      apple,irq-safe:
        type: boolean
        description: The parent PMGR power state is switched with IRQs off.

    required:
      - compatible
      - reg
      - label
      - '#power-domain-cells'

required:
  - compatible
  - reg
  - power-domains
  - '#address-cells'
  - '#size-cells'

additionalProperties: false
```

## Documentation/devicetree/bindings/power/apple,t8140-pmp-report.yaml
```yaml
# SPDX-License-Identifier: (GPL-2.0-only OR BSD-2-Clause)
%YAML 1.2
---
$id: http://devicetree.org/schemas/power/apple,t8140-pmp-report.yaml#
$schema: http://devicetree.org/meta-schemas/core.yaml#

title: Apple PMP report aperture

maintainers:
  - Ryan Murray <ryan@aurorasilicon.org>

description: |
  The PMP report aperture contains a read window and an update window.
  The PMP running bit qualifies the per-cluster fast-die effort. Lane 1
  tracks P-cluster load in Linux measurements. Lane 0 is assigned to the
  E cluster from the Apple device tree order and has not been observed
  changing. The T6041 report has three lanes: E, P0 and P1. Only
  documented report entries may be read; the aperture is not a
  contiguous readable array of registers.

  T8140 also publishes a 32-bit lifetime-servo effort count at offset
  0xc000, followed by at most two 32-bit Q8.24 effort values. The entries
  are applied in order to one actuator, making the last present entry the
  effective GPU effort. T8112 uses the same layout.

allOf:
  - if:
      properties:
        compatible:
          const: apple,t6000-pmp-v2-report
    then:
      properties:
        reg:
          maxItems: 2
    else:
      properties:
        reg:
          maxItems: 1
        reg-names: false
  - if:
      properties:
        reg:
          minItems: 2
    then:
      required:
        - reg-names

  - $ref: apple,pmp-dram.yaml#

properties:
  compatible:
    oneOf:
      - enum:
          - apple,t6000-pmp-v2-report
          - apple,t6020-pmp-v2-report
          - apple,t6030-pmp-v2-report
          - apple,t6041-pmp-v2-report
          - apple,t6050-pmp-v2-report
          - apple,t8112-pmp-v2-report
          - apple,t8122-pmp-v2-report
          - apple,t8140-pmp-v2-report
      - items:
          - const: apple,t6031-pmp-v2-report
          - const: apple,t6020-pmp-v2-report

  reg:
    minItems: 1
    maxItems: 2

  reg-names:
    items:
      - const: report
      - const: ane-dvfs

  nonposted-mmio: true

  power-domains:
    maxItems: 1

  '#address-cells':
    const: 1

  '#size-cells':
    const: 0

  operating-points-v2: true
  apple,dram-type: true
  apple,data-bus-width: true
  apple,dcs-state-count: true
  apple,peak-bandwidth-bytes-per-second: true
  apple,bandwidth-class-bytes-per-second: true

  apple,pmp:
    $ref: /schemas/types.yaml#/definitions/phandle
    description:
      The PMP that publishes this report, on SoCs where the host starts the
      PMP after a display handoff.

patternProperties:
  '^report@[0-9a-f]+$':
    type: object
    description: |
      A device whose power state the host reports to the PMP, provided as a
      power domain. The host sets the device's request bit after its parent
      domain powers on and clears it before the parent powers off, and waits
      for the PMP to acknowledge while the PMP runs.
    additionalProperties: false

    properties:
      compatible:
        oneOf:
          - items:
              - const: apple,t6020-pmp-v2-report-entry
              - const: apple,t6000-pmp-v2-report-entry
          - const: apple,t6000-pmp-v2-report-entry
          - const: apple,t8140-pmp-v2-report-entry
          - items:
              - enum:
                  - apple,t6030-pmp-v2-report-entry
                  - apple,t6031-pmp-v2-report-entry
                  - apple,t6041-pmp-v2-report-entry
                  - apple,t6050-pmp-v2-report-entry
                  - apple,t8112-pmp-v2-report-entry
                  - apple,t8122-pmp-v2-report-entry
              - const: apple,t6000-pmp-v2-report-entry

      reg:
        maxItems: 1
        description: PMP soc-device index of the device.

      label:
        description: Name of the power domain.

      '#power-domain-cells':
        const: 0

      power-domains:
        minItems: 1
        maxItems: 2

      apple,dvfs:
        $ref: /schemas/types.yaml#/definitions/uint32-array
        items:
          - description: SOC-DEV-DVFS entry holding the device's request.
          - description:
              Main-field performance level requested while powered (0-31).
              Legacy trees with apple,dvfs-request-class instead use this as
              that single request class's level.
            maximum: 31
        description:
          The device also has a performance request. While the domain is
          powered, after the PMP acknowledges the device, the host writes the
          complete request word (with the valid bit) to the entry once; before
          clearing the device request it writes every level as 0.

      apple,dvfs-request-levels:
        $ref: /schemas/types.yaml#/definitions/uint32-array
        minItems: 2
        maxItems: 10
        description:
          Request-class and level pairs. Classes 0x21 through 0x25 occupy the
          four-bit fields at bits 35:32 through 51:48; levels are 0 through
          15. Each class may occur once. These fields are combined with the
          main level in apple,dvfs into one 64-bit request word.

      apple,adt-dvfs:
        type: boolean
        description:
          The bootloader fills apple,dvfs and apple,dvfs-request-levels from
          this machine's ADT (the soc-device's SOC-DEV-DVFS slot and its named
          PMGR performance sources). Without this property the bootloader
          leaves the entry as it is. If the bootloader does not fill it, the
          entry sends no performance request.

      apple,dvfs-request-class:
        $ref: /schemas/types.yaml#/definitions/uint32
        enum: [0x21, 0x22, 0x23, 0x24, 0x25]
        deprecated: true
        description:
          Legacy single request class holding apple,dvfs's second cell. New
          trees use apple,dvfs-request-levels so a main level and multiple
          class levels can be requested together.

      apple,always-on:
        type: boolean
        description: Report the device as on from probe.

      apple,no-ack:
        type: boolean
        description:
          The PMP does not acknowledge this entry's requests; the host sets
          and clears the request bit without waiting for an acknowledgement.

      apple,soc-device-record:
        type: boolean
        description:
          The request and acknowledge bits are indexed by the index of the
          PMP soc-device record (apple,tunable-soc-device on the PMP) that
          holds this entry's device ID, instead of by reg. Only valid on a
          report whose PMP the host starts.

      apple,irq-safe:
        type: boolean
        description:
          The entry is the parent of IRQ-safe PMGR power states and is
          switched with interrupts disabled. Setting the state takes a
          spinlock and polls the acknowledgment atomically.

    required:
      - compatible
      - reg
      - label
      - '#power-domain-cells'

    allOf:
      - not:
          required:
            - apple,dvfs-request-levels
            - apple,dvfs-request-class

    dependentRequired:
      apple,dvfs-request-levels:
        - apple,dvfs
      apple,dvfs-request-class:
        - apple,dvfs

required:
  - compatible
  - reg

additionalProperties: false

examples:
  - |
    soc {
        #address-cells = <2>;
        #size-cells = <2>;

        pmp-report@3003c0000 {
            compatible = "apple,t8140-pmp-v2-report";
            reg = <3 0x003c0000 0 0x14000>;
            #address-cells = <1>;
            #size-cells = <0>;

            report@9 {
                compatible = "apple,t8140-pmp-v2-report-entry";
                reg = <0x9>;
                label = "pmp-gfx";
                #power-domain-cells = <0>;
            };
        };
    };
```

## Documentation/devicetree/bindings/power/reset/apple,smc-reboot.yaml
```yaml
# SPDX-License-Identifier: (GPL-2.0-only OR BSD-2-Clause)
%YAML 1.2
---
$id: http://devicetree.org/schemas/power/reset/apple,smc-reboot.yaml#
$schema: http://devicetree.org/meta-schemas/core.yaml#

title: Apple SMC Reboot Controller

description:
  The Apple System Management Controller (SMC) provides reboot functionality
  on Apple Silicon SoCs. It uses NVMEM cells to store and track various
  system state information related to boot, shutdown, and panic events.

maintainers:
  - Sven Peter <sven@kernel.org>

properties:
  compatible:
    oneOf:
      - const: apple,smc-reboot
      - items:
          - const: apple,t8132-smc-reboot
          - const: apple,smc-reboot

  nvmem-cells:
    minItems: 4
    items:
      - description: Flag indicating shutdown (as opposed to reboot)
      - description: Stage at which the boot process stopped (0x30 for normal boot)
      - description: Counter for boot errors
      - description: Counter for system panics
      - description: The PMU's power-on policy (after a power loss, at power connect)

  nvmem-cell-names:
    minItems: 4
    items:
      - const: shutdown_flag
      - const: boot_stage
      - const: boot_error_count
      - const: panic_count
      - const: pm_setting

required:
  - compatible
  - nvmem-cells
  - nvmem-cell-names

additionalProperties: false
```

## Documentation/devicetree/bindings/power/supply/apple,battery-monitor.yaml
```yaml
# SPDX-License-Identifier: (GPL-2.0-only OR BSD-2-Clause)
%YAML 1.2
---
$id: http://devicetree.org/schemas/power/supply/apple,battery-monitor.yaml#
$schema: http://devicetree.org/meta-schemas/core.yaml#

title: Apple PMU battery monitor

maintainers:
  - Ryan Murray <81541646+RyanTheTide@users.noreply.github.com>

description: |
  Battery-monitor function. T6041 uses a separate SPMI follower and
  telemetry-router source identifiers; T8140 is a function of the primary
  PMIC and signals through the SPMI interrupt controller. The monitor does
  not transfer ownership of PMIC control or battery policy to the host.

properties:
  compatible:
    items:
      - enum:
          - apple,t8103-battery-monitor
          - apple,t6000-battery-monitor
          - apple,t6041-battery-monitor
          - apple,t8140-battery-monitor
      - const: apple,battery-monitor

  reg:
    maxItems: 1

  interrupts:
    minItems: 1
    maxItems: 2

required:
  - compatible
  - interrupts

additionalProperties: false
```

## Documentation/devicetree/bindings/pwm/apple,pwm.yaml
```yaml
# SPDX-License-Identifier: (GPL-2.0-only OR BSD-2-Clause)
%YAML 1.2
---
$id: http://devicetree.org/schemas/pwm/apple,pwm.yaml#
$schema: http://devicetree.org/meta-schemas/core.yaml#

title: Apple timer PWM controller

maintainers:
  - Ryan Murray <81541646+RyanTheTide@users.noreply.github.com>

description: |
  The timer PWM controller is distinct from the FPWM keyboard-backlight
  controller. It has one register aperture, one interrupt and a PMGR gate.
  No firmware PWM program or board-specific output state is implied.
  On T6000 the plain-PWM view shares its register bank with FPWM0,
  but has a distinct gate and interrupt. Ownership must be coordinated
  before either interface is used alongside the other.

select:
  properties:
    compatible:
      contains:
        enum:
          - apple,t6000-pwm
          - apple,t8103-pwm
          - apple,t8112-pwm
          - apple,t8122-pwm
          - apple,t8132-pwm
  required:
    - compatible

properties:
  compatible:
    items:
      - enum:
          - apple,t6000-pwm
          - apple,t8103-pwm
          - apple,t8112-pwm
          - apple,t8122-pwm
          - apple,t8132-pwm
      - const: apple,pwm

  reg:
    maxItems: 1

  interrupts:
    maxItems: 1

  power-domains:
    maxItems: 1

required:
  - compatible
  - reg
  - interrupts
  - power-domains

additionalProperties: false
```
