## Documentation/devicetree/bindings/phy/apple,t6050-dp-phy.yaml
```yaml
# SPDX-License-Identifier: GPL-2.0-only
%YAML 1.2
---
$id: http://devicetree.org/schemas/phy/apple,t6050-dp-phy.yaml#
$schema: http://devicetree.org/meta-schemas/core.yaml#

title: Apple T6050 DisplayPort and Type-C combo PHY

maintainers:
  - Dj <hey@djdev.me>

description: |
  Fixed four-lane DisplayPort PHY for HDMI bridges, or one shared owner of
  Type-C USB2, USB3 and DisplayPort alternate mode. DisplayPort supports RBR
  through HBR3 without spread-spectrum clocking. The combo provider serializes
  controller shutdown, PIPE handoff, orientation and alternate-mode changes.
  Register resources, power domains and board tunables come from the producer.

properties:
  compatible:
    enum:
      - apple,t6050-dp-phy
      - apple,t6050-combo-phy

  reg:
    minItems: 6
    maxItems: 11

  reg-names:
    minItems: 6
    maxItems: 11

  '#phy-cells':
    enum: [0, 1]

  '#reset-cells':
    const: 1

  apple,port-index:
    enum: [1, 2]
    description: Native Type-C port; the debug/proxy port is excluded

  apple,guest-port-reserved:
    type: boolean
    description: The boot producer has excluded this port from host ownership

  mode-switch: true
  orientation-switch: true

  mboxes:
    maxItems: 1

  port:
    $ref: /schemas/graph.yaml#/properties/port

  apple,tunable-aus40cmn-shm:
    $ref: /schemas/types.yaml#/definitions/uint32-array
    description: Offset, mask and value tuples for the common analog bank

  apple,tunable-cio4pll:
    $ref: /schemas/types.yaml#/definitions/uint32-array
    description: Offset, mask and value tuples for the CIO PLL bank

  apple,tunable-usb2-default:
    $ref: /schemas/types.yaml#/definitions/uint32-array
    description: Offset, mask and value tuples for the USB2 PHY bank

  apple,tunable-usb2-host:
    $ref: /schemas/types.yaml#/definitions/uint32-array
    description: Offset, mask and value tuples for the USB2 host bank

  apple,tunable-pipe-default:
    $ref: /schemas/types.yaml#/definitions/uint32-array
    description: Offset, mask and value tuples for the PIPE handler

  power-domains:
    minItems: 3
    maxItems: 3

  power-domain-names:
    items:
      - const: usb-aon
      - const: common
      - const: wrapper

  apple,tunable-axi2af:
    $ref: /schemas/types.yaml#/definitions/uint32-array
    description: Offset, mask and value tuples within the named bank

  apple,tunable-fabric:
    $ref: /schemas/types.yaml#/definitions/uint32-array
    description: Offset, mask and value tuples within the named bank

  apple,tunable-common-cfg:
    $ref: /schemas/types.yaml#/definitions/uint32-array
    description: Offset, mask and value tuples within the named bank

  apple,tunable-lioa:
    $ref: /schemas/types.yaml#/definitions/uint32-array
    description: Offset, mask and value tuples within the named bank

  apple,tunable-lane0-rx-clock:
    $ref: /schemas/types.yaml#/definitions/uint32-array
    description: Offset, mask and value tuples within the named bank

  apple,tunable-lane1-rx-clock:
    $ref: /schemas/types.yaml#/definitions/uint32-array
    description: Offset, mask and value tuples within the named bank

  apple,tunable-lane0-rx-eq:
    $ref: /schemas/types.yaml#/definitions/uint32-array
    description: Offset, mask and value tuples within the named bank

  apple,tunable-lane1-rx-eq:
    $ref: /schemas/types.yaml#/definitions/uint32-array
    description: Offset, mask and value tuples within the named bank

  apple,tunable-auspll:
    $ref: /schemas/types.yaml#/definitions/uint32-array
    description: Offset, mask and value tuples within the named bank

patternProperties:
  '^apple,dp-training-table(-rbr|-hbr|-hbr2|-hbr3)?$':
    $ref: /schemas/types.yaml#/definitions/uint32-array
    minItems: 16
    maxItems: 16
    description: Drive presets indexed by voltage swing times four plus pre-emphasis

required:
  - compatible
  - reg
  - reg-names
  - '#phy-cells'
  - power-domains
  - power-domain-names
  - apple,tunable-axi2af
  - apple,tunable-fabric
  - apple,tunable-common-cfg
  - apple,tunable-lioa
  - apple,tunable-lane0-rx-clock
  - apple,tunable-lane1-rx-clock
  - apple,tunable-lane0-rx-eq
  - apple,tunable-lane1-rx-eq
  - apple,tunable-auspll

allOf:
  - if:
      properties:
        compatible:
          const: apple,t6050-combo-phy
    then:
      properties:
        '#phy-cells':
          const: 1
        reg:
          minItems: 11
          maxItems: 11
        reg-names:
          items:
            - const: core
            - const: usb2phy
            - const: usb2-digital
            - const: reset
            - const: fabric
            - const: axi2af
            - const: lioa
            - const: common-cfg
            - const: usb-control
            - const: firmware-data
            - const: pipehandler
      required:
        - '#reset-cells'
        - apple,port-index
        - apple,guest-port-reserved
        - mode-switch
        - orientation-switch
        - mboxes
        - apple,tunable-aus40cmn-shm
        - apple,tunable-cio4pll
        - apple,tunable-usb2-default
        - apple,tunable-usb2-host
        - apple,tunable-pipe-default
    else:
      properties:
        '#phy-cells':
          const: 0
      if:
        required:
          - mode-switch
      then:
        properties:
          reg:
            minItems: 8
            maxItems: 8
          reg-names:
            items:
              - const: core
              - const: reset
              - const: fabric
              - const: axi2af
              - const: lioa
              - const: common-cfg
              - const: usb-control
              - const: firmware-data
        required:
          - orientation-switch
          - mboxes
          - apple,tunable-aus40cmn-shm
          - apple,tunable-cio4pll
      else:
        properties:
          reg:
            minItems: 6
            maxItems: 6
          reg-names:
            items:
              - const: core
              - const: reset
              - const: fabric
              - const: axi2af
              - const: lioa
              - const: common-cfg

additionalProperties: false
```

## Documentation/devicetree/bindings/phy/apple,t8152-aciophy-usb3.yaml
```yaml
# SPDX-License-Identifier: (GPL-2.0-only OR BSD-2-Clause)
%YAML 1.2
---
$id: http://devicetree.org/schemas/phy/apple,t8152-aciophy-usb3.yaml#
$schema: http://devicetree.org/meta-schemas/core.yaml#

title: Apple T8152 ACIOPHY in USB3 mode

maintainers:
  - Thomas Glanzmann <thomas@glanzmann.de>

description:
  The Type-C PHY (ACIOPHY) of the Apple T8152 (M6) SoC, used as the USB3 PHY
  of a port that is wired to a fixed USB3 device instead of a Type-C
  connector, such as the on-board hub behind the Mac mini (2026) front ports.
  The PHY also switches the PIPE handler of its DWC3 controller between the
  controller's dummy PHY and the ACIOPHY.

$defs:
  apple,tunable:
    $ref: /schemas/types.yaml#/definitions/uint32-matrix
    minItems: 1
    maxItems: 512
    items:
      items:
        - description: Register offset into the ATC PHY block
        - description: Mask to be applied to the register value
        - description: Bits to be set after applying the mask
    description:
      List of (register offset, mask, value) tuples from the PHY's node in
      Apple's device tree. These values can differ between devices of the
      same model and likely contain calibration values.

properties:
  compatible:
    const: apple,t8152-aciophy-usb3

  reg:
    items:
      - description: ATC PHY block
      - description: PIPE handler of the DWC3 controller
      - description: PMGR power states of the ATC's DP_0, DP_1 and USB_AON
      - description: PMGR2 PSD service block of the ATC's common domain

  reg-names:
    items:
      - const: atc
      - const: pipehandler
      - const: atc-ps
      - const: atc-psd

  "#phy-cells":
    const: 0

  apple,tunable-pre:
    $ref: "#/$defs/apple,tunable"
    description:
      Register settings applied after the PHY power-up, before the lane
      crossbar is set up.

  apple,tunable-post:
    $ref: "#/$defs/apple,tunable"
    description:
      Register settings applied after the lane crossbar is set up, including
      those of the USB3 lane.

required:
  - compatible
  - reg
  - reg-names
  - "#phy-cells"
  - apple,tunable-pre
  - apple,tunable-post

additionalProperties: false

examples:
  - |
    soc {
        #address-cells = <2>;
        #size-cells = <2>;

        phy@383000000 {
            compatible = "apple,t8152-aciophy-usb3";
            reg = <0x3 0x83000000 0x0 0x84000>,
                  <0x3 0x82414000 0x0 0x4000>,
                  <0x3 0x08290080 0x0 0x104>,
                  <0x3 0x03a13900 0x0 0xc0>;
            reg-names = "atc", "pipehandler", "atc-ps", "atc-psd";
            #phy-cells = <0>;
            apple,tunable-pre = <0x00800 0x00fc0000 0x00fc0000>;
            apple,tunable-post = <0x6c12c 0x0000801f 0x00000004>;
        };
    };
```

## Documentation/devicetree/bindings/phy/ti,cd2e22.yaml
```yaml
# SPDX-License-Identifier: (GPL-2.0-only OR BSD-2-Clause)
%YAML 1.2
---
$id: http://devicetree.org/schemas/phy/ti,cd2e22.yaml#
$schema: http://devicetree.org/meta-schemas/core.yaml#

title: Texas Instruments CD2E22 eUSB2 to USB 2.0 repeater

maintainers:
  - Ryan Murray <81541646+RyanTheTide@users.noreply.github.com>

description: |
  The CD2E22 is a dual-channel eUSB2 to USB 2.0 repeater with an I2C
  configuration interface. Board-specific tuning is supplied by firmware and
  is represented as masked 8-bit register updates. The operating-system driver
  deliberately has no built-in fallback values.

properties:
  compatible:
    const: ti,cd2e22

  reg:
    maxItems: 1

  "#phy-cells":
    const: 0

  ti,port:
    $ref: /schemas/types.yaml#/definitions/uint32
    enum: [0, 1]
    description: Repeater channel connected to this PHY consumer.

  apple,tunable:
    $ref: /schemas/types.yaml#/definitions/uint32-matrix
    description: |
      Masked register updates copied verbatim from the corresponding firmware
      device-tree property by the bootloader, one 32-bit cell per update. A
      cell holds, from its most to its least significant byte, the register,
      the mask, the value and a reserved byte that must be zero; in the
      flattened tree that is the byte sequence (register, mask, value,
      reserved). Each update applies (old & ~mask) | (value & mask).

      The type is the one apple,tunable has in the other bindings that define
      it, because a property name can have only one integer type across all
      bindings. No item counts are given here for the same reason: they would
      be merged into the three-cell row layout of those bindings.

required:
  - compatible
  - reg
  - "#phy-cells"
  - ti,port

additionalProperties: false

examples:
  - |
    i2c {
        #address-cells = <1>;
        #size-cells = <0>;

        usb_repeater: phy@21 {
            compatible = "ti,cd2e22";
            reg = <0x21>;
            #phy-cells = <0>;
            ti,port = <0>;
            apple,tunable = <0x010f0500>;
        };
    };
...
```
