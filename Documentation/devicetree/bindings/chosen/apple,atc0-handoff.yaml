## Documentation/devicetree/bindings/hwmon/apple,smc-hwmon.yaml
```yaml
# SPDX-License-Identifier: (GPL-2.0-only OR BSD-2-Clause)
%YAML 1.2
---
$id: http://devicetree.org/schemas/hwmon/apple,smc-hwmon.yaml#
$schema: http://devicetree.org/meta-schemas/core.yaml#

title: Apple SMC Hardware Monitoring

description:
  Apple's System Management Controller (SMC) exposes a vast array of
  hardware monitoring sensors, including temperature probes, current and
  voltage sense, power meters, and fan speeds. It also provides endpoints
  to manually control the speed of each fan individually. Each Apple
  Silicon device exposes a different set of endpoints via SMC keys. This
  is true even when two machines share an SoC. The CPU core temperature
  sensor keys on an M1 Mac mini are different to those on an M1 MacBook
  Pro, for example.

maintainers:
  - James Calligeros <jcalligeros99@gmail.com>

$defs:
  sensor:
    type: object

    properties:
      apple,key-id:
        $ref: /schemas/types.yaml#/definitions/string
        pattern: "^[A-Za-z0-9]{4}$"
        description: The SMC FourCC key of the desired sensor.
          Must match the node's suffix.

      label:
        description: Human-readable name for the sensor

      apple,no-data-below-millicelsius:
        maxItems: 1
        description:
          The SMC publishes a placeholder below this temperature, in
          millidegrees Celsius, while the sensor is powered down (the GPU
          temperature sensors of the M4 Pro read -4 to 4 C while the GPU is
          off). Such readings are reported as no data instead of as a
          temperature, and a thermal zone on the sensor skips them.

    required:
      - apple,key-id

properties:
  compatible:
    const: apple,smc-hwmon

  apple,soc-die-keys:
    $ref: /schemas/types.yaml#/definitions/string-array
    minItems: 1
    maxItems: 32
    items:
      pattern: "^[A-Za-z0-9]{4}$"
    description:
      SMC FourCC keys for SoC die temperature sensors. Each key must report a
      readable four-byte floating-point temperature in degrees Celsius. The
      hottest reading supplies the macsmc_soc_die thermal zone. These channels
      follow the temperature-* children in the listed order and are labelled
      "SoC die <key>". Keys absent from the running firmware or with an
      unsupported format are skipped. These channels do not change the indices
      used by thermal-sensors references to temperature-* children. With
      apple,discover-temperatures, a listed key adds no channel; its
      discovered channel (labelled with the key) supplies the zone. Likewise,
      a listed key whose temperature-* child has
      apple,no-data-below-millicelsius adds no channel; that child supplies
      the zone, and its readings below the threshold are left out of it.

  apple,soc-die-fan-trip-millicelsius:
    maxItems: 1
    description:
      Active trip temperature, in millidegrees Celsius, on the macsmc_soc_die
      thermal zone for kernel hotspot fan assistance. Intended to be populated
      by the boot loader (Aura) from the machine's ADT or SMC rather than
      hardcoded in static board .dts files. Requires a single key in
      apple,soc-die-keys, apple,soc-die-fan-hysteresis-millicelsius, and
      apple,soc-die-fan-hold-ms. Without these properties, hotspot fan
      assistance stays off.

  apple,soc-die-fan-hysteresis-millicelsius:
    maxItems: 1
    description:
      Hysteresis, in millidegrees Celsius, below
      apple,soc-die-fan-trip-millicelsius for the macsmc_soc_die active trip
      (release temperature is trip minus hysteresis). Intended to be populated
      by the boot loader (Aura) from the machine's ADT or SMC rather than
      hardcoded in static board .dts files. Must be strictly positive and less
      than the trip temperature.

  apple,soc-die-fan-hold-ms:
    minimum: 1
    description:
      Minimum hold time, in milliseconds, that kernel hotspot fan assistance
      keeps fans boosted after the GPU goes idle or the SoC die temperature
      falls below the release temperature before returning them to SMC
      automatic control. Intended to be populated by the boot loader (Aura)
      from the machine's ADT or SMC rather than hardcoded in static board .dts
      files.

  apple,soc-die-passive-millicelsius:
    maxItems: 1
    description:
      Passive trip temperature, in millidegrees Celsius, on the macsmc_soc_die
      thermal zone. In-kernel power consumers begin shedding performance at
      this temperature. Taken from the machine's ADT. Requires
      apple,soc-die-keys and apple,soc-die-hot-millicelsius.

  apple,soc-die-hot-millicelsius:
    maxItems: 1
    description:
      Hot trip temperature, in millidegrees Celsius, on the macsmc_soc_die
      thermal zone. In-kernel power consumers hold their lowest performance
      state at this temperature. Taken from the machine's ADT. Must be above
      apple,soc-die-passive-millicelsius. The trip reports the event without
      shutting the machine down.

  apple,thermal-pressure-key:
    $ref: /schemas/types.yaml#/definitions/string
    pattern: "^[A-Za-z0-9]{4}$"
    description:
      SMC FourCC key reporting the firmware thermal pressure level as a
      readable signed 32-bit integer. This is exposed for monitoring only.

  apple,discover-temperatures:
    type: boolean
    description:
      Enumerate readable, non-function temperature keys from the running SMC
      instead of providing a board-specific temperature table. Only keys
      beginning with T and reporting a four-byte floating-point value are
      exposed. Labels are the key identifiers, without inferred locations.
      Channels are reporting-only; their indices depend on the firmware and
      must not be used by a static thermal policy.

  "#thermal-sensor-cells":
    const: 1
    description:
      The cell is the zero-based index of a temperature channel, counting
      the temperature-* child nodes in order. With
      apple,discover-temperatures, whose channel indices are not stable, the
      only sensor is 1000, the hottest of the apple,soc-die-keys readings.
      A thermal zone on it comes in addition to the macsmc_soc_die zone,
      which is still registered for the users that look it up by name.

  "#cooling-cells":
    const: 3
    deprecated: true
    description:
      Former fan cooling-device specifier. Fan policy is handled by the SMC
      firmware; the driver no longer registers fan cooling devices.

patternProperties:
  "^current-[A-Za-z0-9]{4}$":
    $ref: "#/$defs/sensor"
    unevaluatedProperties: false

  "^fan-[A-Za-z0-9]{4}$":
    $ref: "#/$defs/sensor"
    unevaluatedProperties: false

    properties:
      apple,fan-minimum:
        $ref: /schemas/types.yaml#/definitions/string
        pattern: "^[A-Za-z0-9]{4}$"
        description: SMC key containing the fan's minimum speed

      apple,fan-maximum:
        $ref: /schemas/types.yaml#/definitions/string
        pattern: "^[A-Za-z0-9]{4}$"
        description: SMC key containing the fan's maximum speed

      apple,fan-target:
        $ref: /schemas/types.yaml#/definitions/string
        pattern: "^[A-Za-z0-9]{4}$"
        description: Writeable endpoint for setting desired fan speed

      apple,fan-mode:
        $ref: /schemas/types.yaml#/definitions/string
        pattern: "^[A-Za-z0-9]{4}$"
        description: Writeable key to enable/disable manual fan control

      apple,fan-manual-control:
        type: boolean
        description:
          The SMC firmware of this machine accepts a manual speed for this
          fan from the host and returns it to firmware control when asked,
          so the fan's target speed can be set from the OS. Requires
          apple,fan-target and apple,fan-mode. Without it the fan is only
          monitored, and driven by the thermal framework where the SMC
          node is a cooling device.

  "^power-[A-Za-z0-9]{4}$":
    $ref: "#/$defs/sensor"
    unevaluatedProperties: false

  "^temperature-[A-Za-z0-9]{4}$":
    $ref: "#/$defs/sensor"
    unevaluatedProperties: false

  "^voltage-[A-Za-z0-9]{4}$":
    $ref: "#/$defs/sensor"
    unevaluatedProperties: false

dependentRequired:
  apple,soc-die-fan-trip-millicelsius:
    - apple,soc-die-keys
    - apple,soc-die-fan-hysteresis-millicelsius
    - apple,soc-die-fan-hold-ms
  apple,soc-die-fan-hysteresis-millicelsius:
    - apple,soc-die-keys
    - apple,soc-die-fan-trip-millicelsius
    - apple,soc-die-fan-hold-ms
  apple,soc-die-fan-hold-ms:
    - apple,soc-die-keys
    - apple,soc-die-fan-trip-millicelsius
    - apple,soc-die-fan-hysteresis-millicelsius
  apple,soc-die-passive-millicelsius:
    - apple,soc-die-keys
    - apple,soc-die-hot-millicelsius
  apple,soc-die-hot-millicelsius:
    - apple,soc-die-keys
    - apple,soc-die-passive-millicelsius

allOf:
  - if:
      required:
        - apple,discover-temperatures
    then:
      patternProperties:
        "^temperature-": false

additionalProperties: false
```

## Documentation/devicetree/bindings/media/apple,t8140-ave.yaml
```yaml
# SPDX-License-Identifier: (GPL-2.0-only OR BSD-2-Clause)
%YAML 1.2
---
$id: http://devicetree.org/schemas/media/apple,t8140-ave.yaml#
$schema: http://devicetree.org/meta-schemas/core.yaml#

title: Apple video encoder

maintainers:
  - Miguel Cruz <7362641+Acelogic@users.noreply.github.com>

description: |
  The AVE coprocessor encodes video using firmware preloaded by the bootloader.
  DART instances translate its DMA streams. The bootloader supplies the firmware
  memory handoff and IOVA mappings.

select:
  properties:
    compatible:
      contains:
        enum:
          - apple,t6000-ave
          - apple,t6020-ave
          - apple,t6021-ave
          - apple,t6022-ave
          - apple,t6030-ave
          - apple,t6031-ave
          - apple,t6032-ave
          - apple,t6041-ave
          - apple,t8103-ave
          - apple,t8112-ave
          - apple,t8122-ave
          - apple,t8132-ave
          - apple,t6050-ave
          - apple,t8140-ave
          - apple,t8142-ave
  required:
    - compatible

properties:
  compatible: true

allOf:
  - properties:
      compatible:
        oneOf:
          - enum:
              - apple,t6000-ave
              - apple,t6041-ave
              - apple,t6050-ave
              - apple,t8112-ave
              - apple,t8140-ave
              - apple,t8142-ave
          - items:
              - enum:
                  - apple,t6020-ave
                  - apple,t6021-ave
                  - apple,t6022-ave
                  - apple,t6030-ave
                  - apple,t6031-ave
                  - apple,t6032-ave
                  - apple,t8103-ave
                  - apple,t8122-ave
                  - apple,t8132-ave
              - const: apple,ave

      reg:
        minItems: 3
        maxItems: 5
        description: Codec, mailbox, coprocessor and generation-specific auxiliary banks.

      reg-names:
        minItems: 3
        items:
          - const: codec
          - const: mailbox
          - const: coproc
          - enum: [pmgr, power-control]
          - enum: [fabric, pio]

      clocks:
        maxItems: 1

      interrupts:
        items:
          - description: Mailbox, raised when the firmware posts to a host ring
          - description: Codec interrupt handled by the firmware
          - description: Codec interrupt handled by the firmware
          - description: Codec interrupt handled by the firmware
          - description: Codec interrupt handled by the firmware

      power-domains:
        minItems: 1
        maxItems: 6

      power-domain-names:
        minItems: 5
        items:
          - const: dma
          - const: pipe4
          - const: pipe5
          - const: me0
          - const: me1
          - const: perf
            description: |
              A performance floor the encoder needs to run at full speed, held
              while the encoder is powered (for example the SoC rail floor of a
              PMC).

      iommus:
        minItems: 2
        maxItems: 4
        description:
          The encoder's stream on each of its DARTs. Where the motion-compensated
          temporal filter has its own stream (stream 12 on T8140), that stream is
          listed after the encoder's on each DART.

      memory-region:
        items:
          - description: Preloaded firmware text
          - description: Preloaded firmware data

      aurora,ave-text-crc32:
        $ref: /schemas/types.yaml#/definitions/string
        pattern: '^[0-9a-fA-F]{1,8}$'
        description: |
          Hexadecimal CRC32 of this encoder's preloaded firmware text region,
          injected by the bootloader at boot. When absent, the driver falls
          back to /chosen/aurora,ave-text-crc32 for compatibility with older
          bootloaders; if present, it takes precedence and must be valid.

      aurora,ave-data-crc32:
        $ref: /schemas/types.yaml#/definitions/string
        pattern: '^[0-9a-fA-F]{1,8}$'
        description: |
          Hexadecimal CRC32 of this encoder's clean preloaded firmware data
          region, injected by the bootloader at boot. When absent, the driver
          falls back to /chosen/aurora,ave-data-crc32 for compatibility with
          older bootloaders; if present, it takes precedence and must be valid.

    required:
      - compatible
      - reg
      - interrupts
      - power-domains
      - iommus

    allOf:
      - if:
          properties:
            compatible:
              contains:
                enum:
                  - apple,t6020-ave
                  - apple,t6021-ave
                  - apple,t6022-ave
        then:
          properties:
            reg:
              minItems: 5
        else:
          properties:
            power-domains:
              minItems: 5
          required:
            - reg-names
            - power-domain-names
      - if:
          properties:
            compatible:
              contains:
                enum:
                  - apple,t6041-ave
                  - apple,t6050-ave
                  - apple,t8132-ave
                  - apple,t8140-ave
                  - apple,t8142-ave
        then:
          properties:
            reg:
              maxItems: 3
            reg-names:
              maxItems: 3

    additionalProperties: false

unevaluatedProperties: false

examples:
  - |
    #include <dt-bindings/interrupt-controller/apple-aic.h>
    #include <dt-bindings/interrupt-controller/irq.h>

    soc {
        #address-cells = <2>;
        #size-cells = <2>;

        video-codec@285100000 {
            compatible = "apple,t6041-ave";
            reg = <0x2 0x85100000 0x0 0x45c000>,
                  <0x2 0x85050000 0x0 0x4000>,
                  <0x2 0x85800000 0x0 0x800000>;
            reg-names = "codec", "mailbox", "coproc";
            interrupt-parent = <&aic>;
            interrupts = <AIC_IRQ 1476 IRQ_TYPE_LEVEL_HIGH>,
                         <AIC_IRQ 1470 IRQ_TYPE_LEVEL_HIGH>,
                         <AIC_IRQ 1469 IRQ_TYPE_LEVEL_HIGH>,
                         <AIC_IRQ 1472 IRQ_TYPE_LEVEL_HIGH>,
                         <AIC_IRQ 1471 IRQ_TYPE_LEVEL_HIGH>;
            power-domains = <&ps_venc1_dma>, <&ps_venc1_pipe4>,
                            <&ps_venc1_pipe5>, <&ps_venc1_me0>,
                            <&ps_venc1_me1>, <&pmc_soc_max>;
            power-domain-names = "dma", "pipe4", "pipe5", "me0", "me1", "perf";
            iommus = <&ave1_dart0 0>, <&ave1_dart0 12>,
                     <&ave1_dart1 0>, <&ave1_dart1 12>;
            memory-region = <&ave1_fw_text>, <&ave1_fw_data>;
            aurora,ave-text-crc32 = "9a080cad";
            aurora,ave-data-crc32 = "6e66c376";
        };
    };
```
