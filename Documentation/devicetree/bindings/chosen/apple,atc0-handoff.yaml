## Documentation/devicetree/bindings/soc/apple/apple,clpc.yaml
```yaml
# SPDX-License-Identifier: (GPL-2.0-only OR BSD-2-Clause)
%YAML 1.2
---
$id: http://devicetree.org/schemas/soc/apple/apple,clpc.yaml#
$schema: http://devicetree.org/meta-schemas/core.yaml#

title: Apple SoC host performance controller (standalone)

maintainers:
  - Ryan Murray <ryan@aurorasilicon.org>

description:
  Platform-profile provider for Apple SoCs whose host performance controller
  (CLPC) does not sit under a PMC voter block (apple,pmc.yaml). Exposes
  low-power, balanced and performance platform profiles and enforces CPU
  frequency ceilings (and optional SMC package power targets or High Power
  mode) through the shared apple-clpc driver.

properties:
  compatible:
    oneOf:
      - items:
          - enum:
              - apple,t8112-clpc
          - const: apple,clpc
      - const: apple,clpc

  apple,smc:
    $ref: /schemas/types.yaml#/definitions/phandle
    description:
      The SMC, whose package power reading (PHPC) the low-power platform
      profile can monitor or target, and which the performance profile tells
      about High Power mode on Macs that have it.

  apple,high-power-mode:
    type: boolean
    description:
      The machine has High Power mode, the fan and power headroom macOS
      offers on some MacBook Pros. The performance platform profile then
      tells the SMC (apple,smc) that it is on.

  apple,low-power-frequency-max-mhz:
    description:
      The machine's CPU frequency ceiling in macOS's Low Power mode, in
      MHz, as the ADT's cpu-low-power-frequency-max has it. The low-power
      platform profile holds the CPU clusters to it, up to the next
      frequency of their tables. When absent and apple,high-power-mode is
      not set, no platform profile is registered.

  apple,low-power-mw:
    $ref: /schemas/types.yaml#/definitions/uint32
    description:
      Optional package power target in milliwatts (measured from SMC PHPC)
      for the low-power platform profile.

required:
  - compatible

additionalProperties: false

examples:
  - |
    performance-controller {
        compatible = "apple,t8112-clpc", "apple,clpc";
        apple,smc = <&smc>;
    };
```

## Documentation/devicetree/bindings/soc/apple/apple,t6000-pmgr-misc.yaml
```yaml
# SPDX-License-Identifier: (GPL-2.0-only OR BSD-2-Clause)
%YAML 1.2
---
$id: http://devicetree.org/schemas/soc/apple/apple,t6000-pmgr-misc.yaml#
$schema: http://devicetree.org/meta-schemas/core.yaml#

title: Apple SoC PMGR Misc Power States

maintainers:
  - Sasha Finkelstein <k@chaosmail.tech>

description: |
  Certain Apple SoCs include additional PMGR power states that are controlled
  via a different "misc" control block. This includes the fabric and memory
  controller states.

  When the host owns these registers and PMP firmware is disabled, an optional
  measured bandwidth OPP table enables one shared interconnect provider on
  T600x. Endpoint 0 represents clients and endpoint 1 represents memory. All
  clients use the path from 0 to 1, so their bandwidth requests aggregate.

properties:
  compatible:
    enum:
      - apple,t8103-pmgr-misc
      - apple,t6000-pmgr-misc
      - apple,t6020-pmgr-misc

  reg:
    minItems: 2
    maxItems: 3

  reg-names:
    minItems: 2
    items:
      - const: fabric-ps
      - const: dcs-ps
      - const: disp-ps

  apple,fabric-min-pstate:
    $ref: /schemas/types.yaml#/definitions/uint32
    minimum: 1
    maximum: 15
    description: |
      Lowest raw PMGR fabric p-state verified safe on this board for idle and
      s2idle scaling. When absent on SoCs without a built-in suspend floor,
      the boot fabric p-state is retained for idle and s2idle.

  apple,dcs-min-pstate:
    $ref: /schemas/types.yaml#/definitions/uint32
    minimum: 1
    maximum: 15
    description: |
      Lowest raw PMGR DCS p-state verified safe on this board for idle and
      s2idle scaling without starving active display scanout. When absent on
      SoCs without a built-in suspend floor, the boot DCS p-state is retained
      for idle and s2idle. Mutually exclusive with operating-points-v2.

  apple,disp-min-pstate:
    $ref: /schemas/types.yaml#/definitions/uint32
    minimum: 1
    maximum: 15
    description: |
      Lowest raw PMGR display perf p-state verified safe on this board for idle
      and s2idle scaling while scanning out the internal panel. Requires the
      optional disp-ps register range; when absent, the boot display perf
      p-state is retained.

  '#interconnect-cells':
    const: 1

  operating-points-v2:
    description: |
      Measured sustainable bandwidth table following
      operating-points-v2-apple-dcs.yaml. Only valid with host ownership of DCS;
      do not enable PMP firmware together with this interface.
    maxItems: 1

required:
  - compatible
  - reg
  - reg-names

dependentRequired:
  operating-points-v2: ['#interconnect-cells']
  '#interconnect-cells': [operating-points-v2]

allOf:
  - if:
      properties:
        compatible:
          enum:
            - apple,t8103-pmgr-misc
            - apple,t6020-pmgr-misc
    then:
      properties:
        operating-points-v2: false
        '#interconnect-cells': false
  - not:
      required:
        - apple,dcs-min-pstate
        - operating-points-v2

additionalProperties: false

examples:
  - |
    power-management@8e20c000 {
        compatible = "apple,t6000-pmgr-misc";
        reg = <0x8e20c000 0x400>,
              <0x8e20c800 0x400>;
        reg-names = "fabric-ps", "dcs-ps";
    };
```

## Documentation/devicetree/bindings/soc/apple/apple,t6030-sleep.yaml
```yaml
# SPDX-License-Identifier: (GPL-2.0-only OR BSD-2-Clause)
%YAML 1.2
---
$id: http://devicetree.org/schemas/soc/apple/apple,t6030-sleep.yaml#
$schema: http://devicetree.org/meta-schemas/core.yaml#

title: Apple T6030 system sleep controls

maintainers:
  - Aron van de Pol <hello@aronvandepol.com>

description: |
  The registers a kernel running directly at EL2 on the M3 Pro writes to enter
  and return from suspend-to-RAM: the sleep commit word, the PMGR's power
  states, power gates, CPU-start block and CPU complex words, the AON
  watchdog, the AP wake-enable words and nub-spmi0; optionally nub-spmi-a0,
  the AON AP watchdog deadline, the clock-generator muxes, the CLLT word and
  the SoC perf word. They belong to several hardware blocks, some of which
  other drivers also use, so the driver does not claim them. Every address is
  from the J516S ADT.

properties:
  compatible:
    const: apple,t6030-sleep

  reg:
    minItems: 8
    maxItems: 13

  reg-names:
    minItems: 8
    items:
      - const: commit
      - const: ps
      - const: pwrgate
      - const: cpu-start
      - const: cluster
      - const: wdt
      - const: wake
      - const: spmi
      - const: spmi-a0
      - const: aon-deadline
      - const: clk-mux
      - const: cllt
      - const: soc-perf

  apple,wake-enable:
    $ref: /schemas/types.yaml#/definitions/uint32-array
    description:
      The wake source IDs left enabled across suspend-to-RAM (the ADT's
      pmgr ap-wake-sources). Every other source is masked.

  apple,apcie:
    $ref: /schemas/types.yaml#/definitions/phandle
    description:
      The PCIe host whose shared registers and tunables the storage
      controller's link depends on, added by the boot loader.

  apple,pinctrl:
    $ref: /schemas/types.yaml#/definitions/phandle
    description:
      The pin controller whose pins a deep sleep resets. Its pins are saved
      before a sleep and put back after it.

  apple,pinctrl-skip-pins:
    $ref: /schemas/types.yaml#/definitions/uint32-array
    description:
      Pins of that controller to leave alone across a sleep.

required:
  - compatible
  - reg
  - reg-names
  - apple,wake-enable

additionalProperties: false

examples:
  - |
    soc {
        #address-cells = <2>;
        #size-cells = <2>;

        sleep-controller@3642d4000 {
            compatible = "apple,t6030-sleep";
            reg = <0x3 0x642d4000 0x0 0x4>,
                  <0x3 0x50700000 0x0 0x14000>,
                  <0x3 0x50724000 0x0 0x100>,
                  <0x3 0x50734000 0x0 0x10>,
                  <0x3 0x50780000 0x0 0x40>,
                  <0x3 0x642b0000 0x0 0x100>,
                  <0x3 0x64004000 0x0 0x100>,
                  <0x3 0x64714000 0x0 0x100>;
            reg-names = "commit", "ps", "pwrgate", "cpu-start", "cluster",
                        "wdt", "wake", "spmi";
            apple,wake-enable = <3 51 74 83>;
        };
    };
```
