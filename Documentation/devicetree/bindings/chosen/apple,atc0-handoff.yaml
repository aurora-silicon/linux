## Documentation/devicetree/bindings/display/apple,t8152-dcp-iboot.yaml
```yaml
# SPDX-License-Identifier: (GPL-2.0-only OR BSD-2-Clause)
%YAML 1.2
---
$id: http://devicetree.org/schemas/display/apple,t8152-dcp-iboot.yaml#
$schema: http://devicetree.org/meta-schemas/core.yaml#

title: Apple T8152 DCP on the iBoot display interface

maintainers:
  - Thomas Glanzmann <thomas@glanzmann.de>

description: |
  The Display Coprocessor (DCP) of the Apple T8152 SoC runs RTKit firmware
  that offers a small iBoot display interface (disp0-service) next to the
  full IOMobileFramebuffer protocol. This binding describes the DCP driven
  through that interface, together with the DisplayPort PHY its DPTX port
  is routed to. The DCP fetches through its own DART, the display pipe
  scans out through another one, which sees each scanout buffer at the same
  address.

properties:
  compatible:
    const: apple,t8152-dcp-iboot

  apple,afk-active-endpoints:
    $ref: /schemas/types.yaml#/definitions/uint32
    maximum: 65535
    description:
      Runtime handoff from the bootloader. Bit N records that AFK endpoint
      0x20 + N is running and must acknowledge shutdown before a new session
      starts. A zero bit means stopped. The bootloader inserts this only
      for controllers whose complete endpoint state it owns, and reserves
      the old session's buffers. The driver refuses takeover if absent.
      This property must not be hard-coded in a board device tree.

  apple,dp-source:
    $ref: /schemas/types.yaml#/definitions/uint32
    maximum: 2
    description:
      Display-crossbar UFP endpoint, 0 for DCP, 1 for DCPEXT0, 2 for DCPEXT1.
      The driver uses DPTX port zero, whose ATC mux selector is twice this.

  apple,usb-c-ports:
    $ref: /schemas/types.yaml#/definitions/phandle
    description:
      Controller node containing the shared USB-C port children, dp-clock,
      aux and aux-ps resources. Each connected port has one controller owner.

  apple,rtkit-wake:
    type: boolean
    description:
      Runtime handoff for an unused DCPEXT whose firmware is loaded, powered,
      and awaiting RTKit wake. The loader must reserve its firmware mappings
      and buffers and supply apple,afk-active-endpoints. This property must
      not be hard-coded in a board tree. An adopted HDMI session is already
      running and takes precedence over this unused-controller indication.

  reg:
    minItems: 2
    maxItems: 9

  reg-names:
    oneOf:
      - items:
          - const: coproc
          - const: atc
          - const: dp-clock
          - const: atc-ps
          - const: atc-psd
          - const: aux
          - const: aux-ps
        minItems: 5
        description:
          DCP coprocessor, ATC DisplayPort PHY (USB-C), the PMGR clock
          control of its DisplayPort link, the PMGR power states the PHY
          depends on, and optionally the AP DisplayPort AUX controller that
          reads the sink's EDID with its PMGR power state
      - items:
          - const: coproc
          - const: phy-core
          - const: phy-apb
          - const: aux
          - const: aux-ps
          - const: phy-ps
          - const: coproc-ps
          - const: coproc-psd
          - const: phy-psd
        minItems: 7
        description:
          DCP coprocessor, the HDMI dptx-phy blocks, the AP
          DisplayPort AUX controller that reads the sink's EDID with its
          PMGR power state, the PMGR power state of the HDMI PHY, the read
          only power state of the DCPEXT CPU, and the PMGR2 PSD service of
          the HDMI PHY. The PHY is accessed only once its power states read
          powered; with phy-psd it is powered up for a cold HDMI start.
      - items:
          - const: coproc
          - const: coproc-psd
        description:
          Additional display controller and its PMGR2 PSD admission state;
          PHY resources are shared through apple,usb-c-ports.
      - items:
          - const: coproc
          - const: dp-clock
          - const: aux
          - const: aux-ps
        minItems: 2
        description:
          DCP coprocessor, the PMGR clock control of the ATC DisplayPort
          links (one divider every eight bytes, starting with ATC0), and
          optionally the AP DisplayPort AUX controller with its PMGR power
          state; the USB-C ports follow as usb-c child nodes

  apple,tunable-pre:
    $ref: /schemas/types.yaml#/definitions/uint32-matrix
    items:
      items:
        - description: register offset in the ATC PHY block
        - description: mask
        - description: value
    description:
      ATC PHY tunables (ADT ACIOPHY_CMN and CIOPLL_CORE defaults), applied
      before the lane crossbar setup when the PHY starts from cold.

  apple,tunable-post:
    $ref: /schemas/types.yaml#/definitions/uint32-matrix
    items:
      items:
        - description: register offset in the ATC PHY block
        - description: mask
        - description: value
    description:
      ATC PHY tunables (ADT ATC_FABRIC, DPPLL and AUX defaults), applied
      after the lane crossbar setup.

  apple,hdmi:
    type: boolean
    description:
      The DCP drives the HDMI port through the dedicated dptx-phy and an
      on-board DisplayPort-to-HDMI converter. With apple,usb-c-ports it can
      instead claim a USB-C port when the bootloader has not assigned HDMI.

  apple,tunable-phy:
    $ref: /schemas/types.yaml#/definitions/uint32-matrix
    items:
      items:
        - description: register offset in the HDMI dptx-phy core block
        - description: mask
        - description: value
    description:
      HDMI dptx-phy tunables (ADT dptx-phy asdc and lane-shm-regs groups),
      applied when the PHY starts from cold.

  apple,smc:
    $ref: /schemas/types.yaml#/definitions/phandle
    description:
      The SMC that switches the power of the DisplayPort-to-HDMI converter.

  apple,pcon-power:
    $ref: /schemas/types.yaml#/definitions/uint32-matrix
    items:
      items:
        - description: SMC key
        - description: value, bits 63:32
        - description: value, bits 31:0
    description:
      SMC writes, in order, that power the DisplayPort-to-HDMI converter
      (ADT dp2hdmi-gpio0 function-dp2hdmi_pwr_en and function-hdmi_pwr_en).
      The converter drives the HDMI hot-plug detect line only while it is
      powered.

  hpd-gpios:
    maxItems: 1
    description:
      Hot plug detect line of the connector, if the AP can read it (J873g
      HDMI); without it the sink is assumed to stay connected.

  mboxes:
    maxItems: 1

  iommus:
    maxItems: 1
    description: DCP DART stream

  power-domains:
    maxItems: 1
    description:
      The coprocessor's power state, which its firmware runs; the DARTs
      follow it.

  scanout:
    type: object
    additionalProperties: false
    description:
      The display pipe's scanout stream. Its DART is locked with its own
      root, so it is a separate device that sees each scanout buffer at the
      DCP's address.
    properties:
      iommus:
        maxItems: 1
      dma-coherent: true
    required:
      - iommus

  dma-coherent: true

  apple,die:
    $ref: /schemas/types.yaml#/definitions/uint32
    description: Die of the DPTX connection target, 0 if absent.

  "#address-cells":
    const: 2

  "#size-cells":
    const: 2

  ranges: true

patternProperties:
  "^usb-c@[0-9a-f]+$":
    type: object
    additionalProperties: false
    description:
      A USB-C port whose ATC PHY the DCP can drive. The DCP drives one port
      at a time, the one a DisplayPort sink is plugged into.
    properties:
      reg:
        maxItems: 3
      reg-names:
        items:
          - const: atc
          - const: atc-ps
          - const: atc-psd
        description:
          ATC DisplayPort PHY, the PMGR power states it depends on (DP_0,
          DP_1 and USB_AON) and its common power domain (PSD)
      apple,dfp-endpoint:
        $ref: /schemas/types.yaml#/definitions/uint32
        description: The ATC's display-crossbar0 DFP endpoint (ATC instance).
      apple,tunable-pre:
        $ref: /schemas/types.yaml#/definitions/uint32-matrix
        description: As the node's apple,tunable-pre, for this port's PHY.
      apple,tunable-post:
        $ref: /schemas/types.yaml#/definitions/uint32-matrix
        description: As the node's apple,tunable-post, for this port's PHY.
      phys:
        maxItems: 1
        description:
          The port's ATC PHY in DisplayPort use (PHY_TYPE_DP). A DCP powers
          it while it drives the PHY, from before its cold start until its
          power-down, and keeps it powered for a display the bootloader
          started; the PHY driver powers the PHY's domains meanwhile and
          keeps it out of USB4. The PHY refuses this while it runs USB4.
      mode-switch:
        type: boolean
        description:
          The port's display switch, one per port and shared by all DCPs
          that can drive it. The port controller sets the port's
          DisplayPort alt mode state, pin assignment and HPD on it; the plug
          orientation is the Type-C port's.
      port:
        $ref: /schemas/graph.yaml#/properties/port
        description:
          Connects to the display port (port@3) of the port's
          usb-c-connector.
    dependencies:
      mode-switch: [ port ]
    required:
      - reg
      - reg-names
      - apple,dfp-endpoint

required:
  - compatible
  - reg
  - reg-names
  - mboxes
  - iommus
  - scanout

additionalProperties: false

examples:
  - |
    soc {
      #address-cells = <2>;
      #size-cells = <2>;

      display@286e00000 {
        compatible = "apple,t8152-dcp-iboot";
        reg = <0x2 0x86e00000 0x0 0x74000>,
              <0x4 0x13000000 0x0 0x84000>,
              <0x3 0x00020044 0x0 0x1c>,
              <0x3 0x082900c0 0x0 0x104>,
              <0x3 0x03a13a00 0x0 0xc0>;
        reg-names = "coproc", "atc", "dp-clock", "atc-ps", "atc-psd";
        mboxes = <&dcp_mbox>;
        iommus = <&dcp_dart 23>;

        scanout {
          iommus = <&disp0_dart 0>;
        };
      };

      display@296e00000 {
        compatible = "apple,t8152-dcp-iboot";
        reg = <0x2 0x96e00000 0x0 0x74000>,
              <0x3 0x00020044 0x0 0x1c>;
        reg-names = "coproc", "dp-clock";
        #address-cells = <2>;
        #size-cells = <2>;
        ranges;
        mboxes = <&dcp_mbox>;
        iommus = <&dcp_dart 23>;

        scanout {
          iommus = <&disp0_dart 0>;
        };

        usb-c@413000000 {
          reg = <0x4 0x13000000 0x0 0x84000>,
                <0x3 0x082900c0 0x0 0x104>,
                <0x3 0x03a13a00 0x0 0xc0>;
          reg-names = "atc", "atc-ps", "atc-psd";
          apple,dfp-endpoint = <3>;
          phys = <&atc3_phy 6>;
          mode-switch;

          port {
            endpoint {
              remote-endpoint = <&typec3_display>;
            };
          };
        };
      };
    };
```

## Documentation/devicetree/bindings/firmware/apple,j714s-atc0-handoff.yaml
```yaml
# SPDX-License-Identifier: GPL-2.0-only OR BSD-2-Clause
%YAML 1.2
---
$id: http://devicetree.org/schemas/firmware/apple,j714s-atc0-handoff.yaml#
$schema: http://devicetree.org/meta-schemas/core.yaml#

title: Apple J714s ATC0 boot ownership handoff interface

maintainers:
  - Dj <hey@djdev.me>

description: |
  The J714s left-back USB-C port is also the boot producer's debug port.
  Its devices start disabled. This firmware interface identifies the group
  the producer may enable after relinquishing USB/debug ownership, proving
  no DMA was retained, and supplying the current machine's PHY tunables.
  Shared providers are excluded. Older producers leave the group disabled;
  Linux does not activate it.

properties:
  compatible:
    const: apple,j714s-atc0-handoff

  apple,devices:
    $ref: /schemas/types.yaml#/definitions/phandle-array
    minItems: 1
    maxItems: 32
    items:
      maxItems: 1
    description: |
      ATC0-only power domains, PHY and mailbox, USB DARTs and DRD, port
      controller, router and mailbox/NHI/DART, PCIe tunnel parent/DART/root
      controller, and display crossbar. Every member must be disabled until
      handoff. Do not include the shared AOP GPIO, AUSS or CIO reset providers.

required:
  - compatible
  - apple,devices

additionalProperties: false
```
