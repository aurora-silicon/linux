## Documentation/devicetree/bindings/soc/apple/apple,t8140-sleep.yaml
```yaml
# SPDX-License-Identifier: (GPL-2.0-only OR BSD-2-Clause)
%YAML 1.2
---
$id: http://devicetree.org/schemas/soc/apple/apple,t8140-sleep.yaml#
$schema: http://devicetree.org/meta-schemas/core.yaml#

title: Apple SoC system sleep controls

maintainers:
  - Diljit Singh <hey@djdev.me>

description: |
  The registers a kernel running directly at EL2 on an Apple SoC writes to enter
  and return from suspend-to-RAM and to power its secondary CPUs off. They belong
  to several hardware blocks, some of which other drivers also use, so this node
  overlaps those drivers' register ranges and the driver does not claim them.
  Each SoC has its own compatible, as its power domains differ.

properties:
  compatible:
    enum:
      - apple,t6030-sleep
      - apple,t8132-sleep
      - apple,t8140-sleep
      - apple,t8142-sleep

  reg:
    minItems: 18
    maxItems: 41

  reg-names:
    minItems: 18
    maxItems: 41

  apple,wake-enable:
    $ref: /schemas/types.yaml#/definitions/uint32-array
    description:
      The wake source IDs left enabled across suspend-to-RAM. Every other
      source is masked.

  apple,spmi-pmu-sources:
    $ref: /schemas/types.yaml#/definitions/uint32-array
    items:
      - minimum: 0x600
        maximum: 0x61c
        multipleOf: 4
      - minimum: 1
    description: |
      Offset of a Gen4 SPMI peripheral interrupt status word and the mask of
      PMU sources owned by the sleep controller. Only these latched sources
      are acknowledged at entry and wake. On T8142 they are enabled after
      programming the RTC alarm, with their prior enable state restored on
      return. Other peripheral interrupt sources are left unchanged.

  apple,apcie:
    $ref: /schemas/types.yaml#/definitions/phandle
    description:
      The PCIe host whose shared registers and tunables the storage controller's
      link depends on. They are needed even with that host disabled.

  apple,pinctrl:
    $ref: /schemas/types.yaml#/definitions/phandle
    description:
      The pin controller whose pins a deep sleep resets. Its pins are saved
      before a sleep and put back after it, before the storage controller
      starts.

  apple,pinctrl-skip-pins:
    $ref: /schemas/types.yaml#/definitions/uint32-array
    description:
      Pins of that controller to leave alone across a sleep, neither saved nor
      put back.

  apple,debug-port:
    $ref: /schemas/types.yaml#/definitions/phandle
    description:
      The USB-C port controller that carries the debug link, stopped for a sleep.

  apple,radio-host:
    $ref: /schemas/types.yaml#/definitions/phandle
    description:
      The PCIe host of the radio's link, which the boot loader trained. Its root
      port loses its configuration in a deep sleep and is trained again after
      the wake.

  apple,radio-perst:
    $ref: /schemas/types.yaml#/definitions/phandle-array
    items:
      - items:
          - description: Phandle of the radio GPIO controller.
          - description: Pin number.
          - description: GPIO flags.
    description:
      The GPIO that drives the radio's PERST#, held across that retraining.

  apple,display-coprocessors:
    $ref: /schemas/types.yaml#/definitions/phandle-array
    description:
      The DCP and the external DCPs, which must be off before a commit, in that
      order.

  apple,smc-sleep-policy:
    $ref: /schemas/types.yaml#/definitions/uint32-array
    minItems: 6
    maxItems: 6
    description: |
      The SMC's sleep messages: the pmVC value, then the least spacings in us
      from the warning to pmVC, from the last pmVC to SLPA, SLPA to the AP
      idle, the idle to the commit, and the wake to pmVC. 0 is no least
      spacing.

  apple,seq-prepare:
    $ref: "#/$defs/register-sequence"
    description:
      Run after the enclave stops and the sleep's SPMI notify words are
      written, before the other coprocessors stop.

  apple,seq-notice:
    $ref: "#/$defs/register-sequence"
    description:
      Run once the coprocessors that stop first (SIO) have stopped and their
      power words are off, before the others stop.

  apple,seq-commit:
    $ref: "#/$defs/register-sequence"
    description:
      Run once the other cores have stopped, the last steps before the
      commit word.

required:
  - compatible
  - reg
  - reg-names
  - apple,display-coprocessors

allOf:
  - if:
      properties:
        compatible:
          contains:
            const: apple,t8140-sleep
    then:
      required:
        - apple,wake-enable
      properties:
        reg:
          minItems: 28
          maxItems: 28
        reg-names:
          items:
            - const: ps
            - const: pwrgate
            - const: cpu-start
            - const: cllt
            - const: cluster
            - const: commit
            - const: wdt
            - const: aon-misc
            - const: wake
            - const: amcc0
            - const: amcc1
            - const: amcc2
            - const: amcc3
            - const: pmc-dcp
            - const: dvfm-e
            - const: dvfm-p
            - const: spmi
            - const: pmc-voters
            - const: dcs
            - const: ps-aon
            - const: spmi-a0
            - const: clk-mux
            - const: mcc0
            - const: mcc1
            - const: mcc2
            - const: ptd
            - const: clk-perf
            - const: cluster-dcs
  - if:
      properties:
        compatible:
          contains:
            const: apple,t6030-sleep
    then:
      required:
        - apple,wake-enable
        - apple,smc-sleep-policy
        - apple,seq-prepare
        - apple,seq-notice
        - apple,seq-commit
      properties:
        reg:
          minItems: 18
          maxItems: 18
        reg-names:
          items:
            - const: ps
            - const: pwrgate
            - const: cpu-start
            - const: cllt
            - const: cluster
            - const: commit
            - const: wdt
            - const: wake
            - const: spmi
            - const: ps-aon
            - const: spmi-a0
            - const: clk-mux
            - const: clk-perf
            - const: ps-gpu
            - const: amcc0
            - const: amcc1
            - const: dcs0
            - const: ptd
    else:
      properties:
        apple,smc-sleep-policy: false
        apple,seq-prepare: false
        apple,seq-notice: false
        apple,seq-commit: false
  - if:
      properties:
        compatible:
          contains:
            const: apple,t8132-sleep
    then:
      properties:
        reg:
          minItems: 25
          maxItems: 26
        reg-names:
          minItems: 25
          items:
            - const: ps
            - const: pwrgate
            - const: cpu-start
            - const: cllt
            - const: cluster
            - const: commit
            - const: wdt
            - const: aon-misc
            - const: wake
            - const: amcc0
            - const: amcc1
            - const: pmc-dcp
            - const: dvfm-e
            - const: dvfm-p
            - const: spmi
            - const: pmc-voters
            - const: dcs
            - const: ps-aon
            - const: spmi-a0
            - const: clk-mux
            - const: mcc0
            - const: mcc1
            - const: ptd
            - const: clk-perf
            - const: cluster-dcs
            - const: ps-prot
  - if:
      properties:
        compatible:
          contains:
            const: apple,t8142-sleep
    then:
      required:
        - apple,wake-enable
      properties:
        reg:
          minItems: 36
          maxItems: 41
        reg-names:
          minItems: 36
          items:
            - const: ps
            - const: pwrgate
            - const: cpu-start
            - const: cllt
            - const: cluster
            - const: commit
            - const: wdt
            - const: aon-misc
            - const: wake
            - const: spmi
            - const: ps-aon
            - const: spmi-a0
            - const: pmc-voters
            - const: clk-perf
            - const: dcs
            - const: acc-e
            - const: acc-p
            - const: amcc0
            - const: amcc1
            - const: amcc2
            - const: amcc3
            - const: socni0
            - const: socni1
            - const: socni2
            - const: socni3
            - const: socni4
            - const: socni5
            - const: mcc0
            - const: mcc1
            - const: mcc2
            - const: mcc3
            - const: mcc4
            - const: mcc5
            - const: mcc6
            - const: mcc7
            - const: mem-clk
            - const: clk-slots
            - const: amcc-cfg0
            - const: amcc-cfg1
            - const: amcc-cfg2
            - const: amcc-cfg3
  - if:
      not:
        properties:
          compatible:
            contains:
              const: apple,t8142-sleep
    then:
      properties:
        apple,radio-host: false
        apple,radio-perst: false

additionalProperties: false

$defs:
  register-sequence:
    $ref: /schemas/types.yaml#/definitions/uint32-matrix
    description: |
      Run in order. Kind bits 7:0 are 0 write the value, 1 read, 2 set the
      value's bits, 3 clear them, 4 write back what is read, 5 wait for the
      value's bits to be set, 6 wait for them to be clear, 7 a 16-bit write,
      8 a 64-bit write of the value as the high word and 0 as the low one, 9
      a 64-bit read written back with the value's bits of its low word
      cleared. Kinds 0 to 6 are 32-bit accesses. Bits 31:16 are a wait's
      timeout in ms (0 for 10 ms); bit 8 a wait whose timeout is not an
      error. The block is this node's reg entry by index, and the offset is
      aligned to the access's width, which fits in the block.
    items:
      items:
        - description: Kind
        - description: Block
        - description: Offset
        - description: Value
```

## Documentation/devicetree/bindings/soc/apple/apple,t8152-aop.yaml
```yaml
# SPDX-License-Identifier: (GPL-2.0-only OR BSD-2-Clause)
%YAML 1.2
---
$id: http://devicetree.org/schemas/soc/apple/apple,t8152-aop.yaml#
$schema: http://devicetree.org/meta-schemas/core.yaml#

title: Apple T8152-generation Always-On Processor

maintainers:
  - Ryan Murray <81541646+RyanTheTide@users.noreply.github.com>

description:
  The Always-On Processor on T8142, T8152 and T6050 runs firmware that the
  boot loader loads and leaves halted. It owns the audio and sensor services.
  The host boots it over its RTKit mailbox, using a separate setup-port
  mailbox when the firmware's boot protocol requires it, and shares buffers
  through one stream of the AOP DART.

properties:
  compatible:
    oneOf:
      - items:
          - enum:
              - apple,t6050-aop
              - apple,t8142-aop
          - const: apple,t8152-aop
      - const: apple,t8152-aop

  reg:
    items:
      - description: AOP register and boot-argument window
      - description: ASC wrapper and processor control registers

  reg-names:
    items:
      - const: mmio
      - const: asc

  mboxes:
    minItems: 1
    items:
      - description: Primary firmware transport
      - description: Firmware setup-port transport

  mbox-names:
    description:
      Include setup when the firmware uses the setup-port boot protocol.
      Omitting setup selects boot over the primary RTKit mailbox alone.
    minItems: 1
    items:
      - const: mbox
      - const: setup

  iommus:
    maxItems: 1

  apple,dma-range:
    $ref: /schemas/types.yaml#/definitions/uint64-array
    minItems: 2
    maxItems: 2
    description:
      Host DMA allocation window as a base and nonzero size, inside the root
      slots of this AOP DART stream that are free for the host.

  apple,sleep-endpoints:
    $ref: /schemas/types.yaml#/definitions/uint32-array
    minItems: 1
    maxItems: 15
    uniqueItems: true
    items:
      minimum: 0x20
      maximum: 0x2e
    description:
      The service endpoints the host stops before a system sleep in which the
      firmware keeps running, in the order it stops them; one not listed is
      left as it is. Without it the host stops every started endpoint in
      endpoint order. Filled in by the bootloader.

  apple,wake-endpoints:
    $ref: /schemas/types.yaml#/definitions/uint32-array
    minItems: 1
    maxItems: 15
    uniqueItems: true
    items:
      minimum: 0x20
      maximum: 0x2e
    description:
      The order in which the host starts the endpoints it stopped, after that
      sleep; one not listed is not started again. Without it they start in
      endpoint order. Filled in by the bootloader.

  audio:
    type: object
    $ref: /schemas/sound/apple,t8152-aop-audio.yaml#

  als:
    type: object
    $ref: /schemas/iio/light/apple,aop-als.yaml#
    description: The ambient light sensor service.
    unevaluatedProperties: false

  las:
    type: object
    $ref: /schemas/iio/position/apple,aop-las.yaml#
    description: The lid angle sensor service.
    unevaluatedProperties: false

  accel:
    type: object
    $ref: /schemas/iio/imu/apple,aop-motion.yaml#
    description: The accelerometer service.
    unevaluatedProperties: false

  gyro:
    type: object
    $ref: /schemas/iio/imu/apple,aop-motion.yaml#
    description: The gyroscope service.
    unevaluatedProperties: false

  devmotion6:
    type: object
    $ref: /schemas/iio/imu/apple,aop-devmotion.yaml#
    description: The device motion (orientation) service.

allOf:
  - if:
      properties:
        compatible:
          contains:
            const: apple,t8142-aop
    then:
      properties:
        als:
          properties:
            compatible:
              items:
                - const: apple,t8142-aop-als
                - const: apple,aop-als
    else:
      properties:
        als:
          properties:
            compatible:
              not:
                contains:
                  const: apple,t8142-aop-als

required:
  - compatible
  - reg
  - reg-names
  - mboxes
  - mbox-names
  - iommus
  - apple,dma-range

additionalProperties: false

examples:
  - |
    aop@290c00000 {
        compatible = "apple,t6050-aop", "apple,t8152-aop";
        reg = <0x90c00000 0x1e0000>, <0x90600000 0x4000>;
        reg-names = "mmio", "asc";
        mboxes = <&aop_mbox>;
        mbox-names = "mbox";
        iommus = <&aop_dart 0>;
        apple,dma-range = /bits/ 64 <0x11000000000 0x1000000000>;

        audio {
            compatible = "apple,t6050-aop-audio";
            dmas = <&admac 4>, <&admac 5>, <&admac 0>, <&admac 1>;
            dma-names = "cout", "cin", "spkr", "sense";
            #sound-dai-cells = <1>;
        };
    };
```
