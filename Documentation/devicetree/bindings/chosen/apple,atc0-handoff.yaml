## Documentation/devicetree/bindings/chosen/apple,atc0-handoff.yaml
```yaml
# SPDX-License-Identifier: GPL-2.0-only OR BSD-2-Clause
%YAML 1.2
---
$id: http://devicetree.org/schemas/chosen/apple,atc0-handoff.yaml#
$schema: http://devicetree.org/meta-schemas/core.yaml#

title: Apple J714s ATC0 boot ownership handoff group

maintainers:
  - Dj <hey@djdev.me>

description: |
  The J714s left-back USB-C port is also the boot producer's debug port.
  Its devices start disabled. A producer may enable this complete group only
  after relinquishing USB/debug ownership, proving no DMA was retained, and
  supplying the current machine's PHY tunables. Shared providers are excluded.
  An older producer leaves the group disabled. Linux does not activate it.

select:
  properties:
    $nodename:
      const: chosen
  required:
    - $nodename
    - apple,atc0-handoff

properties:
  $nodename:
    const: chosen

  apple,atc0-handoff:
    $ref: /schemas/types.yaml#/definitions/phandle-array
    minItems: 1
    maxItems: 32
    items:
      maxItems: 1
    description: |
      ATC0-only power domains, PHY and mailbox, USB DARTs and DRD, port
      controller, router and mailbox/NHI/DART, PCIe tunnel parent/DART/root
      controller, and display crossbar. Every member must be disabled until
      handoff. Do not include the shared AOP GPIO, AUSS or CIO reset providers.

additionalProperties: true
```

## Documentation/devicetree/bindings/chosen/apple,dcp-rtkit-running.yaml
```yaml
# SPDX-License-Identifier: (GPL-2.0-only OR BSD-2-Clause)
%YAML 1.2
---
$id: http://devicetree.org/schemas/chosen/apple,dcp-rtkit-running.yaml#
$schema: http://devicetree.org/meta-schemas/core.yaml#

title: Apple DCP RTKit state at the loader hand-off

maintainers:
  - Thomas Glanzmann <thomas@glanzmann.de>

description:
  The loader records whether the internal display coprocessor's RTKit was
  running when it handed over to the kernel, or whether the loader quiesced
  it after a failed display setup. The loader omits this property when it
  never started the coprocessor.

select:
  properties:
    $nodename:
      const: chosen
  required:
    - $nodename

properties:
  $nodename:
    const: chosen

  apple,dcp-rtkit-running:
    $ref: /schemas/types.yaml#/definitions/uint32
    enum: [0, 1]
    description:
      One if the internal DCP's RTKit was running at the hand-off, zero if
      the loader quiesced it.

additionalProperties: true
...
```

## Documentation/devicetree/bindings/chosen/linux-enablement-mac,dapf-handoff.yaml
```yaml
# SPDX-License-Identifier: (GPL-2.0 OR BSD-2-Clause)
%YAML 1.2
---
$id: http://devicetree.org/schemas/chosen/linux-enablement-mac,dapf-handoff.yaml#
$schema: http://devicetree.org/meta-schemas/core.yaml#

title: Apple T8132 DAPF consumer hand-off

maintainers:
  - Diljit Singh <hey@djdev.me>

description:
  Board device trees on Apple T8132 Macs describe which ADT consumers need
  their DART access protection filters (DAPFs) programmed by the bootloader
  before handing control to Linux, and whether a consumer must be powered on
  or programmed as halted prior to hand-off.

select:
  properties:
    $nodename:
      const: chosen
  required:
    - $nodename

properties:
  $nodename:
    const: chosen

  linux-enablement-mac,dapf-handoff:
    $ref: /schemas/types.yaml#/definitions/string-array
    description:
      ADT paths of consumers (for example "/arm-io/aop", "/arm-io/mtp",
      "/arm-io/pmp") whose DART access protection filters the bootloader
      programs for hand-off to Linux.

  linux-enablement-mac,dapf-power-on-handoff:
    $ref: /schemas/types.yaml#/definitions/string-array
    description:
      Subset of consumers listed in linux-enablement-mac,dapf-handoff that
      the bootloader powers on before programming their DAPFs and leaves
      powered across hand-off.

  linux-enablement-mac,dapf-halted-handoff:
    $ref: /schemas/types.yaml#/definitions/string-array
    description:
      Subset of consumers listed in linux-enablement-mac,dapf-handoff that
      boot firmware leaves halted and unpowered, whose DAPFs the bootloader
      programs for a halted consumer so Linux can cold-start them.

additionalProperties: true
...
```

## Documentation/devicetree/bindings/chosen/linux-enablement-mac,disk-boot.yaml
```yaml
# SPDX-License-Identifier: (GPL-2.0-only OR BSD-2-Clause)
%YAML 1.2
---
$id: http://devicetree.org/schemas/chosen/linux-enablement-mac,disk-boot.yaml#
$schema: http://devicetree.org/meta-schemas/core.yaml#

title: Apple T8132 disk-boot /chosen flag

maintainers:
  - Diljit Singh <hey@djdev.me>

description:
  Boolean flag in /chosen carried by Apple T8132 board device trees to
  indicate that the board tree targets normal disk-boot hand-off from
  the bootloader.

select:
  properties:
    $nodename:
      const: chosen
  required:
    - $nodename

properties:
  $nodename:
    const: chosen

  linux-enablement-mac,disk-boot:
    type: boolean
    description:
      Indicates that the board device tree targets disk-boot hand-off
      on Apple T8132 systems.

additionalProperties: true
...
```

## Documentation/devicetree/bindings/display/apple,t8140-display-power.yaml
```yaml
# SPDX-License-Identifier: (GPL-2.0-only OR BSD-2-Clause)
%YAML 1.2
---
$id: http://devicetree.org/schemas/display/apple,t8140-display-power.yaml#
$schema: http://devicetree.org/meta-schemas/core.yaml#

title: Apple T8103, T6041, T8132, T8140 and T8142 display power words

maintainers:
  - Diljit Singh <hey@djdev.me>

description:
  The words and PMGR power-state chains a display coprocessor's driver writes
  to power its domains off and on around a restart of its firmware, as macOS
  does. A display coprocessor names this node in its apple,display-power
  property. The words belong to the power manager and the display block, so no
  driver binds it.

properties:
  compatible:
    enum:
      - apple,t8103-display-power
      - apple,t6041-display-power
      - apple,t8132-display-power
      - apple,t8140-display-power
      - apple,t8142-display-power

  reg:
    minItems: 1
    maxItems: 5

  reg-names:
    minItems: 1
    maxItems: 5

  '#address-cells':
    const: 1

  '#size-cells':
    const: 0

patternProperties:
  '^chain@[0-9]+$':
    type: object
    description: |
      One ordered display power-domain chain for apple,t6041-display-power,
      powered down in reg order during suspend-to-RAM.
    properties:
      reg:
        maxItems: 1

      label:
        description: Short name of the display chain (e.g. main, ext0..ext3).

      apple,main-chain:
        type: boolean
        description:
          Marks the internal display chain, which clears the display AXI2AF
          bridge and PMC voter on stop and is restarted warm on wake.

      apple,pwrgate-aux:
        type: boolean
        description:
          Selects the pwrgate-aux register window instead of pwrgate for this
          chain's power-gate retention words.

      apple,gapf-offset:
        $ref: /schemas/types.yaml#/definitions/uint32
        description:
          Byte offset of this chain's clock-protection slice within the gapf
          register window.

      apple,pwrgate-offsets:
        $ref: /schemas/types.yaml#/definitions/uint32-array
        minItems: 2
        maxItems: 2
        description:
          Byte offsets of the pair of power-gate retention words (A, then B)
          within the selected pwrgate window.

      apple,fabric-domain:
        $ref: /schemas/types.yaml#/definitions/phandle
        description:
          Parent fabric PMGR power-state node held manually on while this chain
          powers down, then returned to its previous auto-enable state.

      power-domains:
        minItems: 3
        maxItems: 16
        description: |
          Ordered PMGR power-state nodes for this chain: SYS, FE, CPU, followed
          by the chain's child sub-domains in parent-before-child order
          (powered off in reverse).

    required:
      - reg
      - label
      - apple,gapf-offset
      - apple,pwrgate-offsets
      - power-domains

    additionalProperties: false

required:
  - compatible
  - reg
  - reg-names

allOf:
  - if:
      properties:
        compatible:
          const: apple,t8103-display-power
    then:
      # T8103's display has no retention words and its PMC no count of the coprocessors.
      properties:
        reg:
          items:
            - description: the power manager's power state words
        reg-names:
          items:
            - const: ps
  - if:
      properties:
        compatible:
          const: apple,t6041-display-power
    then:
      properties:
        reg:
          items:
            - description: the display PMC voter counter pair
            - description: the internal display power gate retention words
            - description: the external display power gate retention words
            - description: the clock-protection slices for all display chains
            - description: the internal display AXI2AF bridge registers
        reg-names:
          items:
            - const: pmc-dcp
            - const: pwrgate
            - const: pwrgate-aux
            - const: gapf
            - const: axi2af
      required:
        - '#address-cells'
        - '#size-cells'
    else:
      properties:
        '#address-cells': false
        '#size-cells': false
      patternProperties:
        '^chain@[0-9]+$': false
  - if:
      properties:
        compatible:
          enum:
            - apple,t8132-display-power
            - apple,t8140-display-power
    then:
      properties:
        reg:
          items:
            - description: the display PMC word that counts the powered coprocessors
            - description: the power manager's power state words
            - description: the power manager's power gate words
        reg-names:
          items:
            - const: pmc-dcp
            - const: ps
            - const: pwrgate
  - if:
      properties:
        compatible:
          const: apple,t8142-display-power
    then:
      # T8142's PMC keeps no count of the powered coprocessors: no pmc-dcp word.
      properties:
        reg:
          items:
            - description: the power manager's power gate words
            - description: the power manager's power state words
        reg-names:
          items:
            - const: pwrgate
            - const: ps

additionalProperties: false

examples:
  - |
    soc {
        #address-cells = <2>;
        #size-cells = <2>;

        display-power@5048a9c14 {
            compatible = "apple,t6041-display-power";
            reg = <0x5 0x048a9c14 0x0 0x8>,
                  <0x5 0x022a1000 0x0 0x100>,
                  <0x5 0x0282d000 0x0 0x1000>,
                  <0x5 0x00578000 0x0 0x1000>,
                  <0x4 0x03000100 0x0 0x10>;
            reg-names = "pmc-dcp", "pwrgate", "pwrgate-aux", "gapf", "axi2af";
            #address-cells = <1>;
            #size-cells = <0>;

            chain@0 {
                reg = <0>;
                label = "ext3";
                apple,pwrgate-aux;
                apple,gapf-offset = <0x740>;
                apple,pwrgate-offsets = <0xfb4 0xfd8>;
                power-domains = <&ps_dispext3_sys>, <&ps_dispext3_fe>,
                                <&ps_dispext3_cpu>, <&ps_dispext3_dbe>,
                                <&ps_dpext3>, <&ps_dispext3_gp0>,
                                <&ps_dispext3_gp1>, <&ps_dispext3_gpl>,
                                <&ps_dispext3_ppp>, <&ps_dispext3_dsc>;
            };

            chain@4 {
                reg = <4>;
                label = "main";
                apple,main-chain;
                apple,gapf-offset = <0x540>;
                apple,pwrgate-offsets = <0x1c 0x60>;
                apple,fabric-domain = <&ps_fab6_soc>;
                power-domains = <&ps_disp_sys>, <&ps_disp_fe>, <&ps_disp_cpu>,
                                <&ps_disp_spi>, <&ps_disp_spmi>, <&ps_disp_dbe>,
                                <&ps_disp_dp>, <&ps_disp_gp0>, <&ps_disp_gp1>,
                                <&ps_disp_gpl>, <&ps_disp_cmb>, <&ps_disp_ppp>,
                                <&ps_disp_brc>, <&ps_disp_blc>;
            };
        };
    };

  - |
    soc {
        #address-cells = <2>;
        #size-cells = <2>;

        display-power@3028a9c14 {
            compatible = "apple,t8140-display-power";
            reg = <0x3 0x028a9c14 0x0 0x4>,
                  <0x3 0x00700000 0x0 0x14000>,
                  <0x3 0x00724000 0x0 0x1000>;
            reg-names = "pmc-dcp", "ps", "pwrgate";
        };
    };

  - |
    soc {
        #address-cells = <2>;
        #size-cells = <2>;

        display-power@380724000 {
            compatible = "apple,t8142-display-power";
            reg = <0x3 0x80724000 0x0 0x2000>,
                  <0x3 0x80700000 0x0 0x14000>;
            reg-names = "pwrgate", "ps";
        };
    };
```
