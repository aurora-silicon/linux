## Documentation/devicetree/bindings/soc/apple/apple,t6050-sleep.yaml
```yaml
# SPDX-License-Identifier: (GPL-2.0-only OR BSD-2-Clause)
%YAML 1.2
---
$id: http://devicetree.org/schemas/soc/apple/apple,t6050-sleep.yaml#
$schema: http://devicetree.org/meta-schemas/core.yaml#

title: Apple T6050 system sleep controls

maintainers:
  - Diljit Singh <hey@djdev.me>

description: |
  The registers a kernel running directly at EL2 on the M5 Pro or Max writes to enter and
  return from suspend-to-RAM: the PMGR's power, clock, perf and table banks on both
  dies, the CPU clusters, power gates and start block, the sleep commit word, the
  watchdogs, nub-spmi0, the PMC, PTD, the DART GAPF bank, the clusters' CPM blocks,
  the storage link's PHY, the clock generator, the memory controller's channel pages,
  the AP wake-enable words and the GFX die's interrupt controller. They belong to
  several hardware blocks, some of which other drivers also use, so the driver does
  not claim them.

properties:
  compatible:
    oneOf:
      - const: apple,t6050-sleep
      - items:
          - const: apple,t6050-j716c-sleep
          - const: apple,t6050-sleep

  reg:
    minItems: 46
    maxItems: 46

  reg-names:
    items:
      - const: ps0
      - const: ps1
      - const: ps-aon
      - const: ps-gpx
      - const: ps-media
      - const: ps-gfx-aon
      - const: clk
      - const: clk-soc
      - const: clk1
      - const: afr-clk
      - const: media-clk
      - const: perf
      - const: media-perf
      - const: table0
      - const: table1
      - const: media-table
      - const: cluster
      - const: pwrgate
      - const: cpu-start
      - const: commit
      - const: wdt
      - const: wdt-aux
      - const: disp-gate
      - const: spmi
      - const: pmc-voters
      - const: pmc-rails
      - const: ptd
      - const: gapf
      - const: aon-clk
      - const: media-aon-clk
      - const: cpm0
      - const: cpm1
      - const: cpm2
      - const: storage-phy
      - const: storage-phy-ip
      - const: clkgen
      - const: clkgen-78
      - const: media-clkgen-78
      - const: mcc22
      - const: mcc23
      - const: mcc24
      - const: mcc25
      - const: mcc26
      - const: wake
      - const: wake-gfx
      - const: aic-gfx

  apple,display-coprocessors:
    $ref: /schemas/types.yaml#/definitions/phandle-array
    minItems: 5
    maxItems: 5
    items:
      maxItems: 1
    description: Internal DCP, DCPEXT0, DCPEXT1, DCPEXT2, DCPEXT3.

  apple,spmi-buses:
    $ref: /schemas/types.yaml#/definitions/phandle-array
    minItems: 1
    maxItems: 7
    items:
      maxItems: 1
    description: |
      The SPMI buses whose interrupt masks the sleep sets: aop-spmi0 fifth, then
      the buses a board has beyond the J714s's (the M5 Max's nub-spmi1, nub-spmi4).

  apple,sleep-darts:
    $ref: /schemas/types.yaml#/definitions/phandle-array
    minItems: 1
    maxItems: 4
    items:
      maxItems: 1
    description: SEP's, PMP0's, SIO's and the DCP's DART, stopped in the sleep's last steps.

  apple,radio-pcie:
    $ref: /schemas/types.yaml#/definitions/phandle
    description: |
      The PCIe host whose port 0 carries the radio. Its link is shut down for the
      sleep, and the shared PHY and root complex are started again after it.

  apple,pinctrl:
    $ref: /schemas/types.yaml#/definitions/phandle
    description: The AP pin controller, whose pins a deep sleep resets.

  apple,pinctrl-skip-pins:
    $ref: /schemas/types.yaml#/definitions/uint32-array
    description: |
      Pins neither saved nor restored. From the ADT, set by the bootloader;
      without it no pin is saved.

  apple,sleep-low-pins:
    $ref: /schemas/types.yaml#/definitions/uint32-array
    minItems: 1
    maxItems: 4
    description: Pins driven high that go low in the sleep entry. Set by the bootloader.

  apple,wake-enable:
    $ref: /schemas/types.yaml#/definitions/uint32-array
    minItems: 1
    maxItems: 64
    description: |
      The AP wake sources left enabled for a sleep, by their ADT index. From
      the ADT, set by the bootloader.

  apple,wake-enable-gfx:
    $ref: /schemas/types.yaml#/definitions/uint32-array
    minItems: 1
    maxItems: 32
    description: |
      The GFX die's wake sources left enabled for a sleep. From the ADT, set by
      the bootloader.

  apple,clk-gating-boot:
    $ref: /schemas/types.yaml#/definitions/uint32-matrix
    items:
      items:
        - description: Index of a clock page or table in reg
        - description: Offset
        - description: Value
    description: |
      The one-time clock-gating set-up of the PMGR's clock pages, written in this
      order at probe. Set by the bootloader; without it the pages keep the values
      the bootloader left.

  apple,cpm-boot:
    $ref: /schemas/types.yaml#/definitions/uint64-matrix
    items:
      items:
        - description: Cluster (0 to 2, the cpm0 to cpm2 apertures)
        - description: Offset
        - description: Value
    description: |
      The clusters' CPM set-up, written in this order at probe. Set by the
      bootloader.

  apple,radio-link-down:
    $ref: "#/$defs/register-sequence"
    description: |
      The radio link's shutdown before the sleep, up to its PME_Turn_Off
      handshake; PERST# goes low after it. Without it the link is not shut down
      and the sleep is refused while the radio's host is bound.

  apple,radio-link-down-port:
    $ref: "#/$defs/register-sequence"
    description: The radio port's shutdown after its DART is stopped.

  apple,radio-port-wake:
    $ref: "#/$defs/register-sequence"
    description: The radio port's wake steps, after the port is set up again.

  apple,radio-dart-wake:
    $ref: "#/$defs/register-sequence"
    description: The radio port's wake steps after its DART runs again.

  apple,radio-phy-wake:
    $ref: "#/$defs/register-sequence"
    description: |
      The shared PCIe PHY's tunables and start after a sleep, before its root
      complex runs again.

  apple,phy-park:
    $ref: "#/$defs/register-sequence"
    description: The shared PCIe PHY parked before its power words go down.

  apple,phy-down:
    $ref: "#/$defs/register-sequence"
    description: The shared PCIe PHY's last step before APCIE_PHY_SW goes down.

  apple,commit-schedule-us:
    minItems: 20
    maxItems: 20
    description: |
      The commit window's steps, each as its time before the sleep timer in
      us, in the driver's step order: the two MCC releases, the storage PHY's
      park, the storage words, the watchdogs, the memory floor, the MCC stop,
      clkgen, the clock words, three PTD drops, three power-gate rounds, the
      perf words, AFR, the cluster words, SIO, the tables. Each less than
      apple,commit-runway-us where that is given. Without it there is no deep
      sleep.

  apple,commit-runway-us:
    maxItems: 1
    description: |
      The time before the sleep timer, in us, that the entry keeps from the
      SMC's idle notice to the timer, the commit window. Every step of
      apple,commit-schedule-us is nearer the timer than this. Without it the
      driver takes the schedule's earliest step and one millisecond more.

  apple,smc-sleep-policy:
    $ref: /schemas/types.yaml#/definitions/uint32-array
    minItems: 6
    maxItems: 6
    description: |
      The SMC's sleep messages: the pmVC value, then the spacings in us from
      the warning to pmVC, pmVC to SLPA, SLPA to the AP idle, the idle to the
      timer, and the wake to pmVC. Without it there is no deep sleep.

  apple,seq-boot:
    $ref: "#/$defs/register-sequence"
    description: |
      Run once at probe after apple,clk-gating-boot and apple,cpm-boot: the
      power words the boot puts under automatic power, and the SPMI buses'
      interrupt masks and event sources.

  apple,spmi-runtime-mask:
    $ref: /schemas/types.yaml#/definitions/uint32
    description: |
      nub-spmi0's interrupt mask through the sleep's own PMU commands before
      the masks; without it, what the boot left there.

  apple,spmi-pmu-sources:
    $ref: /schemas/types.yaml#/definitions/uint32-array
    items:
      - description: |
          Offset in the spmi block of the nub-spmi0 peripheral status word
          (0x600 to 0x61c) that holds the PMU's interrupt sources.
      - description: The PMU's source bits in that word.
    description: |
      The PMU's interrupt sources on nub-spmi0. A source the PMU raised stays
      latched, and holds an AP wake source up, until it is acknowledged; no
      driver takes these interrupts. The sleep acknowledges them (writes 1 to
      the latched bits) before its SPMI masks and again at the wake. Without
      it, nothing is acknowledged.

  apple,seq-stage:
    $ref: "#/$defs/register-sequence"
    description: |
      At the stage, after the PMC's channels and the memory floor's steps: the
      PMC's rail words.

  apple,seq-commit-wdt:
    $ref: "#/$defs/register-sequence"
    description: |
      In the commit window, before the watchdogs are stopped.

  apple,seq-commit-afr:
    $ref: "#/$defs/register-sequence"
    description: |
      In the commit window, for AFR while its power word is on.

  apple,seq-commit-sio:
    $ref: "#/$defs/register-sequence"
    description: |
      In the commit window, before the tables: SIO's power words and the clock
      muxes.

  apple,seq-display-gate:
    $ref: "#/$defs/register-sequence"
    description: |
      At the internal display's stop, after its CPU word: the display gate
      words, which the wake restores from their saved values.

  apple,wake-order:
    $ref: /schemas/types.yaml#/definitions/uint32-array
    minItems: 1
    maxItems: 8192
    description: |
      The words the wake restores, in order, from their values read before the
      sleep: (reg index << 20) | offset of a clock, perf or table word, or
      0x80000000 | the same for a power word.

  apple,entry-clk-words:
    $ref: /schemas/types.yaml#/definitions/uint32-array
    minItems: 1
    maxItems: 256
    description: |
      The clock words whose enable bit the commit clears, as (reg index << 20)
      | offset.

  apple,entry-perf-words:
    $ref: /schemas/types.yaml#/definitions/uint32-array
    minItems: 1
    maxItems: 64
    description: |
      The perf words the commit writes to 0, as (reg index << 20) | offset.

  apple,ptd-sleep:
    $ref: /schemas/types.yaml#/definitions/uint32-array
    minItems: 5
    maxItems: 5
    description: |
      PTD: the AP's request entry, then the bits in it of the three CPU
      clusters and of storage. The bits are also the PMP report entries the
      sleep owns.

  apple,pmu-sleep-reads:
    $ref: /schemas/types.yaml#/definitions/uint32-array
    minItems: 2
    maxItems: 16
    description: |
      The PMU reads after the boot stage write, as address and length (1 to 8)
      pairs.

  apple,spmi-sleep-order:
    $ref: /schemas/types.yaml#/definitions/uint32-array
    minItems: 1
    maxItems: 7
    description: |
      The order in which the apple,spmi-buses get their sleep mask, by index;
      without it, their DT order.

  apple,spmi-sleep-gap-us:
    description: |
      The spacing between those writes, in us.

  apple,pmu-alarm-rearm:
    $ref: /schemas/types.yaml#/definitions/uint32-array
    minItems: 2
    maxItems: 2
    description: |
      The PMU RTC control values after the timer: after an alarm that already
      fired, then the final one. Without it the alarm is not rearmed and the
      entry counts a PMU error.

  apple,pmu-wake-stage:
    $ref: /schemas/types.yaml#/definitions/uint32
    description: |
      The PMU boot stage written back at the wake.

  apple,complex-requests:
    $ref: /schemas/types.yaml#/definitions/uint32-array
    minItems: 2
    maxItems: 8
    description: |
      The complex request the commit writes for each state it may find, as
      (state, request) pairs; any other state refuses the sleep.

  apple,perf-floor-steps:
    $ref: /schemas/types.yaml#/definitions/uint32-array
    minItems: 1
    maxItems: 4
    description: |
      The memory performance floor's steps before it goes to 0.

  apple,perf-floor-step-ms:
    description: |
      The time each step is held, in ms.

  apple,pmc-sleep-channels:
    $ref: /schemas/types.yaml#/definitions/uint32-array
    minItems: 1
    maxItems: 4
    description: |
      The PMC channels taken down at the stage.

required:
  - compatible
  - reg
  - reg-names
  - apple,display-coprocessors

additionalProperties: false

$defs:
  register-sequence:
    $ref: /schemas/types.yaml#/definitions/uint32-matrix
    description: |
      Set by the bootloader. Run in order. Kind bits 7:0 are 0 write the value,
      1 read, 2 set the value's bits, 3 clear them, 4 write back what is read,
      5 wait for the value's bits to be set, 6 wait for them to be clear, 7 a
      16-bit write; bits 31:16 a wait's timeout in ms (0 for 10 ms); bit 8 a
      wait whose timeout is not an error. The blocks are 0 to 7 the radio
      host's config, port0 (0x24000 bytes from its start), phy0, rc, phy0's
      four port words (0x10000 bytes from its start), the PHY's common page
      below them, this node's storage-phy and storage-phy-ip; 8 to 14 the
      apple,spmi-buses; from 16, this node's reg entries by index.
    items:
      items:
        - description: Kind
        - description: Block
        - description: Offset
        - description: Value
```
