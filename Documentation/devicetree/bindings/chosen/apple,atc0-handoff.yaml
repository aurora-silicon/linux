## Documentation/devicetree/bindings/media/apple,t8152-avd.yaml
```yaml
# SPDX-License-Identifier: (GPL-2.0-only OR BSD-2-Clause)
%YAML 1.2
---
$id: http://devicetree.org/schemas/media/apple,t8152-avd.yaml#
$schema: http://devicetree.org/meta-schemas/core.yaml#

title: Apple T8152 Kopsia video decoder

maintainers:
  - Thomas Glanzmann <thomas@glanzmann.de>

description:
  Kopsia is the T8152 stateless video decoder. Its decoder, PIODMA and
  auxiliary data streams share a Gen3 DART and a PSD power domain. The host
  submits codec programs with the MCU halted and polls decoder status;
  the PostOffice mailbox transport is not used by this implementation.

properties:
  compatible:
    const: apple,t8152-avd

  reg:
    items:
      - description: MCU code memory
      - description: MCU control registers
      - description: Decoder control registers
      - description: Decoder wrapper registers
      - description: PIODMA registers

  reg-names:
    items:
      - const: code
      - const: mbox
      - const: ctrl
      - const: wrap
      - const: dma

  iommus:
    items:
      - description: Decoder stream
      - description: PIODMA stream
      - description: Auxiliary data stream

  power-domains:
    maxItems: 1

required:
  - compatible
  - reg
  - reg-names
  - iommus
  - power-domains

additionalProperties: false

examples:
  - |
    soc {
        #address-cells = <2>;
        #size-cells = <2>;

        video-codec@485400000 {
            compatible = "apple,t8152-avd";
            reg = <0x4 0x85400000 0x0 0x12000>,
                  <0x4 0x85500000 0x0 0x4000>,
                  <0x4 0x85100000 0x0 0x10000>,
                  <0x4 0x850c0000 0x0 0x4000>,
                  <0x4 0x85070000 0x0 0x4000>;
            reg-names = "code", "mbox", "ctrl", "wrap", "dma";
            iommus = <&avd_dart 0>, <&avd_dart 1>, <&avd_dart 2>;
            power-domains = <&ps_avd>;
        };
    };
```

## Documentation/devicetree/bindings/mfd/apple,smc.yaml
```yaml
# SPDX-License-Identifier: (GPL-2.0-only OR BSD-2-Clause) AND GPL-2.0-only
%YAML 1.2
---
$id: http://devicetree.org/schemas/mfd/apple,smc.yaml#
$schema: http://devicetree.org/meta-schemas/core.yaml#

title: Apple Mac System Management Controller

maintainers:
  - Sven Peter <sven@kernel.org>

description:
  Apple Mac System Management Controller implements various functions
  such as GPIO, RTC, power, reboot.

properties:
  compatible:
    oneOf:
      - description: T8152 SMC with read-only hardware monitoring.
        const: apple,t8152-smc
      - const: apple,t6050-smc
      - items:
          - enum:
              - apple,t6020-smc
              - apple,t6030-smc
              - apple,t6031-smc
              - apple,t6041-smc
              - apple,t8122-smc
              - apple,t8132-smc
              - apple,t8140-smc
              - apple,t8142-smc
          - const: apple,t8103-smc
      - items:
          - enum:
              # Do not add additional SoC to this list.
              - apple,t6000-smc
              - apple,t8103-smc
              - apple,t8112-smc
          - const: apple,smc

  reg:
    items:
      - description: SMC area
      - description: SRAM area

  reg-names:
    items:
      - const: smc
      - const: sram

  mboxes:
    maxItems: 1

  apple,sleep-wake-type:
    type: boolean
    description:
      The SMC firmware expects the wake type key (WKTP) set to its sleep value
      at the sleep commit, and cleared after a full wake. Left at the sleep
      value, the SMC treats the time awake as a power nap.

  apple,sleep-pmvc:
    $ref: /schemas/types.yaml#/definitions/uint32
    minimum: 0x100
    maximum: 0x1ff
    description:
      The value written to the SMC's VDD_CIO rail key (pmVC) at the sleep
      commit, before the sleep notice. Bit 8 is set, and bit n keeps port n's
      CIO rail powered across the sleep. Which rails must stay up depends on
      what the SoC's sleep sequence powers on itself. Without the property
      pmVC is not written.

  apple,sleep-low-pins:
    $ref: /schemas/types.yaml#/definitions/uint32-array
    minItems: 1
    maxItems: 4
    items:
      maximum: 0xff
    description:
      SMC GPIO numbers (the number in the GPIO's gPxx key) that are driven
      low before the SMC is told of a suspend-to-RAM and high again after the
      wake, for a supply that has to be off while the machine sleeps and that
      no driver switches at that point. On the J314s this is GPIO 26, the SD
      card reader's power enable.

  gpio:
    oneOf:
      - $ref: /schemas/gpio/apple,smc-gpio.yaml
      - $ref: /schemas/gpio/apple,smc-pcio-gpio.yaml

  gpio-low:
    $ref: /schemas/gpio/apple,smc-gpio.yaml

  reboot:
    $ref: /schemas/power/reset/apple,smc-reboot.yaml

  rtc:
    $ref: /schemas/rtc/apple,smc-rtc.yaml

  hwmon:
    $ref: /schemas/hwmon/apple,smc-hwmon.yaml

  apple,wake-reasons:
    $ref: /schemas/types.yaml#/definitions/uint32-array
    minItems: 1
    maxItems: 64
    items:
      maximum: 63
    description: |
      The bits of the SMC's wake record that have a name on this board, as the
      ADT's smc-pmu node numbers them (event_name-bitN).

  apple,wake-reason-names:
    $ref: /schemas/types.yaml#/definitions/string-array
    minItems: 1
    maxItems: 64
    description: The names of the bits in apple,wake-reasons, in the same order.

additionalProperties: false

required:
  - compatible
  - reg
  - reg-names
  - mboxes

examples:
  - |
    soc {
      #address-cells = <2>;
      #size-cells = <2>;

      smc@23e400000 {
        compatible = "apple,t8103-smc", "apple,smc";
        reg = <0x2 0x3e400000 0x0 0x4000>,
               <0x2 0x3fe00000 0x0 0x100000>;
        reg-names = "smc", "sram";
        mboxes = <&smc_mbox>;

        smc_gpio: gpio {
          compatible = "apple,smc-gpio";
          gpio-controller;
          #gpio-cells = <2>;
        };

        reboot {
          compatible = "apple,smc-reboot";
          nvmem-cells = <&shutdown_flag>, <&boot_stage>,
                        <&boot_error_count>, <&panic_count>;
          nvmem-cell-names = "shutdown_flag", "boot_stage",
                             "boot_error_count", "panic_count";
        };

        rtc {
          compatible = "apple,smc-rtc";
          nvmem-cells = <&rtc_offset>;
          nvmem-cell-names = "rtc_offset";
       };

        hwmon {
          compatible = "apple,smc-hwmon";

          current-ID0R {
            apple,key-id = "ID0R";
            label = "AC Input Current";
          };

          fan-F0Ac {
            apple,key-id = "F0Ac";
            apple,fan-minimum = "F0Mn";
            apple,fan-maximum = "F0Mx";
            apple,fan-target = "F0Tg";
            apple,fan-mode = "F0Md";
            label = "Fan 1";
          };

          power-PSTR {
            apple,key-id = "PSTR";
            label = "Total System Power";
          };

          temperature-TW0P {
            apple,key-id = "TW0P";
            label = "WiFi/BT Module Temperature";
          };

          voltage-VD0R {
            apple,key-id = "VD0R";
            label = "AC Input Voltage";
          };
        };
      };
    };
```

## Documentation/devicetree/bindings/net/wireless/apple,centauri.yaml
```yaml
# SPDX-License-Identifier: GPL-2.0-only
%YAML 1.2
---
$id: http://devicetree.org/schemas/net/wireless/apple,centauri.yaml#
$schema: http://devicetree.org/meta-schemas/core.yaml#

title: Apple N1 Centauri Control PCI function

maintainers:
  - Dj <hey@djdev.me>

description: |
  PCI function zero owns the shared N1 firmware bootstrap. The boot producer
  supplies the personalized FTAB filename and packed firmware platform ID.
  The endpoint must be left in its stopped ROM personality with DMA and MSI
  quiesced. The host's root-port reset retrains the link after the ROM
  bootstrap. This binding does not authorize adopting an existing live
  firmware session or releasing another owner's retained DART streams.

  The T8142 and T8152 native transport uses the same PCI function IDs but is a
  different firmware profile. Its SoC-specific compatible identifies this
  binding profile; the generic PCI compatible is retained as the fallback.
  Runtime driver selection continues to use the PCI ID and host SoC; the
  native driver prefers firmware-name from this node when present (falling
  back to its board table while older DTBs and firmware layouts transition)
  rather than the T6050 wire-protocol properties.

  On T8142 and T8152 the root port above function zero may describe the N1's
  warm reset with apple,function-warm-reset and apple,warm-reset-writes, as in
  pci/apple,pcie.yaml. With both, the native driver restarts a firmware
  that stopped; without them it never resets the chip.

properties:
  compatible:
    oneOf:
      - enum:
          - pci106b,1900
          - pci106b,1901
      - items:
          - enum:
              - apple,t8142-centauri-control
              - apple,t8152-centauri-control
          - const: pci106b,1900

  reg:
    maxItems: 1
    description: Standard five-cell PCI function address

  firmware-name:
    $ref: /schemas/types.yaml#/definitions/string
    description: Personalized FTAB including the required per-device calibration

  apple,centauri-platform-id:
    $ref: /schemas/types.yaml#/definitions/uint32
    description: Firmware chip ID in bits 15..0 and board ID in bits 30..16

  apple,centauri-protocol:
    $ref: /schemas/types.yaml#/definitions/uint32
    const: 27
    description: Shared firmware wire protocol profile

allOf:
  - if:
      properties:
        compatible:
          contains:
            enum:
              - apple,t8142-centauri-control
              - apple,t8152-centauri-control
    then:
      properties:
        apple,centauri-platform-id: false
        apple,centauri-protocol: false
    else:
      required:
        - firmware-name
        - apple,centauri-platform-id
        - apple,centauri-protocol

required:
  - compatible
  - reg

additionalProperties: false
```

## Documentation/devicetree/bindings/power/apple,t8152-psd.yaml
```yaml
# SPDX-License-Identifier: (GPL-2.0-only OR BSD-2-Clause)
%YAML 1.2
---
$id: http://devicetree.org/schemas/power/apple,t8152-psd.yaml#
$schema: http://devicetree.org/meta-schemas/core.yaml#

title: Apple T8152 PMGR2 PSD service

maintainers:
  - Thomas Glanzmann <thomas@glanzmann.de>

description:
  On T8152, the video decoder, USB4 routers and their PHYs use PMGR2 PSD
  services. The reg property identifies the 0x100-byte register block for
  each service. The block contains a target-state request, an acknowledge
  bit and the current state (0 powered, 6 cold). Reading the state consumes
  the acknowledge. One node describes one service as a power domain.

allOf:
  - $ref: power-domain.yaml#

properties:
  compatible:
    const: apple,t8152-psd

  reg:
    maxItems: 1

  '#power-domain-cells':
    const: 0

  label:
    description: The service's name, for the power domain.

  apple,always-on:
    type: boolean
    description:
      Keep the service powered. For a service whose consumers cannot yet
      restore the state another agent set up in its blocks, such as a PHY
      configured by the bootloader.

required:
  - compatible
  - reg
  - '#power-domain-cells'

unevaluatedProperties: false

examples:
  - |
    soc {
        #address-cells = <2>;
        #size-cells = <2>;

        power-controller@303a13200 {
            compatible = "apple,t8152-psd";
            reg = <0x3 0x03a13200 0x0 0x100>;
            #power-domain-cells = <0>;
            label = "avd";
        };
    };
```

## Documentation/devicetree/bindings/soc/apple/apple,aop2.yaml
```yaml
# SPDX-License-Identifier: (GPL-2.0-only OR BSD-2-Clause)
%YAML 1.2
---
$id: http://devicetree.org/schemas/soc/apple/apple,aop2.yaml#
$schema: http://devicetree.org/meta-schemas/core.yaml#

title: Apple secondary always-on processor

maintainers:
  - Ryan Murray <81541646+RyanTheTide@users.noreply.github.com>

description: |
  Secondary always-on processor register banks and transport interrupts.
  The processor uses a distinct stream in the primary AOP DART. On T6050 the
  host starts the processor and talks to it over its RTKit mailbox; the node
  then has the ASC wrapper's registers and the mailbox provider, which has
  the transport interrupts.

properties:
  compatible:
    oneOf:
      - items:
          - enum:
              - apple,t6050-aop2
              - apple,t8140-aop2
          - const: apple,aop2

  reg:
    minItems: 1
    maxItems: 3
    description:
      Register apertures in hardware-description order, or, with a mailbox
      provider, the ASC wrapper and processor control registers alone.

  reg-names:
    items:
      - const: asc

  interrupts:
    minItems: 4
    maxItems: 4

  mboxes:
    maxItems: 1

  mbox-names:
    items:
      - const: mbox

  apple,dma-range:
    $ref: /schemas/types.yaml#/definitions/uint64-array
    minItems: 2
    maxItems: 2
    description:
      Host DMA allocation window as a base and nonzero size, inside the root
      slots of this processor's DART stream that are free for the host.

  power-domains:
    maxItems: 1

  iommus:
    maxItems: 1

  apple,init-arg:
    $ref: /schemas/types.yaml#/definitions/uint32
    description:
      The argument of the INIT message with which the host opens each service
      endpoint. Without it, INIT carries no argument. Filled in by the
      bootloader.

  apple,sleep-message:
    $ref: /schemas/types.yaml#/definitions/uint32-array
    minItems: 1
    maxItems: 28
    description:
      The message, in 32-bit words, that the host puts on each open service
      endpoint's transmit ring before a system sleep, waiting for the
      firmware to answer it. Without it the endpoints get no message and the
      host only sends its IDLE. Filled in by the bootloader.

  apple,wake-message:
    $ref: /schemas/types.yaml#/definitions/uint32-array
    minItems: 3
    maxItems: 28
    description:
      The message, in 32-bit words, that the host puts on the transmit ring
      of each service endpoint that took the sleep message, after the system
      sleep and its ON, waiting for the firmware to answer it. Without it
      those endpoints stay closed. Filled in by the bootloader.

  apple,open-endpoints:
    $ref: /schemas/types.yaml#/definitions/uint32-array
    minItems: 1
    maxItems: 13
    uniqueItems: true
    items:
      minimum: 0x20
      maximum: 0x2c
    description:
      The service endpoints the host opens once the firmware has started, in
      the order it opens them; one not listed is not opened. Without it the
      host opens every service endpoint the firmware has, in endpoint order.
      Filled in by the bootloader.

  apple,sleep-endpoints:
    $ref: /schemas/types.yaml#/definitions/uint32-array
    minItems: 1
    maxItems: 13
    uniqueItems: true
    items:
      minimum: 0x20
      maximum: 0x2c
    description:
      The open service endpoints that get the sleep message before a system
      sleep, in the order they get it; one not listed gets none. Without it
      every open endpoint gets the message, in endpoint order. Filled in by
      the bootloader.

required:
  - compatible
  - reg
  - iommus

allOf:
  - if:
      properties:
        compatible:
          contains:
            const: apple,t8140-aop2
    then:
      required:
        - power-domains
  - if:
      properties:
        compatible:
          contains:
            const: apple,t6050-aop2
      required:
        - mboxes
    then:
      properties:
        reg:
          maxItems: 1
        interrupts: false
      required:
        - reg-names
        - mbox-names
    else:
      properties:
        reg:
          minItems: 3
        reg-names: false
        mboxes: false
        mbox-names: false
      required:
        - interrupts

additionalProperties: false
```
