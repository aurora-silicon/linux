## Documentation/devicetree/bindings/sound/apple,aop-audio.yaml
```yaml
# SPDX-License-Identifier: (GPL-2.0-only OR BSD-2-Clause)
%YAML 1.2
---
$id: http://devicetree.org/schemas/sound/apple,aop-audio.yaml#
$schema: http://devicetree.org/meta-schemas/core.yaml#

title: Apple AOP audio service

maintainers:
  - Ryan Murray <81541646+RyanTheTide@users.noreply.github.com>

description: |
  The service is supplied by the parent Always-On Processor. Firmware and
  calibration handoff determine its availability. It has no independent
  application-processor register window or interrupt.

# Match on the first compatible only: T6041 and T8132 also list
# apple,t6030-aop-audio as a fallback and are validated by
# apple,t6041-aop-audio.yaml.
select:
  properties:
    compatible:
      minItems: 1
      maxItems: 2
      items:
        - enum:
            - apple,t6000-aop-audio
            - apple,t6020-aop-audio
            - apple,t6030-aop-audio
            - apple,t6031-aop-audio
            - apple,t8103-aop-audio
            - apple,t8112-aop-audio
            - apple,t8122-aop-audio
      additionalItems: true
  required:
    - compatible

properties:
  compatible:
    oneOf:
      - items:
          - enum:
              - apple,t6000-aop-audio
              - apple,t6020-aop-audio
              - apple,t8103-aop-audio
              - apple,t8112-aop-audio
          - const: apple,aop-audio
      - const: apple,t6030-aop-audio
      - items:
          - enum:
              - apple,t6031-aop-audio
              - apple,t8122-aop-audio
          - const: apple,t6030-aop-audio

  dmas:
    maxItems: 1

  dma-names:
    const: dma

  apple,chassis-name:
    $ref: /schemas/types.yaml#/definitions/string
    description: Board family used to identify the audio configuration.

  apple,machine-kind:
    $ref: /schemas/types.yaml#/definitions/string
    description: Machine family used for the sound card identity.

  apple,no-beamforming:
    type: boolean
    description: Disable microphone array beamforming on boards without it.

required:
  - compatible
  - dmas
  - dma-names

additionalProperties: false
```

## Documentation/devicetree/bindings/spmi/apple,spmi.yaml
```yaml
# SPDX-License-Identifier: (GPL-2.0 OR BSD-2-Clause)
%YAML 1.2
---
$id: http://devicetree.org/schemas/spmi/apple,spmi.yaml#
$schema: http://devicetree.org/meta-schemas/core.yaml#

title: Apple SPMI controller

maintainers:
  - Sasha Finkelstein <k@chaosmail.tech>

description: A SPMI controller present on most Apple SoCs

allOf:
  - $ref: spmi.yaml#
  - if:
      properties:
        compatible:
          contains:
            const: apple,t8142-spmi
    then:
      properties:
        apple,response-vector: false

properties:
  compatible:
    oneOf:
      - const: apple,t8142-spmi
      - items:
          - enum:
              - apple,t6000-spmi
              - apple,t8103-spmi
              - apple,t8112-spmi
          - const: apple,spmi
      - items:
          - const: apple,t6050-spmi
          - const: apple,t8142-spmi
      - items:
          - enum:
              - apple,t6000-spmi
              - apple,t6020-spmi
              - apple,t6030-spmi
              - apple,t6031-spmi
              - apple,t6041-spmi
              - apple,t8012-spmi
              - apple,t8015-spmi
              - apple,t8112-spmi
              - apple,t8122-spmi
              - apple,t8132-spmi
              - apple,t8140-spmi
          - const: apple,t8103-spmi
      - description:
          The gen-4 controller of T8152, with its FIFO registers at 0x200.
        items:
          - const: apple,t8152-spmi
          - const: apple,t8142-spmi

  reg:
    minItems: 1
    items:
      - description: SPMI command interface
      - description: SPMI interrupt interface
      - description: SPMI auxiliary interface

  interrupts:
    maxItems: 1
    description: Optional, operates in polled mode if not present

  interrupt-controller:
    description:
      The controller demultiplexes follower interrupts. Some instances (the
      T8112 AOP controllers) have no interrupt line to the AP. Follower
      interrupts are then described but cannot be delivered, and drivers
      fall back to polling or stay idle.

  "#interrupt-cells":
    const: 2

  apple,response-vector:
    $ref: /schemas/types.yaml#/definitions/uint32
    minimum: 64
    maximum: 256
    multipleOf: 64
    description:
      Controller vector index for the RX FIFO command-response notification on
      gen-1 controllers. Peripheral interrupts occupy vectors 0 through N-1, so
      this also gives the peripheral interrupt count. When omitted, the driver
      uses the compatible's default (192 for T6000, 256 for other gen-1
      controllers). Not applicable to generation 4 controllers
      ("apple,t8142-spmi").

  power-domains:
    maxItems: 1

required:
  - compatible
  - reg

dependentRequired:
  interrupt-controller:
    - "#interrupt-cells"

unevaluatedProperties: false

examples:
  - |
    #include <dt-bindings/spmi/spmi.h>

    spmi@920a1300 {
        compatible = "apple,t6000-spmi", "apple,spmi";
        reg = <0x920a1300 0x100>;
        #address-cells = <2>;
        #size-cells = <0>;

        pmic@f {
            reg = <0xf SPMI_USID>;
            /* PMIC-specific properties */
        };
    };
```

## Documentation/devicetree/bindings/watchdog/apple,wdt.yaml
```yaml
# SPDX-License-Identifier: (GPL-2.0-only OR BSD-2-Clause)
%YAML 1.2
---
$id: http://devicetree.org/schemas/watchdog/apple,wdt.yaml#
$schema: http://devicetree.org/meta-schemas/core.yaml#

title: Apple SoC Watchdog

maintainers:
  - Sven Peter <sven@svenpeter.dev>

allOf:
  - $ref: watchdog.yaml#
  - if:
      properties:
        reg:
          minItems: 2
      required:
        - reg
    then:
      required:
        - reg-names

properties:
  compatible:
    oneOf:
      - items:
          - enum:
              - apple,t6020-wdt
              - apple,t6030-wdt
              - apple,t6031-wdt
              - apple,t6041-wdt
              - apple,t6050-wdt
              - apple,t8122-wdt
              - apple,t8132-wdt
              - apple,t8140-wdt
              - apple,t8142-wdt
              - apple,t8152-wdt
          - const: apple,t8103-wdt
      - items:
          - enum:
              # Do not add additional SoC to this list.
              - apple,s5l8960x-wdt
              - apple,t7000-wdt
              - apple,s8000-wdt
              - apple,t8010-wdt
              - apple,t8015-wdt
              - apple,t8103-wdt
              - apple,t8112-wdt
              - apple,t6000-wdt
          - const: apple,wdt

  reg:
    minItems: 1
    items:
      - description: Watchdog timer registers
      - description: Simple-reconfig routing register

  reg-names:
    minItems: 1
    items:
      - const: wdt
      - const: reconfig

  clocks:
    maxItems: 1

  interrupts:
    maxItems: 1

required:
  - compatible
  - reg
  - clocks
  - interrupts

unevaluatedProperties: false

examples:
  - |
    #include <dt-bindings/interrupt-controller/apple-aic.h>
    #include <dt-bindings/interrupt-controller/irq.h>

    wdt: watchdog@50000000 {
        compatible = "apple,t8103-wdt", "apple,wdt";
        reg = <0x50000000 0x4000>;
        clocks = <&clk>;
        interrupts = <AIC_IRQ 123 IRQ_TYPE_LEVEL_HIGH>;
    };
  - |
    #include <dt-bindings/interrupt-controller/apple-aic.h>
    #include <dt-bindings/interrupt-controller/irq.h>

    watchdog@8836c000 {
        compatible = "apple,t6050-wdt", "apple,t8103-wdt";
        reg = <0x8836c000 0x4000>,
              <0x8833002c 0x4>;
        reg-names = "wdt", "reconfig";
        clocks = <&clk>;
        interrupts = <AIC_IRQ 0 721 IRQ_TYPE_LEVEL_HIGH>;
    };

...
```
