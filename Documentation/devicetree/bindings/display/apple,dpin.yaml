## Documentation/devicetree/bindings/dma/apple,admac.yaml
```yaml
# SPDX-License-Identifier: GPL-2.0-only OR BSD-2-Clause
%YAML 1.2
---
$id: http://devicetree.org/schemas/dma/apple,admac.yaml#

$schema: http://devicetree.org/meta-schemas/core.yaml#

title: Apple Audio DMA Controller (ADMAC)

maintainers:
  - Martin Povišer <povik+lin@cutebit.org>

description: |
  Apple's Audio DMA Controller (ADMAC) is used to fetch and store audio samples
  on SoCs from the "Apple Silicon" family.

  The controller has been seen with up to 32 channels. Even-numbered channels
  are TX-only, odd-numbered are RX-only. Individual channels are coupled to
  fixed device endpoints.

select:
  anyOf:
    -
      properties:
        compatible:
          contains:
            enum:
              - "apple,admac"
              - "apple,dma-range"
              - "apple,t6000-admac"
              - "apple,t6020-admac"
              - "apple,t6030-admac"
              - "apple,t6031-admac"
              - "apple,t6041-admac"
              - "apple,t8103-admac"
              - "apple,t8112-admac"
              - "apple,t8122-admac"
              - "apple,t8132-admac"
              - "apple,t8140-admac"
      required:
        - "compatible"
    -
      properties:
        compatible:
          items:
            -
              const: "apple,t6050-admac"
            -
              const: "apple,admac"
      required:
        - "compatible"

properties:
  compatible: true
  reg: true
  "#dma-cells": true
  dma-channels:
    maximum: 32
  interrupts: true
  iommus: true
  apple,dma-range:
    $ref: /schemas/types.yaml#/definitions/uint64-array
    minItems: 2
    maxItems: 2
    description:
      Host DMA allocation window as a base and nonzero size. T8140 ADMAC
      instances share firmware-owned AOP DART roots and use windows assigned
      to their own streams. If absent, the DART allocation aperture applies.
  nonposted-mmio: true
  power-domains: true
  resets: true
  clocks: true
  status: true

allOf:
  - if:
      anyOf:
        -
          properties:
            compatible:
              items:
                -
                  const: "apple,t6050-admac"
                -
                  const: "apple,admac"
            status:
              const: "disabled"
          required:
            - "compatible"
            - "status"
    then:
      oneOf:
        -
          description: "T6050 native resource description. Firmware ownership, backend support and enables require separate qualification. This variant remains disabled and contains no programming sequences or firmware data."
          properties:
            compatible:
              items:
                -
                  const: "apple,t6050-admac"
                -
                  const: "apple,admac"
            status:
              const: "disabled"
            reg:
              minItems: 2
              maxItems: 2
              description: "Native register apertures in hardware-interface order, including shared auxiliary views."
            interrupts:
              maxItems: 1
            iommus:
              maxItems: 1
            "#dma-cells":
              const: 1
          required:
            - "compatible"
            - "reg"
            - "status"
            - "interrupts"
            - "#dma-cells"
          additionalProperties: false
    else:
      allOf:
        - $ref: dma-controller.yaml#
      properties:
        compatible:
          oneOf:
            - items:
                - const: apple,t6020-admac
                - const: apple,t8103-admac
            - items:
                - enum:
                    # Do not add additional SoC to this list.
                    - apple,t6000-admac
                    - apple,t8103-admac
                    - apple,t8112-admac
                - const: apple,admac
            - items:
                - enum:
                    - apple,t6030-admac
                    - apple,t6031-admac
                - const: apple,t8122-admac
            - const: apple,t8122-admac
            - const: apple,t8140-admac
            - const: apple,t8132-admac
            - items:
                - const: apple,t6041-admac
                - const: apple,t8132-admac

        reg:
          maxItems: 1

        '#dma-cells':
          const: 1
          description:
            Clients specify a single cell with channel number. Logical IDs alternate
            TX and RX, including T8132 controllers with separate register banks.

        dma-channels:
          maximum: 32

        interrupts:
          minItems: 4
          maxItems: 4
          description:
            Interrupts that correspond to the 4 IRQ outputs of the controller. Usually
            only one of the controller outputs will be connected as an usable interrupt
            source. The remaining interrupts will be left without a valid value, e.g.
            in an interrupts-extended list the disconnected positions will contain
            an empty phandle reference <0>.

        iommus:
          minItems: 1
          maxItems: 2

        apple,dma-range:
          $ref: /schemas/types.yaml#/definitions/uint64-array
          minItems: 2
          maxItems: 2
          description:
            Host DMA allocation window as a base and nonzero size. T8140 ADMAC
            instances share firmware-owned AOP DART roots and use windows assigned
            to their own streams. If absent, the DART allocation aperture applies.

        nonposted-mmio: true

        power-domains:
          maxItems: 1

        resets:
          maxItems: 1
      required:
        - compatible
        - reg
        - '#dma-cells'
        - dma-channels
        - interrupts
      additionalProperties: false

examples:
  - |
    #include <dt-bindings/interrupt-controller/apple-aic.h>
    #include <dt-bindings/interrupt-controller/irq.h>

    aic: interrupt-controller {
      interrupt-controller;
      #interrupt-cells = <3>;
    };

    admac: dma-controller@238200000 {
      compatible = "apple,t8103-admac", "apple,admac";
      reg = <0x38200000 0x34000>;
      dma-channels = <24>;
      interrupts-extended = <0>,
                            <&aic AIC_IRQ 626 IRQ_TYPE_LEVEL_HIGH>,
                            <0>,
                            <0>;
      #dma-cells = <1>;
    };
```

## Documentation/devicetree/bindings/dma/apple,m2-pcie-piodma.yaml
```yaml
# SPDX-License-Identifier: (GPL-2.0-only OR BSD-2-Clause)
%YAML 1.2
---
$id: http://devicetree.org/schemas/dma/apple,m2-pcie-piodma.yaml#
$schema: http://devicetree.org/meta-schemas/core.yaml#

title: Apple M2 generation PCIe programmed I/O DMA

maintainers:
  - Ryan Murray <81541646+RyanTheTide@users.noreply.github.com>

description: |
  PCIe programmed I/O DMA resources on M2 generation SoCs. The register apertures
  follow hardware resource order. Firmware configuration and tuning are
  supplied by the bootloader and are not part of this binding. Unqualified
  instances must remain disabled.

select:
  properties:
    compatible:
      contains:
        enum:
          - apple,t6020-pcie-piodma
          - apple,t6021-pcie-piodma
          - apple,t6022-pcie-piodma
  required:
    - compatible

properties:
  compatible:
    items:
      - enum:
          - apple,t6020-pcie-piodma
          - apple,t6021-pcie-piodma
          - apple,t6022-pcie-piodma
      - const: apple,pcie-piodma

  reg:
    maxItems: 3

  interrupts:
    maxItems: 1

  iommus:
    maxItems: 1

required:
  - compatible
  - reg
  - interrupts
  - iommus

additionalProperties: false
```

## Documentation/devicetree/bindings/dma/apple,m2-pciec-piodma.yaml
```yaml
# SPDX-License-Identifier: (GPL-2.0-only OR BSD-2-Clause)
%YAML 1.2
---
$id: http://devicetree.org/schemas/dma/apple,m2-pciec-piodma.yaml#
$schema: http://devicetree.org/meta-schemas/core.yaml#

title: Apple M2 generation tunneled PCIe programmed I/O DMA

maintainers:
  - Ryan Murray <81541646+RyanTheTide@users.noreply.github.com>

description: |
  Tunneled PCIe programmed I/O DMA resources on M2 generation SoCs. The register apertures
  follow hardware resource order. Firmware configuration and tuning are
  supplied by the bootloader and are not part of this binding. Unqualified
  instances must remain disabled.

select:
  properties:
    compatible:
      contains:
        enum:
          - apple,t6020-pciec-piodma
          - apple,t6021-pciec-piodma
          - apple,t6022-pciec-piodma
          - apple,t8112-pciec-piodma
  required:
    - compatible

properties:
  compatible:
    items:
      - enum:
          - apple,t6020-pciec-piodma
          - apple,t6021-pciec-piodma
          - apple,t6022-pciec-piodma
          - apple,t8112-pciec-piodma
      - const: apple,pciec-piodma

  reg:
    maxItems: 4

  interrupts:
    maxItems: 1

  iommus:
    maxItems: 1

required:
  - compatible
  - reg
  - interrupts
  - iommus

additionalProperties: false
```

## Documentation/devicetree/bindings/dma/apple,m3-pcie-piodma.yaml
```yaml
# SPDX-License-Identifier: (GPL-2.0-only OR BSD-2-Clause)
%YAML 1.2
---
$id: http://devicetree.org/schemas/dma/apple,m3-pcie-piodma.yaml#
$schema: http://devicetree.org/meta-schemas/core.yaml#

title: Apple M3 family PCIe programmed I/O DMA engine

maintainers:
  - Ryan Murray <81541646+RyanTheTide@users.noreply.github.com>

description: |
  Hardware resources of the M3 family PCIe programmed I/O DMA engine.
  The interface is described for discovery and must remain disabled until
  its ownership, initialization and shutdown are supported. Register windows
  are listed in hardware resource order; firmware configuration and tuning
  data are supplied by the boot firmware rather than this binding.

select:
  properties:
    compatible:
      contains:
        enum:
          - apple,t8122-pcie-piodma
          - apple,t6030-pcie-piodma
          - apple,t6031-pcie-piodma
  required:
    - compatible

properties:
  compatible:
    items:
      - enum:
          - apple,t8122-pcie-piodma
          - apple,t6030-pcie-piodma
          - apple,t6031-pcie-piodma
      - const: apple,pcie-piodma

  reg:
    minItems: 3
    maxItems: 4

  interrupts:
    minItems: 1
    maxItems: 1

required:
  - compatible
  - reg
  - interrupts

additionalProperties: false
```

## Documentation/devicetree/bindings/dma/apple,pcie-piodma.yaml
```yaml
# SPDX-License-Identifier: (GPL-2.0-only OR BSD-2-Clause)
%YAML 1.2
---
$id: http://devicetree.org/schemas/dma/apple,pcie-piodma.yaml#
$schema: http://devicetree.org/meta-schemas/core.yaml#

title: Apple PCIe PIODMA engine

maintainers:
  - Ryan Murray <81541646+RyanTheTide@users.noreply.github.com>

description: |
  PCIe auxiliary DMA register banks and completion interrupt. The stream
  is distinct from the PCIe endpoint streams in the same DART.

select:
  properties:
    compatible:
      contains:
        enum:
          - apple,t6020-pcie-piodma
          - apple,t6021-pcie-piodma
          - apple,t6022-pcie-piodma
          - apple,t6030-pcie-piodma
          - apple,t6031-pcie-piodma
          - apple,t6032-pcie-piodma
          - apple,t6041-pcie-piodma
          - apple,t8112-pcie-piodma
          - apple,t8122-pcie-piodma
          - apple,t8132-pcie-piodma
          - apple,t8142-pcie-piodma
          - apple,t6050-pcie-piodma
          - apple,t8152-pcie-piodma
  required:
    - compatible

properties:
  compatible: true

allOf:
  - if:
      properties:
        compatible:
          contains:
            enum:
              - apple,t8132-pcie-piodma
      required:
        - compatible
    then:
      properties:
        compatible:
          items:
            - enum:
                - apple,t8132-pcie-piodma
            - const: apple,pcie-piodma

        reg:
          minItems: 3
          maxItems: 3

        interrupts:
          maxItems: 1

        iommus:
          maxItems: 1

      required:
        - compatible
        - reg
        - interrupts
        - iommus
    else:
      allOf:
        - if:
            properties:
              compatible:
                contains:
                  enum:
                    - apple,t6032-pcie-piodma
            required:
              - compatible
          then:
            properties:
              compatible:
                items:
                  - const: apple,t6032-pcie-piodma
                  - const: apple,pcie-piodma

              reg:
                minItems: 3
                maxItems: 3

              interrupts:
                maxItems: 1

              iommus:
                maxItems: 1

            required:
              - compatible
              - reg
              - interrupts
          else:
            properties:
              compatible:
                items:
                  - enum:
                      - apple,t6020-pcie-piodma
                      - apple,t6021-pcie-piodma
                      - apple,t6022-pcie-piodma
                      - apple,t6030-pcie-piodma
                      - apple,t6031-pcie-piodma
                      - apple,t6041-pcie-piodma
                      - apple,t8112-pcie-piodma
                      - apple,t8122-pcie-piodma
                      - apple,t8142-pcie-piodma
                      - apple,t6050-pcie-piodma
                      - apple,t8152-pcie-piodma
                  - const: apple,pcie-piodma

              reg:
                minItems: 3
                maxItems: 3
                description: Register apertures in hardware-description order.

              interrupts:
                maxItems: 1

              iommus:
                maxItems: 1

            required:
              - compatible
              - reg
              - interrupts
              - iommus

            additionalProperties: false

unevaluatedProperties: false
```
