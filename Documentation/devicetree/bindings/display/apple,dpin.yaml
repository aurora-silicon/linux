## Documentation/devicetree/bindings/dma/apple,pciec-piodma.yaml
```yaml
# SPDX-License-Identifier: (GPL-2.0-only OR BSD-2-Clause)
%YAML 1.2
---
$id: http://devicetree.org/schemas/dma/apple,pciec-piodma.yaml#
$schema: http://devicetree.org/meta-schemas/core.yaml#

title: Apple PCIe tunnel PIODMA engine

maintainers:
  - Ryan Murray <81541646+RyanTheTide@users.noreply.github.com>

description: |
  PCIe tunnel auxiliary DMA register banks and completion interrupt. Its
  stream is distinct from the tunnel endpoint streams in the same DART.

select:
  properties:
    compatible:
      contains:
        enum:
          - apple,t6000-pciec-piodma
          - apple,t6020-pciec-piodma
          - apple,t6021-pciec-piodma
          - apple,t6022-pciec-piodma
          - apple,t6030-pciec-piodma
          - apple,t6031-pciec-piodma
          - apple,t6032-pciec-piodma
          - apple,t6041-pciec-piodma
          - apple,t8103-pciec-piodma
          - apple,t8112-pciec-piodma
          - apple,t8122-pciec-piodma
          - apple,t8132-pciec-piodma
          - apple,t8142-pciec-piodma
          - apple,t6050-pciec-piodma
          - apple,t8152-pciec-piodma
  required:
    - compatible

properties:
  compatible: true

allOf:
  - if:
      properties:
        compatible:
          contains:
            enum:
              - apple,t8132-pciec-piodma
      required:
        - compatible
    then:
      properties:
        compatible:
          items:
            - enum:
                - apple,t8132-pciec-piodma
            - const: apple,pciec-piodma

        reg:
          minItems: 4
          maxItems: 4

        interrupts:
          maxItems: 1

        iommus:
          maxItems: 1

      required:
        - compatible
        - reg
        - interrupts
        - iommus
    else:
      allOf:
        - if:
            properties:
              compatible:
                contains:
                  enum:
                    - apple,t6032-pciec-piodma
            required:
              - compatible
          then:
            properties:
              compatible:
                items:
                  - const: apple,t6032-pciec-piodma
                  - const: apple,pciec-piodma

              reg:
                minItems: 4
                maxItems: 4

              interrupts:
                maxItems: 1

              iommus:
                maxItems: 1

            required:
              - compatible
              - reg
              - interrupts
          else:
            properties:
              compatible:
                items:
                  - enum:
                      - apple,t6000-pciec-piodma
                      - apple,t6020-pciec-piodma
                      - apple,t6021-pciec-piodma
                      - apple,t6022-pciec-piodma
                      - apple,t6030-pciec-piodma
                      - apple,t6031-pciec-piodma
                      - apple,t6041-pciec-piodma
                      - apple,t8103-pciec-piodma
                      - apple,t8112-pciec-piodma
                      - apple,t8122-pciec-piodma
                      - apple,t8142-pciec-piodma
                      - apple,t6050-pciec-piodma
                      - apple,t8152-pciec-piodma
                  - const: apple,pciec-piodma

              reg:
                minItems: 4
                maxItems: 4
                description: Register apertures in hardware-description order.

              interrupts:
                maxItems: 1

              iommus:
                maxItems: 1

            required:
              - compatible
              - reg
              - interrupts
              - iommus

            additionalProperties: false

unevaluatedProperties: false
```

## Documentation/devicetree/bindings/dma/apple,t6032-pcie-piodma.yaml
```yaml
# SPDX-License-Identifier: (GPL-2.0-only OR BSD-2-Clause)
%YAML 1.2
---
$id: http://devicetree.org/schemas/dma/apple,t6032-pcie-piodma.yaml#
$schema: http://devicetree.org/meta-schemas/core.yaml#

title: Apple T6032 PCIe programmed I/O DMA engine

maintainers:
  - Ryan Murray <81541646+RyanTheTide@users.noreply.github.com>

description: |
  Hardware resources of the T6032 PCIe programmed I/O DMA engine. The package contains two
  peripheral dies. Register banks follow hardware resource order. The block
  remains disabled until its ownership and lifecycle are supported; firmware
  data and tuning are supplied separately by the boot firmware.

select:
  properties:
    compatible:
      contains:
        const: apple,t6032-pcie-piodma
  required:
    - compatible

properties:
  compatible:
    items:
      - const: apple,t6032-pcie-piodma
      - const: apple,pcie-piodma

  reg:
    minItems: 3
    maxItems: 4

  interrupts:
    minItems: 1
    maxItems: 1

  iommus:
    minItems: 1
    maxItems: 1

required:
  - compatible
  - reg
  - interrupts

additionalProperties: false
```

## Documentation/devicetree/bindings/dma/apple,t8140-pcie-bootstrap.yaml
```yaml
# SPDX-License-Identifier: (GPL-2.0-only OR BSD-2-Clause)
%YAML 1.2
---
$id: http://devicetree.org/schemas/dma/apple,t8140-pcie-bootstrap.yaml#
$schema: http://devicetree.org/meta-schemas/core.yaml#

title: Apple T8140 PCIe bootstrap engine

maintainers:
  - Ace <Acelogic@users.noreply.github.com>

description: |
  This engine performs a single retained config read before native downstream
  ECAM access is enabled for the T8140 radio PCIe host. It does not expose
  generic DMA channels or establish an engine reset or memory reuse contract.
  The host selects this engine with apple,piodma; apple,pcie-host must point
  back to that host. The legacy compatible is supported for existing Stage 2
  device trees.

properties:
  compatible:
    oneOf:
      - const: apple,t8140-pcie-bootstrap
      - const: apple,t8140-piodma-diagnostic
        deprecated: true
      - items:
          - const: apple,t8140-pcie-bootstrap
          - const: apple,t8140-piodma-diagnostic

  reg:
    items:
      - description: Request engine
      - description: Interrupt aggregator
      - description: PCIe fabric interface

  reg-names:
    items:
      - const: engine
      - const: irq-aggregator
      - const: fabric

  interrupts:
    maxItems: 1

  power-domains:
    maxItems: 1

  iommus:
    maxItems: 1

  apple,pcie-host:
    $ref: /schemas/types.yaml#/definitions/phandle
    description: PCIe host controller whose ECAM access this engine primes.

required:
  - compatible
  - reg
  - reg-names
  - interrupts
  - power-domains
  - iommus
  - apple,pcie-host

additionalProperties: false
```

## Documentation/devicetree/bindings/dma/apple,t8140-piodma-diagnostic.yaml
```yaml
# SPDX-License-Identifier: (GPL-2.0-only OR BSD-2-Clause)
%YAML 1.2
---
$id: http://devicetree.org/schemas/dma/apple,t8140-piodma-diagnostic.yaml#
$schema: http://devicetree.org/meta-schemas/core.yaml#

title: Apple T8140 experimental PCIe PIODMA bootstrap engine

maintainers:
  - Ace <Acelogic@users.noreply.github.com>

description: |
  The J700 diagnostic driver uses this engine for a single retained request
  before enabling native downstream ECAM access. It does not expose generic
  DMA channels. This experimental binding describes that bounded bootstrap;
  it does not establish an engine reset, removal or memory reuse contract.

properties:
  compatible:
    const: apple,t8140-piodma-diagnostic

  reg:
    items:
      - description: Request engine
      - description: Interrupt aggregator
      - description: PCIe fabric interface

  reg-names:
    items:
      - const: engine
      - const: irq-aggregator
      - const: fabric

  interrupts:
    maxItems: 1

  power-domains:
    maxItems: 1

  iommus:
    maxItems: 1

  apple,pcie-host:
    $ref: /schemas/types.yaml#/definitions/phandle
    description: PCIe host controller whose ECAM access this engine primes.

required:
  - compatible
  - reg
  - reg-names
  - interrupts
  - power-domains
  - iommus
  - apple,pcie-host

additionalProperties: false
```
