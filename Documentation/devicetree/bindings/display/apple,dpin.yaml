## Documentation/devicetree/bindings/display/apple,dpin.yaml
```yaml
# SPDX-License-Identifier: (GPL-2.0-only OR BSD-2-Clause)
%YAML 1.2
---
$id: http://devicetree.org/schemas/display/apple,dpin.yaml#
$schema: http://devicetree.org/meta-schemas/core.yaml#

title: Apple DisplayPort tunnel ingress

maintainers:
  - Ryan Murray <81541646+RyanTheTide@users.noreply.github.com>

description: |
  DisplayPort ingress registers and interrupt for a USB4 display tunnel.

select:
  properties:
    compatible:
      contains:
        enum:
          - apple,t6000-dpin
          - apple,t6020-dpin
          - apple,t6021-dpin
          - apple,t6022-dpin
          - apple,t6030-dpin
          - apple,t6031-dpin
          - apple,t6032-dpin
          - apple,t6041-dpin
          - apple,t6050-dpin
          - apple,t8103-dpin
          - apple,t8112-dpin
          - apple,t8122-dpin
          - apple,t8132-dpin
  required:
    - compatible

properties:
  compatible: true

allOf:
  - if:
      properties:
        compatible:
          contains:
            enum:
              - apple,t8132-dpin
      required:
        - compatible
    then:
      properties:
        compatible:
          items:
            - enum:
                - apple,t8132-dpin
            - const: apple,dpin

        reg:
          maxItems: 1

        interrupts:
          maxItems: 1

      required:
        - compatible
        - reg
        - interrupts
    else:
      allOf:
        - if:
            properties:
              compatible:
                contains:
                  enum:
                    - apple,t6032-dpin
            required:
              - compatible
          then:
            properties:
              compatible:
                items:
                  - const: apple,t6032-dpin
                  - const: apple,dpin

              reg:
                maxItems: 1

              interrupts:
                maxItems: 1

            required:
              - compatible
              - reg
              - interrupts
          else:
            properties:
              compatible:
                items:
                  - enum:
                      - apple,t6000-dpin
                      - apple,t6020-dpin
                      - apple,t6021-dpin
                      - apple,t6022-dpin
                      - apple,t6030-dpin
                      - apple,t6031-dpin
                      - apple,t6041-dpin
                      - apple,t6050-dpin
                      - apple,t8103-dpin
                      - apple,t8112-dpin
                      - apple,t8122-dpin
                  - const: apple,dpin

              reg:
                maxItems: 1
                description: Register apertures in hardware-description order.

              interrupts:
                maxItems: 1

            required:
              - compatible
              - reg
              - interrupts

            additionalProperties: false

unevaluatedProperties: false
```

## Documentation/devicetree/bindings/display/apple,dptx-aux.yaml
```yaml
# SPDX-License-Identifier: (GPL-2.0-only OR BSD-2-Clause)
%YAML 1.2
---
$id: http://devicetree.org/schemas/display/apple,dptx-aux.yaml#
$schema: http://devicetree.org/meta-schemas/core.yaml#

title: Apple DisplayPort AUX channel

maintainers:
  - Ryan Murray <81541646+RyanTheTide@users.noreply.github.com>

description: |
  A T6050 block described from the ADT so that the device tree lists all of
  the SoC's hardware. No driver uses it yet: the node stays disabled until
  one does and the block is brought up on hardware.

properties:
  compatible:
    items:
      - const: apple,t6050-dptx-aux
      - const: apple,dptx-aux

  reg:
    minItems: 2
    maxItems: 2
    description: Register windows in the ADT's order, including views shared with other blocks.

  power-domains:
    maxItems: 1

required:
  - compatible
  - reg
  - power-domains

additionalProperties: false
```

## Documentation/devicetree/bindings/display/apple,m2-display-coprocessor.yaml
```yaml
# SPDX-License-Identifier: (GPL-2.0-only OR BSD-2-Clause)
%YAML 1.2
---
$id: http://devicetree.org/schemas/display/apple,m2-display-coprocessor.yaml#
$schema: http://devicetree.org/meta-schemas/core.yaml#

title: Apple M2 generation display coprocessor

maintainers:
  - Ryan Murray <81541646+RyanTheTide@users.noreply.github.com>

description: |
  Display coprocessor resources on M2 generation SoCs. The register apertures
  follow hardware resource order. Firmware configuration and tuning are
  supplied by the bootloader and are not part of this binding. Unqualified
  instances must remain disabled.

select:
  properties:
    compatible:
      contains:
        enum:
          - apple,t6021-display-coprocessor
          - apple,t6022-display-coprocessor
  required:
    - compatible

properties:
  compatible:
    items:
      - enum:
          - apple,t6021-display-coprocessor
          - apple,t6022-display-coprocessor
      - const: apple,display-coprocessor

  reg:
    maxItems: 2

  interrupts:
    maxItems: 4

  iommus:
    maxItems: 1

  power-domains:
    maxItems: 1

required:
  - compatible
  - reg
  - interrupts
  - iommus
  - power-domains

additionalProperties: false
```

## Documentation/devicetree/bindings/display/apple,m2-display-engine.yaml
```yaml
# SPDX-License-Identifier: (GPL-2.0-only OR BSD-2-Clause)
%YAML 1.2
---
$id: http://devicetree.org/schemas/display/apple,m2-display-engine.yaml#
$schema: http://devicetree.org/meta-schemas/core.yaml#

title: Apple M2 generation display engine

maintainers:
  - Ryan Murray <81541646+RyanTheTide@users.noreply.github.com>

description: |
  Display engine resources on M2 generation SoCs. The register apertures
  follow hardware resource order. Firmware configuration and tuning are
  supplied by the bootloader and are not part of this binding. Unqualified
  instances must remain disabled.

select:
  properties:
    compatible:
      contains:
        enum:
          - apple,t6021-display-engine
          - apple,t6022-display-engine
  required:
    - compatible

properties:
  compatible:
    items:
      - enum:
          - apple,t6021-display-engine
          - apple,t6022-display-engine
      - const: apple,display-engine

  reg:
    maxItems: 5

  interrupts:
    maxItems: 12

  iommus:
    maxItems: 4

required:
  - compatible
  - reg
  - interrupts
  - iommus

additionalProperties: false
```

## Documentation/devicetree/bindings/display/apple,m2-dpin.yaml
```yaml
# SPDX-License-Identifier: (GPL-2.0-only OR BSD-2-Clause)
%YAML 1.2
---
$id: http://devicetree.org/schemas/display/apple,m2-dpin.yaml#
$schema: http://devicetree.org/meta-schemas/core.yaml#

title: Apple M2 generation DisplayPort input

maintainers:
  - Ryan Murray <81541646+RyanTheTide@users.noreply.github.com>

description: |
  DisplayPort input resources on M2 generation SoCs. The register apertures
  follow hardware resource order. Firmware configuration and tuning are
  supplied by the bootloader and are not part of this binding. Unqualified
  instances must remain disabled.

select:
  properties:
    compatible:
      contains:
        enum:
          - apple,t6020-dpin
          - apple,t6021-dpin
          - apple,t6022-dpin
          - apple,t8112-dpin
  required:
    - compatible

properties:
  compatible:
    items:
      - enum:
          - apple,t6020-dpin
          - apple,t6021-dpin
          - apple,t6022-dpin
          - apple,t8112-dpin
      - const: apple,dpin

  reg:
    maxItems: 1

  interrupts:
    maxItems: 1

required:
  - compatible
  - reg
  - interrupts

additionalProperties: false
```

## Documentation/devicetree/bindings/display/apple,m3-dp-in.yaml
```yaml
# SPDX-License-Identifier: (GPL-2.0-only OR BSD-2-Clause)
%YAML 1.2
---
$id: http://devicetree.org/schemas/display/apple,m3-dp-in.yaml#
$schema: http://devicetree.org/meta-schemas/core.yaml#

title: Apple M3 family DisplayPort input adapter

maintainers:
  - Ryan Murray <81541646+RyanTheTide@users.noreply.github.com>

description: |
  Hardware resources of the M3 family DisplayPort input adapter.
  The interface is described for discovery and must remain disabled until
  its ownership, initialization and shutdown are supported. Register windows
  are listed in hardware resource order; firmware configuration and tuning
  data are supplied by the boot firmware rather than this binding.

select:
  properties:
    compatible:
      contains:
        enum:
          - apple,t8122-dp-in
          - apple,t6030-dp-in
          - apple,t6031-dp-in
  required:
    - compatible

properties:
  compatible:
    items:
      - enum:
          - apple,t8122-dp-in
          - apple,t6030-dp-in
          - apple,t6031-dp-in
      - const: apple,dp-in

  reg:
    minItems: 1
    maxItems: 1

  interrupts:
    minItems: 1
    maxItems: 1

required:
  - compatible
  - reg
  - interrupts

additionalProperties: false
```

## Documentation/devicetree/bindings/display/apple,sac-controller.yaml
```yaml
# SPDX-License-Identifier: (GPL-2.0-only OR BSD-2-Clause)
%YAML 1.2
---
$id: http://devicetree.org/schemas/display/apple,sac-controller.yaml#
$schema: http://devicetree.org/meta-schemas/core.yaml#

title: Apple display SAC controller

maintainers:
  - Ryan Murray <81541646+RyanTheTide@users.noreply.github.com>

description: |
  Display SAC firmware controller associated with the SAC manager.

properties:
  compatible:
    oneOf:
      - items:
          - const: apple,t6041-sac-controller
          - const: apple,sac-controller
      - items:
          - const: apple,t8140-sac-controller
          - const: apple,sac-controller

  apple,manager:
    $ref: /schemas/types.yaml#/definitions/phandle
    description: Firmware SAC manager.

required:
  - compatible
  - apple,manager

additionalProperties: false
```

## Documentation/devicetree/bindings/display/apple,secure-display-pipe.yaml
```yaml
# SPDX-License-Identifier: (GPL-2.0-only OR BSD-2-Clause)
%YAML 1.2
---
$id: http://devicetree.org/schemas/display/apple,secure-display-pipe.yaml#
$schema: http://devicetree.org/meta-schemas/core.yaml#

title: Apple secure display pipeline

maintainers:
  - Ryan Murray <81541646+RyanTheTide@users.noreply.github.com>

description: |
  Secure display pipeline firmware endpoint, its interrupts and DART
  streams. Firmware retains control of the display registers.

properties:
  compatible:
    oneOf:
      - items:
          - const: apple,t8140-secure-display-pipe
          - const: apple,secure-display-pipe

  interrupts:
    minItems: 4
    maxItems: 4

  iommus:
    minItems: 2
    maxItems: 2

required:
  - compatible
  - interrupts
  - iommus

additionalProperties: false
```

## Documentation/devicetree/bindings/display/apple,t6032-dpin.yaml
```yaml
# SPDX-License-Identifier: (GPL-2.0-only OR BSD-2-Clause)
%YAML 1.2
---
$id: http://devicetree.org/schemas/display/apple,t6032-dpin.yaml#
$schema: http://devicetree.org/meta-schemas/core.yaml#

title: Apple T6032 DisplayPort input adapter

maintainers:
  - Ryan Murray <81541646+RyanTheTide@users.noreply.github.com>

description: |
  Hardware resources of the T6032 DisplayPort input adapter. The package contains two
  peripheral dies. Register banks follow hardware resource order. The block
  remains disabled until its ownership and lifecycle are supported; firmware
  data and tuning are supplied separately by the boot firmware.

select:
  properties:
    compatible:
      contains:
        const: apple,t6032-dpin
  required:
    - compatible

properties:
  compatible:
    items:
      - const: apple,t6032-dpin
      - const: apple,dpin

  reg:
    minItems: 1
    maxItems: 1

  interrupts:
    minItems: 1
    maxItems: 1

required:
  - compatible
  - reg
  - interrupts

additionalProperties: false
```

## Documentation/devicetree/bindings/display/apple,t6041-display-power.yaml
```yaml
# SPDX-License-Identifier: (GPL-2.0-only OR BSD-2-Clause)
%YAML 1.2
---
$id: http://devicetree.org/schemas/display/apple,t6041-display-power.yaml#
$schema: http://devicetree.org/meta-schemas/core.yaml#

title: Apple T6040 display power words

maintainers:
  - František Balázsy <frantisekbalazsy@gmail.com>

description: |
  The words a T6040 (M4 Pro) display coprocessor's driver writes to lower
  its power domains after it stops the firmware for a suspend-to-RAM and to
  raise them again on the wake. A display coprocessor names this node in its
  apple,display-power property. The words belong to the power manager and
  the display block, so no driver binds it.

  The internal display coprocessor has its power-state words in the SoC's
  east power manager block, the external ones in the west block, each at its
  own offsets; the display PMC word that counts the powered coprocessors is
  shared by all three. The boot loader publishes one node for the internal
  coprocessor and one that both external coprocessors name.

properties:
  compatible:
    const: apple,t6041-display-power

  reg:
    items:
      - description: a register window, named by reg-names
      - description: a register window, named by reg-names

  reg-names:
    description:
      pmc-dcp is the display PMC word that counts the powered coprocessors,
      ps the power manager block that holds the coprocessors' power-state
      words. The two may come in either order.
    oneOf:
      - items:
          - const: pmc-dcp
          - const: ps
      - items:
          - const: ps
          - const: pmc-dcp

required:
  - compatible
  - reg
  - reg-names

additionalProperties: false

examples:
  - |
    soc {
        #address-cells = <2>;
        #size-cells = <2>;

        display-power@5048a9c14 {
            compatible = "apple,t6041-display-power";
            reg = <0x5 0x048a9c14 0x0 0x8>,
                  <0x5 0x02280000 0x0 0x14000>;
            reg-names = "pmc-dcp", "ps";
        };

        display-power@502800000 {
            compatible = "apple,t6041-display-power";
            reg = <0x5 0x02800000 0x0 0x14000>,
                  <0x5 0x048a9c14 0x0 0x8>;
            reg-names = "ps", "pmc-dcp";
        };
    };
```

## Documentation/devicetree/bindings/display/apple,t8132-dcp-expert.yaml
```yaml
# SPDX-License-Identifier: (GPL-2.0-only OR BSD-2-Clause)
%YAML 1.2
---
$id: http://devicetree.org/schemas/display/apple,t8132-dcp-expert.yaml#
$schema: http://devicetree.org/meta-schemas/core.yaml#

title: Apple M4 base SoC display power sideband

maintainers:
  - Ryan Murray <81541646+RyanTheTide@users.noreply.github.com>

description: |
  Hardware resources of the M4 base SoC display power sideband.
  The interface is described for discovery and must remain disabled until
  its ownership, initialization and shutdown are supported. Register windows
  are listed in hardware resource order; firmware configuration and tuning
  data are supplied by the boot firmware rather than this binding.

select:
  properties:
    compatible:
      contains:
        enum:
          - apple,t8132-dcp-expert
  required:
    - compatible

properties:
  compatible:
    items:
      - enum:
          - apple,t8132-dcp-expert
      - const: apple,dcp-expert

  reg:
    minItems: 2
    maxItems: 2

required:
  - compatible
  - reg

additionalProperties: false
```
