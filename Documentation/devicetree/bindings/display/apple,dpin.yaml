## Documentation/devicetree/bindings/display/apple,t8140-display-power.yaml
```yaml
# SPDX-License-Identifier: (GPL-2.0-only OR BSD-2-Clause)
%YAML 1.2
---
$id: http://devicetree.org/schemas/display/apple,t8140-display-power.yaml#
$schema: http://devicetree.org/meta-schemas/core.yaml#

title: Apple T8140 display power words

maintainers:
  - Diljit Singh <hey@djdev.me>

description:
  The words a display coprocessor's driver writes to power its domains off
  and on around a restart of its firmware, as macOS does. A display
  coprocessor names this node in its apple,display-power property. The words
  belong to the power manager and the display block, so no driver binds it.

properties:
  compatible:
    const: apple,t8140-display-power

  reg:
    items:
      - description: the display PMC word that counts the powered coprocessors
      - description: the power manager's power state words
      - description: the power manager's power gate words

  reg-names:
    items:
      - const: pmc-dcp
      - const: ps
      - const: pwrgate

required:
  - compatible
  - reg
  - reg-names

additionalProperties: false

examples:
  - |
    soc {
        #address-cells = <2>;
        #size-cells = <2>;

        display-power@3028a9c14 {
            compatible = "apple,t8140-display-power";
            reg = <0x3 0x028a9c14 0x0 0x4>,
                  <0x3 0x00700000 0x0 0x14000>,
                  <0x3 0x00724000 0x0 0x1000>;
            reg-names = "pmc-dcp", "ps", "pwrgate";
        };
    };
```

## Documentation/devicetree/bindings/display/apple,t8152-dcp-iboot.yaml
```yaml
# SPDX-License-Identifier: (GPL-2.0-only OR BSD-2-Clause)
%YAML 1.2
---
$id: http://devicetree.org/schemas/display/apple,t8152-dcp-iboot.yaml#
$schema: http://devicetree.org/meta-schemas/core.yaml#

title: Apple T8152 DCP on the iBoot display interface

maintainers:
  - Thomas Glanzmann <thomas@glanzmann.de>

description: |
  The Display Coprocessor (DCP) of the Apple T8152 SoC runs RTKit firmware
  that offers a small iBoot display interface (disp0-service) next to the
  full IOMobileFramebuffer protocol. This binding describes the DCP driven
  through that interface, together with the DisplayPort PHY its DPTX port
  is routed to. The DCP fetches through its own DART, the display pipe
  scans out through another one, which sees each scanout buffer at the same
  address.

properties:
  compatible:
    const: apple,t8152-dcp-iboot

  reg:
    minItems: 2
    maxItems: 7

  reg-names:
    oneOf:
      - items:
          - const: coproc
          - const: atc
          - const: dp-clock
          - const: atc-ps
          - const: atc-psd
          - const: aux
          - const: aux-ps
        minItems: 5
        description:
          DCP coprocessor, ATC DisplayPort PHY (USB-C), the PMGR clock
          control of its DisplayPort link, the PMGR power states the PHY
          depends on, and optionally the AP DisplayPort AUX controller that
          reads the sink's EDID with its PMGR power state
      - items:
          - const: coproc
          - const: phy-core
          - const: phy-apb
          - const: aux
          - const: aux-ps
          - const: phy-ps
          - const: coproc-ps
        description:
          DCP coprocessor, the HDMI dptx-phy blocks, the AP
          DisplayPort AUX controller that reads the sink's EDID with its
          PMGR power state, and the read-only PMGR power states for the
          HDMI PHY and DCPEXT CPU. The driver only adopts the bootloader's
          powered link and must check these states before accessing the PHY.
      - items:
          - const: coproc
          - const: dp-clock
          - const: aux
          - const: aux-ps
        minItems: 2
        description:
          DCP coprocessor, the PMGR clock control of the ATC DisplayPort
          link (shared by the ports), and optionally the AP DisplayPort AUX
          controller with its PMGR power state; the USB-C ports follow as
          usb-c child nodes

  apple,tunable-pre:
    $ref: /schemas/types.yaml#/definitions/uint32-matrix
    items:
      items:
        - description: register offset in the ATC PHY block
        - description: mask
        - description: value
    description:
      ATC PHY tunables (ADT ACIOPHY_CMN and CIOPLL_CORE defaults), applied
      before the lane crossbar setup when the PHY starts from cold.

  apple,tunable-post:
    $ref: /schemas/types.yaml#/definitions/uint32-matrix
    items:
      items:
        - description: register offset in the ATC PHY block
        - description: mask
        - description: value
    description:
      ATC PHY tunables (ADT ATC_FABRIC, DPPLL and AUX defaults), applied
      after the lane crossbar setup.

  apple,hdmi:
    type: boolean
    description:
      The DCP drives the HDMI port through the dedicated dptx-phy and an
      on-board DisplayPort-to-HDMI converter, instead of an ATC USB-C PHY.

  apple,usb-pd:
    $ref: /schemas/types.yaml#/definitions/phandle
    description:
      The USB-C port's PD controller (SPMI), polled for the DisplayPort alt
      mode connection and the plug orientation.

  hpd-gpios:
    maxItems: 1
    description:
      Hot plug detect line of the connector, if the AP can read it (J873g
      HDMI); without it the sink is assumed to stay connected.

  mboxes:
    maxItems: 1

  iommus:
    maxItems: 1
    description: DCP DART stream

  scanout:
    type: object
    additionalProperties: false
    description:
      The display pipe's scanout stream. Its DART is locked with its own
      root, so it is a separate device that sees each scanout buffer at the
      DCP's address.
    properties:
      iommus:
        maxItems: 1
      dma-coherent: true
    required:
      - iommus

  dma-coherent: true

  apple,die:
    $ref: /schemas/types.yaml#/definitions/uint32
    description: Die of the DPTX connection target, 0 if absent.

  "#address-cells":
    const: 2

  "#size-cells":
    const: 2

  ranges: true

patternProperties:
  "^usb-c@[0-9a-f]+$":
    type: object
    additionalProperties: false
    description:
      A USB-C port whose ATC PHY the DCP can drive. The DCP drives one port
      at a time, the one a DisplayPort sink is plugged into.
    properties:
      reg:
        maxItems: 3
      reg-names:
        items:
          - const: atc
          - const: atc-ps
          - const: atc-psd
        description:
          ATC DisplayPort PHY, the PMGR power states it depends on (DP_0,
          DP_1 and USB_AON) and its common power domain (PSD)
      apple,dfp-endpoint:
        $ref: /schemas/types.yaml#/definitions/uint32
        description: The ATC's display-crossbar0 DFP endpoint (ATC instance).
      apple,usb-pd:
        $ref: /schemas/types.yaml#/definitions/phandle
        description: The port's PD controller (SPMI).
      apple,tunable-pre:
        $ref: /schemas/types.yaml#/definitions/uint32-matrix
        description: As the node's apple,tunable-pre, for this port's PHY.
      apple,tunable-post:
        $ref: /schemas/types.yaml#/definitions/uint32-matrix
        description: As the node's apple,tunable-post, for this port's PHY.
    required:
      - reg
      - reg-names
      - apple,dfp-endpoint
      - apple,usb-pd

required:
  - compatible
  - reg
  - reg-names
  - mboxes
  - iommus
  - scanout

additionalProperties: false

examples:
  - |
    soc {
      #address-cells = <2>;
      #size-cells = <2>;

      display@286e00000 {
        compatible = "apple,t8152-dcp-iboot";
        reg = <0x2 0x86e00000 0x0 0x74000>,
              <0x4 0x13000000 0x0 0x84000>,
              <0x3 0x0002005c 0x0 0x4>,
              <0x3 0x082900c0 0x0 0x104>,
              <0x3 0x03a13a00 0x0 0xc0>;
        reg-names = "coproc", "atc", "dp-clock", "atc-ps", "atc-psd";
        mboxes = <&dcp_mbox>;
        iommus = <&dcp_dart 23>;

        scanout {
          iommus = <&disp0_dart 0>;
        };
      };

      display@296e00000 {
        compatible = "apple,t8152-dcp-iboot";
        reg = <0x2 0x96e00000 0x0 0x74000>,
              <0x3 0x0002005c 0x0 0x4>;
        reg-names = "coproc", "dp-clock";
        #address-cells = <2>;
        #size-cells = <2>;
        ranges;
        mboxes = <&dcp_mbox>;
        iommus = <&dcp_dart 23>;

        scanout {
          iommus = <&disp0_dart 0>;
        };

        usb-c@413000000 {
          reg = <0x4 0x13000000 0x0 0x84000>,
                <0x3 0x082900c0 0x0 0x104>,
                <0x3 0x03a13a00 0x0 0xc0>;
          reg-names = "atc", "atc-ps", "atc-psd";
          apple,dfp-endpoint = <3>;
          apple,usb-pd = <&hpm3>;
        };
      };
    };
```

## Documentation/devicetree/bindings/display/bridge/parade,dp855.yaml
```yaml
# SPDX-License-Identifier: (GPL-2.0-only OR BSD-2-Clause)
%YAML 1.2
---
$id: http://devicetree.org/schemas/display/bridge/parade,dp855.yaml#
$schema: http://devicetree.org/meta-schemas/core.yaml#

title: Parade DP855 panel timing controller

maintainers:
  - Ryan Murray <81541646+RyanTheTide@users.noreply.github.com>

description: |
  Panel timing controller controlled through SPI. The controller also
  mediates access to panel management devices through an internal I2C
  engine that it shares with the display firmware under an access lock.
  The SPI chip select is not a downstream device address.

  The optional i2c node exposes that engine as a read-only bus. Only its
  enabled children are reachable, and only by reads. Panel power, source
  driver, write-protect and EEPROM endpoints stay with the display firmware
  and are not described here.

allOf:
  - $ref: /schemas/spi/spi-peripheral-props.yaml#

properties:
  compatible:
    const: parade,dp855

  reg:
    maxItems: 1

  spi-max-frequency: true

  i2c:
    type: object
    $ref: /schemas/i2c/i2c-controller.yaml#
    description: Downstream panel management bus mediated by the timing controller.

    patternProperties:
      '^temperature-sensor@7[0-2]$':
        type: object
        $ref: /schemas/hwmon/ti,tmp103.yaml#
        required:
          - read-only

    unevaluatedProperties: false

required:
  - compatible
  - reg

unevaluatedProperties: false

examples:
  - |
    spi {
        #address-cells = <1>;
        #size-cells = <0>;

        panel-controller@0 {
            compatible = "parade,dp855";
            reg = <0>;
            spi-max-frequency = <1000000>;

            i2c {
                #address-cells = <1>;
                #size-cells = <0>;

                temperature-sensor@70 {
                    compatible = "ti,tmp103";
                    reg = <0x70>;
                    read-only;
                };
            };
        };
    };
```

## Documentation/devicetree/bindings/dma/apple,admac-control.yaml
```yaml
# SPDX-License-Identifier: (GPL-2.0-only OR BSD-2-Clause)
%YAML 1.2
---
$id: http://devicetree.org/schemas/dma/apple,admac-control.yaml#
$schema: http://devicetree.org/meta-schemas/core.yaml#

title: Apple audio DMA control block

maintainers:
  - Ryan Murray <81541646+RyanTheTide@users.noreply.github.com>

description: |
  The LLT escalation detector of a T6050 or T8142 display engine's ADMAC. The ADMAC
  driver sets it up through the ADMAC's apple,admac-control phandle, with
  the ADT's tunables, which the boot loader copies into the node.

properties:
  compatible:
    items:
      - enum:
          - apple,t6050-admac-control
          - apple,t8142-admac-control
      - const: apple,admac-control

  reg:
    minItems: 2
    maxItems: 2
    description: Register windows in the ADT's order, including views shared with other blocks.

  interrupts:
    maxItems: 1

  apple,tunable-ced:
    $ref: /schemas/types.yaml#/definitions/uint32-matrix
    description:
      The ADT's ced-tunables for the first window, as [offset, mask, value]
      entries; supplied by the boot loader.
    items:
      items:
        - description: register offset
        - description: mask of the bits to clear
        - description: bits to set

  apple,tunable-ssw:
    $ref: /schemas/types.yaml#/definitions/uint32-matrix
    description:
      The ADT's ssw-tunables for the second window, as [offset, mask, value]
      entries; supplied by the boot loader.
    items:
      items:
        - description: register offset
        - description: mask of the bits to clear
        - description: bits to set

required:
  - compatible
  - reg
  - interrupts

additionalProperties: false
```

## Documentation/devicetree/bindings/dma/apple,admac-secure.yaml
```yaml
# SPDX-License-Identifier: (GPL-2.0-only OR BSD-2-Clause)
%YAML 1.2
---
$id: http://devicetree.org/schemas/dma/apple,admac-secure.yaml#
$schema: http://devicetree.org/meta-schemas/core.yaml#

title: Apple secure audio DMA controller

maintainers:
  - Ryan Murray <81541646+RyanTheTide@users.noreply.github.com>

description: |
  The secure LEAP audio DMA controller's direct hardware aperture. It is
  distinct from the AP-accessible channel proxy. Its register aperture is
  not safe for the AP to access until firmware transfers ownership. The
  node remains disabled and must not select the ordinary ADMAC driver.
  Linux logical channel IDs alternate TX and RX; the ADT slot count is
  per direction.

allOf:
  - $ref: dma-controller.yaml#
  - if:
      properties:
        compatible:
          contains:
            const: apple,t8140-admac-secure
    then:
      required:
        - dma-channels
        - interrupts
        - iommus
        - power-domains

properties:
  compatible:
    items:
      - enum:
          - apple,t6050-admac-secure
          - apple,t8140-admac-secure
      - const: apple,admac-secure

  reg:
    maxItems: 1

  '#dma-cells':
    const: 1

  dma-channels:
    const: 18

  interrupts:
    maxItems: 1

  iommus:
    maxItems: 1

  power-domains:
    maxItems: 1

required:
  - compatible
  - reg
  - '#dma-cells'

additionalProperties: false
```
