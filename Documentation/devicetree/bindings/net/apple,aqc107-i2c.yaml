## Documentation/devicetree/bindings/phy/apple,atcrt.yaml
```yaml
# SPDX-License-Identifier: (GPL-2.0-only OR BSD-2-Clause)
%YAML 1.2
---
$id: http://devicetree.org/schemas/phy/apple,atcrt.yaml#
$schema: http://devicetree.org/meta-schemas/core.yaml#

title: Apple ATC retimer control interface

maintainers:
  - Ryan Murray <81541646+RyanTheTide@users.noreply.github.com>

description: |
  An addressed retimer control interface on an I2C bus. This does not
  transfer PHY, reset or firmware ownership to the host.

properties:
  compatible:
    items:
      - enum:
          - apple,t8103-atcrt
          - apple,t6000-atcrt
          - apple,t8112-atcrt
          - apple,t6041-atcrt
      - const: apple,atcrt

  reg:
    maxItems: 1

required:
  - compatible
  - reg

additionalProperties: false
```

## Documentation/devicetree/bindings/phy/apple,ausb-phy.yaml
```yaml
# SPDX-License-Identifier: (GPL-2.0-only OR BSD-2-Clause)
%YAML 1.2
---
$id: http://devicetree.org/schemas/phy/apple,ausb-phy.yaml#
$schema: http://devicetree.org/meta-schemas/core.yaml#

title: Apple T6000 AUSB port PHY

maintainers:
  - Ryan Murray <81541646+RyanTheTide@users.noreply.github.com>

description: |
  An AUSB port PHY has its own register aperture and control gate.
  Its shared USB3 PHY is described by the phys reference.

properties:
  compatible:
    items:
      - enum:
          - apple,t6000-ausb-phy
      - const: apple,ausb-phy

  reg:
    maxItems: 1

  power-domains:
    maxItems: 1

  phys:
    maxItems: 1

  '#phy-cells':
    const: 0

required:
  - compatible
  - reg
  - power-domains
  - phys
  - '#phy-cells'

additionalProperties: false
```

## Documentation/devicetree/bindings/phy/apple,ausb-usb3-phy.yaml
```yaml
# SPDX-License-Identifier: (GPL-2.0-only OR BSD-2-Clause)
%YAML 1.2
---
$id: http://devicetree.org/schemas/phy/apple,ausb-usb3-phy.yaml#
$schema: http://devicetree.org/meta-schemas/core.yaml#

title: Apple T6000 shared AUSB USB3 PHY

maintainers:
  - Ryan Murray <81541646+RyanTheTide@users.noreply.github.com>

description: |
  The shared AUSB USB3 PHY exposes control and analogue apertures.
  It supplies the two AUSB port PHYs and has separate USB and always-on gates.

properties:
  compatible:
    items:
      - enum:
          - apple,t6000-ausb-usb3-phy
      - const: apple,ausb-usb3-phy

  reg:
    minItems: 21
    maxItems: 21

  power-domains:
    minItems: 2
    maxItems: 2

  '#phy-cells':
    const: 0

required:
  - compatible
  - reg
  - power-domains
  - '#phy-cells'

additionalProperties: false
```

## Documentation/devicetree/bindings/phy/apple,combo-phy.yaml
```yaml
# SPDX-License-Identifier: GPL-2.0-only
%YAML 1.2
---
$id: http://devicetree.org/schemas/phy/apple,combo-phy.yaml#
$schema: http://devicetree.org/meta-schemas/core.yaml#

title: Apple DisplayPort and Type-C combo PHY

maintainers:
  - Dj <hey@djdev.me>

description: |
  Fixed four-lane DisplayPort PHY for HDMI bridges, or one shared owner of
  Type-C USB2, USB3 and DisplayPort alternate mode. DisplayPort supports RBR
  through HBR3 without spread-spectrum clocking. The combo provider serializes
  controller shutdown, PIPE handoff, orientation and alternate-mode changes.
  Register resources, power domains and board tunables come from the producer.

properties:
  compatible:
    enum:
      - apple,t6050-dp-phy
      - apple,t6050-combo-phy

  reg:
    minItems: 6
    maxItems: 11

  reg-names:
    minItems: 6
    maxItems: 11

  '#phy-cells':
    enum: [0, 1]

  '#reset-cells':
    const: 1

  apple,port-index:
    $ref: /schemas/types.yaml#/definitions/uint32
    enum: [1, 2, 3, 4, 5]
    description: Type-C port; the debug port (0) is excluded

  apple,guest-port-reserved:
    type: boolean
    description: The boot producer has excluded this port from host ownership

  mode-switch: true
  orientation-switch: true

  mboxes:
    maxItems: 1

  port:
    $ref: /schemas/graph.yaml#/properties/port

  apple,tunable-aus40cmn-shm:
    $ref: /schemas/types.yaml#/definitions/uint32-matrix
    description: Offset, mask and value tuples for the common analog bank

  apple,tunable-cio4pll:
    $ref: /schemas/types.yaml#/definitions/uint32-matrix
    description: Offset, mask and value tuples for the CIO PLL bank

  apple,tunable-usb2-default:
    $ref: /schemas/types.yaml#/definitions/uint32-matrix
    description: Offset, mask and value tuples for the USB2 PHY bank

  apple,tunable-usb2-host:
    $ref: /schemas/types.yaml#/definitions/uint32-matrix
    description: Offset, mask and value tuples for the USB2 host bank

  apple,tunable-pipe-default:
    $ref: /schemas/types.yaml#/definitions/uint32-matrix
    description: Offset, mask and value tuples for the PIPE handler

  power-domains:
    description:
      A combo PHY may name the USB controller's domain fourth ("usb"). Its
      USB2 PHY and digital banks are in that domain, and the PHY then holds it
      while it runs, also on a port with no USB controller bound.
    minItems: 3
    maxItems: 4

  power-domain-names:
    minItems: 3
    items:
      - const: usb-aon
      - const: common
      - const: wrapper
      - const: usb

  apple,tunable-axi2af:
    $ref: /schemas/types.yaml#/definitions/uint32-matrix
    description: Offset, mask and value tuples within the named bank

  apple,tunable-fabric:
    $ref: /schemas/types.yaml#/definitions/uint32-matrix
    description: Offset, mask and value tuples within the named bank

  apple,tunable-common-cfg:
    $ref: /schemas/types.yaml#/definitions/uint32-matrix
    description: Offset, mask and value tuples within the named bank

  apple,tunable-lioa:
    $ref: /schemas/types.yaml#/definitions/uint32-matrix
    description: Offset, mask and value tuples within the named bank

  apple,tunable-lane0-rx-clock:
    $ref: /schemas/types.yaml#/definitions/uint32-matrix
    description: Offset, mask and value tuples within the named bank

  apple,tunable-lane1-rx-clock:
    $ref: /schemas/types.yaml#/definitions/uint32-matrix
    description: Offset, mask and value tuples within the named bank

  apple,tunable-lane0-rx-eq:
    $ref: /schemas/types.yaml#/definitions/uint32-matrix
    description: Offset, mask and value tuples within the named bank

  apple,tunable-lane1-rx-eq:
    $ref: /schemas/types.yaml#/definitions/uint32-matrix
    description: Offset, mask and value tuples within the named bank

  apple,tunable-auspll:
    $ref: /schemas/types.yaml#/definitions/uint32-matrix
    description: Offset, mask and value tuples within the named bank

  apple,tunable-uc-regs-cio:
    $ref: /schemas/types.yaml#/definitions/uint32-matrix
    description:
      Offset, mask and value tuples for the PHY firmware's registers in CIO
      (USB4/Thunderbolt) mode. Optional; an absent CIO tunable is skipped.

  apple,tunable-lane0-rx-top-cio:
    $ref: /schemas/types.yaml#/definitions/uint32-matrix
    description: As apple,tunable-uc-regs-cio, for lane 0's receiver top bank

  apple,tunable-lane1-rx-top-cio:
    $ref: /schemas/types.yaml#/definitions/uint32-matrix
    description: As apple,tunable-uc-regs-cio, for lane 1's receiver top bank

  apple,tunable-lane0-rx-eq-cio:
    $ref: /schemas/types.yaml#/definitions/uint32-matrix
    description: As apple,tunable-uc-regs-cio, for lane 0's receiver equalizer

  apple,tunable-lane1-rx-eq-cio:
    $ref: /schemas/types.yaml#/definitions/uint32-matrix
    description: As apple,tunable-uc-regs-cio, for lane 1's receiver equalizer

patternProperties:
  '^apple,dp-training-table(-rbr|-hbr|-hbr2|-hbr3)?$':
    $ref: /schemas/types.yaml#/definitions/uint32-array
    minItems: 16
    maxItems: 16
    description: Drive presets indexed by voltage swing times four plus pre-emphasis

required:
  - compatible
  - reg
  - reg-names
  - '#phy-cells'
  - power-domains
  - power-domain-names

allOf:
  - if:
      properties:
        compatible:
          const: apple,t6050-combo-phy
    then:
      properties:
        '#phy-cells':
          const: 1
        reg:
          minItems: 11
          maxItems: 11
        reg-names:
          items:
            - const: core
            - const: usb2phy
            - const: usb2-digital
            - const: reset
            - const: fabric
            - const: axi2af
            - const: lioa
            - const: common-cfg
            - const: usb-control
            - const: firmware-data
            - const: pipehandler
      required:
        - '#reset-cells'
        - apple,port-index
        - apple,guest-port-reserved
        - mode-switch
        - orientation-switch
        - mboxes
    else:
      properties:
        '#phy-cells':
          const: 0
        power-domains:
          maxItems: 3
        power-domain-names:
          maxItems: 3
      if:
        required:
          - mode-switch
      then:
        properties:
          reg:
            minItems: 8
            maxItems: 8
          reg-names:
            items:
              - const: core
              - const: reset
              - const: fabric
              - const: axi2af
              - const: lioa
              - const: common-cfg
              - const: usb-control
              - const: firmware-data
        required:
          - orientation-switch
          - mboxes
      else:
        properties:
          reg:
            minItems: 6
            maxItems: 6
          reg-names:
            items:
              - const: core
              - const: reset
              - const: fabric
              - const: axi2af
              - const: lioa
              - const: common-cfg

additionalProperties: false
```

## Documentation/devicetree/bindings/phy/apple,dptx-phy.yaml
```yaml
# SPDX-License-Identifier: (GPL-2.0-only OR BSD-2-Clause)
%YAML 1.2
---
$id: http://devicetree.org/schemas/phy/apple,dptx-phy.yaml#
$schema: http://devicetree.org/meta-schemas/core.yaml#

title: Apple DisplayPort transmitter PHY

maintainers:
  - Ryan Murray <81541646+RyanTheTide@users.noreply.github.com>

description: |
  Hardware resources of the Apple Silicon DisplayPort transmitter PHY.
  The interface is described for discovery and must remain disabled until
  its ownership, initialization and shutdown are supported. Register windows
  are listed in hardware resource order; firmware configuration and tuning
  data are supplied by the boot firmware rather than this binding.

select:
  properties:
    compatible:
      contains:
        enum:
          - apple,t6041-dptx-phy
          - apple,t6050-dptx-phy
          - apple,t8122-dptx-phy
  required:
    - compatible

properties:
  compatible:
    oneOf:
      - items:
          - enum:
              - apple,t8122-dptx-phy
          - const: apple,dptx-phy
      - const: apple,t6050-dptx-phy
      - items:
          - const: apple,t6041-dptx-phy
          - const: apple,t6050-dptx-phy

  reg:
    minItems: 2
    maxItems: 2

  reg-names:
    items:
      - const: core
      - const: dptx

  power-domains:
    maxItems: 1

  '#phy-cells':
    const: 0

  '#reset-cells':
    const: 0

  apple,ufp-endpoint:
    $ref: /schemas/types.yaml#/definitions/uint32
    description:
      The display crossbar's upstream-facing endpoint that feeds this PHY.

patternProperties:
  '^apple,(pll-(dcocfg|dtcvreg|dtccal|dcdadj|dlfcfg)|pclkdrv-select)$':
    $ref: /schemas/types.yaml#/definitions/uint32
    description:
      PLL and pixel clock driver settings the PHY is programmed with, as the
      ADT's lpdptx-phy node gives them.

required:
  - compatible
  - reg
  - power-domains
  - '#phy-cells'

additionalProperties: false
```

## Documentation/devicetree/bindings/phy/apple,m3-atcphy.yaml
```yaml
# SPDX-License-Identifier: (GPL-2.0-only OR BSD-2-Clause)
%YAML 1.2
---
$id: http://devicetree.org/schemas/phy/apple,m3-atcphy.yaml#
$schema: http://devicetree.org/meta-schemas/core.yaml#

title: Apple M3 family Type-C PHY

maintainers:
  - Ryan Murray <81541646+RyanTheTide@users.noreply.github.com>

description: |
  The M3 Type-C PHY combines USB and DisplayPort interfaces. The fourth
  PHY on the Pro and Max dies can be described with its common control
  bank only, for DisplayPort operation. The five-bank description also
  exposes the USB interfaces. Calibration is supplied by the bootloader.

allOf:
  - $ref: /schemas/usb/usb-switch.yaml#

properties:
  compatible:
    oneOf:
      - const: apple,t8122-atcphy
      - items:
          - enum:
              - apple,t6030-atcphy
              - apple,t6031-atcphy
          - const: apple,t8122-atcphy

  reg:
    minItems: 1
    items:
      - description: Common PHY controls
      - description: DisplayPort alternate mode PHY
      - description: AXI to fabric interface
      - description: USB2 PHY
      - description: USB3 PIPE interface

  reg-names:
    minItems: 1
    items:
      - const: core
      - const: lpdptx
      - const: axi2af
      - const: usb2phy
      - const: pipehandler

  '#phy-cells':
    const: 1

  '#reset-cells':
    const: 0

  power-domains:
    maxItems: 1

  mode-switch: true
  orientation-switch: true

  ports:
    $ref: /schemas/graph.yaml#/properties/ports

required:
  - compatible
  - reg
  - reg-names
  - '#phy-cells'
  - '#reset-cells'
  - power-domains

oneOf:
  - properties:
      reg:
        maxItems: 1
      reg-names:
        maxItems: 1
  - properties:
      reg:
        minItems: 5
      reg-names:
        minItems: 5

unevaluatedProperties: false
```
