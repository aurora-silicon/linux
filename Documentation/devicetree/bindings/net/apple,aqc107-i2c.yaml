## Documentation/devicetree/bindings/npu/apple,m2-ane-cluster.yaml
```yaml
# SPDX-License-Identifier: (GPL-2.0-only OR BSD-2-Clause)
%YAML 1.2
---
$id: http://devicetree.org/schemas/npu/apple,m2-ane-cluster.yaml#
$schema: http://devicetree.org/meta-schemas/core.yaml#

title: Apple M2 generation neural engine cluster

maintainers:
  - Ryan Murray <81541646+RyanTheTide@users.noreply.github.com>

description: |
  Neural engine cluster resources on M2 generation SoCs. The register apertures
  follow hardware resource order. Firmware configuration and tuning are
  supplied by the bootloader and are not part of this binding. Unqualified
  instances must remain disabled.

select:
  properties:
    compatible:
      contains:
        enum:
          - apple,t6022-ane-cluster
  required:
    - compatible

properties:
  compatible:
    items:
      - enum:
          - apple,t6022-ane-cluster
      - const: apple,ane-cluster

  reg:
    maxItems: 3

  interrupts:
    maxItems: 1

  iommus:
    maxItems: 4

  power-domains:
    maxItems: 2

required:
  - compatible
  - reg
  - interrupts
  - iommus
  - power-domains

additionalProperties: false
```

## Documentation/devicetree/bindings/nvme/apple,nvme-ans.yaml
```yaml
# SPDX-License-Identifier: GPL-2.0 OR BSD-2-Clause
%YAML 1.2
---
$id: http://devicetree.org/schemas/nvme/apple,nvme-ans.yaml#

$schema: http://devicetree.org/meta-schemas/core.yaml#

title: Apple ANS NVM Express host controller

maintainers:
  - Sven Peter <sven@svenpeter.dev>

select:
  anyOf:
    -
      properties:
        compatible:
          contains:
            enum:
              - apple,nvme-ans2
              - apple,t6000-nvme-ans2
              - apple,t6020-nvme-ans2
              - apple,t6030-nvme-ans2
              - apple,t6031-nvme-ans2
              - apple,t6041-nvme-ans2
              - apple,t8015-nvme-ans2
              - apple,t8103-nvme-ans2
              - apple,t8112-nvme-ans2
              - apple,t8122-nvme-ans2
              - apple,t8132-nvme-ans2
              - apple,t8140-nvme-ans2
              - apple,t8142-nvme-ans2
      required:
        - compatible
    -
      properties:
        compatible:
          allOf:
            -
              contains:
                enum:
                  - apple,t8142-nvme-ans2
                  - apple,t8152-nvme-ans2
            -
              contains:
                const: apple,nvme-ans
      required:
        - compatible
properties:
  compatible: true

  reg: true

  reg-names: true

  resets: true

  power-domains: true

  power-domain-names: true

  mboxes:
    maxItems: 1
    description: Mailbox of the ANS2 co-processor

  interrupts: true

  apple,sart:
    $ref: /schemas/types.yaml#/definitions/phandle
    description: |
      Reference to the SART address filter.

      The SART address filter is documented in iommu/apple,sart.yaml.

  apple,rtkit-handoff:
    $ref: /schemas/types.yaml#/definitions/string
    const: nvme-disabled-v1
    description: |
      Added at boot when the bootloader leaves the ANS firmware running,
      with the NVMe controller disabled and its queues drained. The kernel
      adopts that RTKit session without renegotiating it. Shared firmware
      buffers must remain reserved and protected by the SART.

# The root declares the union of property types for DTB decoding. The
# conditional variants below each retain their closed property contract.
additionalProperties: true

allOf:
  -
    if:
      anyOf:
        -
          properties:
            compatible:
              allOf:
                -
                  contains:
                    enum:
                      - apple,t8142-nvme-ans2
                      - apple,t8152-nvme-ans2
                -
                  contains:
                    const: apple,nvme-ans
            status:
              const: disabled
          required:
            - compatible
            - status
          not:
            required:
              - mboxes
    then:
      oneOf:
        -
          type: object
          description: |
            Apple storage controller and coprocessor. Initial resource description for an unsupported
            firmware/backend layout. Register, IRQ and DMA topology can be recorded before a driver
            exists. This form must stay disabled; it does not substitute for the enabled driver contract
            or supply firmware, calibration, programming sequences or unresolved providers.
          properties:
            compatible:
              items:
                -
                  enum:
                    - apple,t8142-nvme-ans2
                    - apple,t8152-nvme-ans2
                -
                  const: apple,nvme-ans
            status:
              const: disabled
            reg:
              description: |
                Register apertures of the complete hardware complex, in hardware interface order.
              minItems: 10
              maxItems: 10
            interrupts:
              description: Interrupt lines wired to the system interrupt controller.
              minItems: 4
              maxItems: 5
          required:
            - compatible
            - reg
            - status
          additionalProperties: false
    else:
      $ref: "#/$defs/legacy-driver"

$defs:
  legacy-driver:
    type: object
    properties:
      compatible:
        oneOf:
          - const: apple,t8015-nvme-ans2
          - const: apple,t6041-nvme-ans2
          - items:
              - enum:
                  - apple,t6020-nvme-ans2
                  - apple,t6030-nvme-ans2
                  - apple,t6031-nvme-ans2
                  - apple,t8122-nvme-ans2
              - const: apple,t8103-nvme-ans2
          - const: apple,t8132-nvme-ans2
          - items:
              - const: apple,t8132-nvme-ans2
              - const: apple,t8103-nvme-ans2
          - items:
              - const: apple,t8140-nvme-ans2
              - const: apple,t8132-nvme-ans2
          - items:
              - const: apple,t8142-nvme-ans2
              - const: apple,t8140-nvme-ans2
          - items:
              - enum:
                  # Do not add additional SoC to this list.
                  - apple,t8103-nvme-ans2
                  - apple,t8112-nvme-ans2
                  - apple,t6000-nvme-ans2
              - const: apple,nvme-ans2

      reg:
        minItems: 2
        items:
          - description: NVMe controller registers, including the NVMMU
              registers on SoCs without a separate NVMMU region
          - description: ANS2 co-processor control registers
          - description: NVMMU registers, a separate region since T8132 (and
              on T604x)

      reg-names:
        oneOf:
          - minItems: 2
            items:
              - const: nvme
              - const: ans
              - const: nvmmu
          - items:
              - const: nvme
              - const: nvmmu
              - const: ans

      resets:
        maxItems: 1
        description:
          Reset of the ANS2 co-processor. On T8140 asserting it raises an
          SError, so it cannot be used to restart the co-processor there.

      power-domains:
        # two domains for t8103, three for t6000, t6020, t6041 and t8140
        minItems: 2
        items:
          - description: power domain for the NVMe controller.
          - description: power domain for the first PCIe bus connecting the NVMe
              controller to the storage modules.
          - description: optional power domain for the second PCIe bus
              connecting the NVMe controller to the storage modules (T6000,
              T6020), or for the PCIe PHY of the link to the storage (T8140).

      power-domain-names:
        minItems: 2
        items:
          - const: ans
          - const: apcie0
          - enum:
              - apcie1
              - apcie_phy

      mboxes:
        maxItems: 1
        description: Mailbox of the ANS2 co-processor

      interrupts:
        maxItems: 1

      apple,sart:
        $ref: /schemas/types.yaml#/definitions/phandle
        description: |
          Reference to the SART address filter.

          The SART address filter is documented in iommu/apple,sart.yaml.

      apple,rtkit-handoff:
        $ref: /schemas/types.yaml#/definitions/string
        const: nvme-disabled-v1
        description: |
          Added at boot when the bootloader leaves the ANS firmware running,
          with the NVMe controller disabled and its queues drained. The kernel
          adopts that RTKit session without renegotiating it. Shared firmware
          buffers must remain reserved and protected by the SART.
    allOf:
      - if:
          properties:
            compatible:
              not:
                contains:
                  enum:
                    - apple,t8132-nvme-ans2
                    - apple,t8140-nvme-ans2
        then:
          properties:
            apple,rtkit-handoff: false

      - if:
          properties:
            compatible:
              contains:
                enum:
                  - apple,t6000-nvme-ans2
                  - apple,t6020-nvme-ans2
                  - apple,t6031-nvme-ans2
                  - apple,t6041-nvme-ans2
                  - apple,t8140-nvme-ans2
        then:
          properties:
            power-domains:
              minItems: 3
            power-domain-names:
              minItems: 3
        else:
          properties:
            power-domains:
              maxItems: 2
            power-domain-names:
              maxItems: 2

      - if:
          properties:
            compatible:
              contains:
                enum:
                  - apple,t6041-nvme-ans2
                  - apple,t8132-nvme-ans2
                  - apple,t8140-nvme-ans2
        then:
          properties:
            reg:
              minItems: 3
            reg-names:
              minItems: 3
        else:
          properties:
            reg:
              maxItems: 2
            reg-names:
              maxItems: 2
    required:
      - compatible
      - reg
      - reg-names
      - resets
      - power-domains
      - power-domain-names
      - mboxes
      - interrupts
      - apple,sart
    additionalProperties: false

examples:
  - |
    #include <dt-bindings/interrupt-controller/apple-aic.h>
    #include <dt-bindings/interrupt-controller/irq.h>

    nvme@7bcc0000 {
      compatible = "apple,t8103-nvme-ans2", "apple,nvme-ans2";
      reg = <0x7bcc0000 0x40000>, <0x77400000 0x4000>;
      reg-names = "nvme", "ans";
      interrupts = <AIC_IRQ 590 IRQ_TYPE_LEVEL_HIGH>;
      mboxes = <&ans>;
      apple,sart = <&sart>;
      power-domains = <&ps_ans2>, <&ps_apcie_st>;
      power-domain-names = "ans", "apcie0";
      resets = <&ps_ans2>;
    };
```

## Documentation/devicetree/bindings/nvme/apple,nvme-apif.yaml
```yaml
# SPDX-License-Identifier: GPL-2.0-only
%YAML 1.2
---
$id: http://devicetree.org/schemas/nvme/apple,nvme-apif.yaml#
$schema: http://devicetree.org/meta-schemas/core.yaml#

title: Resident Apple ANS controller using the Aurora platform interface

maintainers:
  - Dj <hey@djdev.me>

description: |
  A boot-time guest description for the native table-6 ABI with 64-entry
  linear queues. The producer stops all NVMe DMA and quiesces both sides
  of RTKit before handoff. Native queue registrations survive controller
  disable, so the consumer must reuse the four registered queue pages.
  This binding describes an ABI, not a promise of support for every SoC.
  The controller uses identity DMA addresses and coherent shared memory.

properties:
  compatible:
    const: apple,nvme-apif
  reg:
    items:
      - description: NVMe controller registers
      - description: ANS coprocessor control registers
  reg-names:
    items:
      - const: nvme
      - const: ans
  interrupts:
    maxItems: 1
  mboxes:
    maxItems: 1
  apple,sart:
    $ref: /schemas/types.yaml#/definitions/phandle
    description: SART provider for the resident controller
  aurora,apif:
    $ref: /schemas/types.yaml#/definitions/phandle
    description: Version-2 native APIF transport
  dma-coherent: true
  asahi,rtkit-quiesced:
    type: boolean
    description: Both RTKit peers were stopped before their buffers were released
  memory-region:
    minItems: 4
    maxItems: 4
  memory-region-names:
    items:
      - const: admin-sq
      - const: admin-cq
      - const: io-sq
      - const: io-cq
  power-domains:
    minItems: 2
    maxItems: 3
  power-domain-names:
    minItems: 2
    items:
      - const: ans
      - const: apcie0
      - enum: [apcie1, apcie_phy]
  resets:
    maxItems: 1

required:
  - compatible
  - reg
  - reg-names
  - interrupts
  - mboxes
  - apple,sart
  - aurora,apif
  - dma-coherent
  - asahi,rtkit-quiesced
  - memory-region
  - memory-region-names

additionalProperties: false
```

## Documentation/devicetree/bindings/opp/operating-points-v2-apple-dcs.yaml
```yaml
# SPDX-License-Identifier: (GPL-2.0-only OR BSD-2-Clause)
%YAML 1.2
---
$id: http://devicetree.org/schemas/opp/operating-points-v2-apple-dcs.yaml#
$schema: http://devicetree.org/meta-schemas/core.yaml#

title: Apple T600x measured DCS bandwidth operating points

maintainers:
  - Ryan Murray <ryan@aurorasilicon.org>

allOf:
  - $ref: opp-v2-base.yaml#

description: |
  T6000 DCS raw states are 5, 6, 7 and 9. State 8 is invalid; fabric
  states are a separate controller and are not DCS states.
  Each OPP maps a verified raw PMGR desired performance state to measured
  sustainable bandwidth. Values are decimal kB/s, not DRAM clock frequencies,
  theoretical peak bandwidth or firmware policy thresholds. State codes and
  bandwidths must strictly increase together. The highest OPP must match the
  boot firmware's desired state. Unmeasured intermediate states may be omitted.

properties:
  compatible:
    const: operating-points-v2-apple-dcs

patternProperties:
  '^opp(-?[0-9]+)*$':
    type: object
    properties:
      opp-supported-hw: false
      turbo-mode: false
      opp-level:
        description: Verified raw PMGR desired state, without a state-index bias
        enum: [5, 6, 7, 9]
      opp-peak-kBps:
        description: Measured sustainable bandwidth at this raw state
        items:
          - minimum: 1
    required:
      - opp-level
      - opp-peak-kBps
    unevaluatedProperties: false

required:
  - compatible

unevaluatedProperties: false
```
