## Documentation/devicetree/bindings/pci/apple,pcie.yaml
```yaml
# SPDX-License-Identifier: (GPL-2.0-only OR BSD-2-Clause)
%YAML 1.2
---
$id: http://devicetree.org/schemas/pci/apple,pcie.yaml#
$schema: http://devicetree.org/meta-schemas/core.yaml#

title: Apple PCIe host controller

maintainers:
  - Mark Kettenis <kettenis@openbsd.org>

description: |
  The Apple PCIe host controller is a PCIe host controller with
  multiple root ports present in Apple ARM SoC platforms, including
  various iPhone and iPad devices and the "Apple Silicon" Macs.
  The controller incorporates Synopsys DesigWare PCIe logic to
  implements its root ports.  But the ATU found on most DesignWare
  PCIe host bridges is absent.

  On systems derived from T602x, the PHY registers are in a region
  separate from the port registers. In that case, there is one PHY
  register range per port register range.

  The PCIe-C variant connects a single root port to a USB4 router instead of
  a physical PCIe link. It has no external PHY or PERST# GPIO and follows the
  router's cable-controlled power lifetime.

  All root ports share a single ECAM space, but separate GPIOs are
  used to take the PCI devices on those ports out of reset.  Therefore
  the standard "reset-gpios" and "max-link-speed" properties appear on
  the child nodes that represent the PCI bridges that correspond to
  the individual root ports.

  MSIs are handled by the PCIe controller and translated into regular
  interrupts.  A range of 32 MSIs is provided.  These 32 MSIs can be
  distributed over the root ports as the OS sees fit by programming
  the PCIe controller's port registers.

$defs:
  tunable:
    $ref: /schemas/types.yaml#/definitions/uint32-matrix
    items:
      items:
        - description: Register offset
        - description: Mask of bits to clear
        - description: Bits to set
    description: Register initialization tuples for one controller region.

  t6050-tunable:
    $ref: /schemas/types.yaml#/definitions/uint32-matrix
    items:
      items:
        - description: Register offset in the named window
        - description: Access width in bytes
          const: 4
        - description: Mask of the bits to replace
        - description: Value of those bits
    description:
      A T6050 host tunable list, copied by the boot loader from the Apple
      device tree.

properties:
  compatible:
    oneOf:
      - items:
          - enum:
              - apple,t8103-pcie
              - apple,t8112-pcie
              - apple,t6000-pcie
          - const: apple,pcie
      - items:
          - enum:
              - apple,t6030-pcie
              - apple,t6031-pcie
              - apple,t6041-pcie
              - apple,t8122-pcie
          - const: apple,t6020-pcie
      - const: apple,t6020-pcie
      - items:
          - const: apple,t6020-pcie-ge
          - const: apple,t6020-pcie
      - const: apple,t8140-pcie
      - const: apple,t6050-pcie
      - const: apple,t8152-pcie
      - const: apple,t8132-pcie
      - const: apple,t8103-pciec
      - items:
          - const: apple,t8112-pciec
          - const: apple,t8103-pciec
      - const: apple,t6000-pciec
      - const: apple,t6050-pciec
      - items:
          - const: apple,t8132-pciec
          - const: apple,t8122-pciec
          - const: apple,t8103-pciec
      - const: apple,t6040-pciec

  apple,managed-sids:
    $ref: /schemas/types.yaml#/definitions/uint32-array
    items:
      - const: 1
      - const: 2
    description: >
      J713 radio ordinary stream ownership profile. Only these inactive
      normal streams and their exact-RID entries may be adopted by the OS.
      Other streams and RID entries remain inherited. The documented static
      SID16 bypass role may be initialized only from a disabled stream with
      no valid root; an existing bypass remains unchanged. PIODMA and other
      reserved roles are not modified. This does not authorize a controller
      reset or takeover of active page tables. Both the radio DART and PCI
      host describe the same two ordinary streams.

  reg:
    minItems: 3
    maxItems: 20

  reg-names:
    minItems: 3
    maxItems: 20

  ranges:
    minItems: 2
    maxItems: 3

  interrupts:
    description:
      Interrupt specifiers, one for each root port.
    minItems: 1
    maxItems: 6

  interrupt-names:
    minItems: 1
    maxItems: 6

  msi-parent: true

  nonposted-mmio: true

  msi-ranges:
    maxItems: 1

  apple,msi-vector-base:
    $ref: /schemas/types.yaml#/definitions/uint32
    description:
      First global vector targeted by this controller's local MSI map.

  iommu-map: true
  iommu-map-mask: true

  post-init-providers:
    description:
      The DART of a host whose iommu-map names a DART marked
      apple,manual-availability, so that fw_devlink does not make the host wait
      for a DART that probes only after the host has brought up its port.
    $ref: /schemas/types.yaml#/definitions/phandle-array

  power-domains:
    description:
      The power domains the controller needs. Internal controllers on some
      SoCs sit behind two separate domain chains (for example the PCIe
      system and PHY domains), all of which must stay on while the links
      are up.
    minItems: 1
    maxItems: 2

  resets:
    description:
      Reset of a tunneled (PCIe-C) controller and its DART, for controllers
      the kernel initializes itself.
    maxItems: 1

  dma-coherent: true

  apple,pciec-kernel-init:
    type: boolean
    description: |
      The kernel initializes the tunneled controller when firmware has not
      already initialized it. The compatible selects the initialization
      sequence. T600x and T8112 use the Intr2AXI bridge and require tunables
      for their associated DART before the tunnel children can be populated.

  apple,tunable-rc:
    $ref: '#/$defs/tunable'
    description: Root-complex register initialization tuples.

  apple,tunable-fabric:
    $ref: '#/$defs/tunable'
    description: Initialization tuples for the fabric register region.

  apple,tunable-debug:
    $ref: '#/$defs/tunable'
    description: Initialization tuples for the debug register region.

  apple,tunable-oe-fabric:
    $ref: '#/$defs/tunable'
    description: Initialization tuples for the oe-fabric register region.

  apple,tunable-axi2af:
    description: Register tuples for the controller's AXI bridge.

  apple,tunable-cio3pllcore:
    $ref: '#/$defs/t6050-tunable'
    description: T6050 tuples for the CIO3 PLL core, in the pcieclkgen window.

  apple,tunable-pcieclkgen:
    $ref: '#/$defs/t6050-tunable'
    description: T6050 tuples for the pcieclkgen window.

  apple,tunable-cio3pll:
    $ref: '#/$defs/tunable'
    description: Initialization tuples for the shared PHY block's PLL.

  apple,tunable-clkgen:
    $ref: '#/$defs/tunable'
    description: Initialization tuples for the shared PHY block's clock generator.

  apple,tunable-phy:
    description: Register tuples for the controller's PHY window.

  apple,tunable-phy-ip-pll:
    description: PLL register tuples relative to the controller's phy-ip window.

  apple,tunable-phy-ip-auspma:
    description: Lane register tuples relative to the controller's phy-ip window.

  apple,piodma:
    $ref: /schemas/types.yaml#/definitions/phandle
    description:
      T8140 PIODMA bootstrap engine used before native downstream ECAM access.

patternProperties:
  "^pci@":
    $ref: /schemas/pci/pci-bus.yaml#
    type: object
    description: A single PCI root port

    properties:
      reg:
        maxItems: 1

      pwren-gpios:
        description: Optional GPIO to power on the device
        maxItems: 1

      clkreq-gpios:
        description:
          The endpoint's CLKREQ# line. After a deep sleep has reset the pin
          controller, the host returns the pin to an input before it trains
          the link again.
        maxItems: 1

      interrupt-controller: true

      apple,link-trained-by-bootloader:
        type: boolean
        description:
          The boot loader trained this port's link and handed it over up. The
          driver adopts the link as it is instead of resetting the port, so
          the port needs no PERST# line. A T6050 port that also names
          pwren-gpios may be left untrained; the OS then trains it first and
          adopts it the same way.

      apple,tunable:
        $ref: '#/$defs/tunable'
        description: Initialization tuples relative to this port's registers.

      apple,apcie-config-tunables:
        $ref: '#/$defs/t6050-tunable'
        description:
          T6050 tuples for the controller's config window, applied when the
          OS trains the port itself (pwren-gpios).

      apple,pcie-rc-tunables:
        $ref: '#/$defs/t6050-tunable'
        description: T6050 tuples for the root complex window of this port.

      apple,pcie-rc-gen3-shadow-tunables:
        $ref: '#/$defs/t6050-tunable'
        description: T6050 root complex tuples applied for a Gen3 link.

      apple,pcie-rc-gen4-shadow-tunables:
        $ref: '#/$defs/t6050-tunable'
        description: T6050 root complex tuples applied for a Gen4 link.

      apple,pcie-rc-gen5-shadow-tunables:
        $ref: '#/$defs/t6050-tunable'
        description: T6050 root complex tuples applied for a Gen5 link.

    required:
      - interrupt-controller
      - "#interrupt-cells"
      - interrupt-map-mask
      - interrupt-map

    unevaluatedProperties: false

required:
  - compatible
  - reg
  - reg-names
  - bus-range
  - interrupts
  - msi-controller
  - msi-parent
  - msi-ranges

unevaluatedProperties: false

allOf:
  - if:
      properties:
        compatible:
          contains:
            enum:
              - apple,t8132-pciec
              - apple,t6040-pciec
    then:
      required:
        - apple,msi-vector-base
  - $ref: /schemas/pci/pci-host-bridge.yaml#
  - $ref: /schemas/interrupt-controller/msi-controller.yaml#
  - if:
      properties:
        compatible:
          contains:
            const: apple,t6050-pcie
    then:
      properties:
        reg:
          minItems: 5
          maxItems: 20
        reg-names:
          description:
            config and rc, then port<n>, phy<n> and intr2axi<n> for each
            adopted root port 00:<n>.0. A host with a port the OS trains
            itself (pwren-gpios) also names the shared PHY (phy-shared), its
            common block (phy-common) and the windows its tunable lists
            apply to (axi2af, pcieclkgen, phy-window, phy-ip).
          minItems: 5
          maxItems: 20
          items:
            pattern: "^(config|rc|(port|phy|intr2axi)[0-3]|phy-shared|phy-common|axi2af|pcieclkgen|phy-window|phy-ip)$"
        interrupts:
          maxItems: 4
        interrupt-names:
          items:
            pattern: "^port[0-3]$"
        apple,msi-vector-base:
          const: 64
        power-domains: false
        apple,tunable-axi2af:
          $ref: '#/$defs/t6050-tunable'
        apple,tunable-phy:
          $ref: '#/$defs/t6050-tunable'
        apple,tunable-phy-ip-pll:
          $ref: '#/$defs/t6050-tunable'
        apple,tunable-phy-ip-auspma:
          $ref: '#/$defs/t6050-tunable'
        apple,tunable-cio3pll: false
        apple,tunable-clkgen: false
      required:
        - interrupt-names
        - apple,msi-vector-base
        - iommu-map
      patternProperties:
        "^pci@":
          properties:
            reset-gpios:
              description:
                The PERST# line of a port whose endpoint needs a root-port
                reset after the bootloader trained the link. Left as the
                bootloader set it until that reset, or until the OS trains
                the port itself.
            pwren-gpios:
              description:
                The endpoint's power line. A port that names it may be left
                untrained by the bootloader; the OS then powers the endpoint
                and trains the link itself (the host then needs phy-shared
                and phy-common), and adopts it as a bootloader-trained one.
          required:
            - apple,link-trained-by-bootloader
    else:
      properties:
        apple,tunable-axi2af:
          $ref: '#/$defs/tunable'
        apple,tunable-cio3pllcore: false
        apple,tunable-pcieclkgen: false
        apple,tunable-phy:
          $ref: '#/$defs/tunable'
        apple,tunable-phy-ip-pll:
          $ref: '#/$defs/tunable'
        apple,tunable-phy-ip-auspma:
          $ref: '#/$defs/tunable'
      patternProperties:
        "^pci@":
          properties:
            apple,link-trained-by-bootloader: false
            apple,apcie-config-tunables: false
            apple,pcie-rc-tunables: false
            apple,pcie-rc-gen3-shadow-tunables: false
            apple,pcie-rc-gen4-shadow-tunables: false
            apple,pcie-rc-gen5-shadow-tunables: false
  - if:
      properties:
        compatible:
          contains:
            const: apple,t8140-pcie
    then:
      properties:
        apple,piodma: true
    else:
      properties:
        apple,piodma: false
  - if:
      properties:
        compatible:
          contains:
            const: apple,t8103-pcie
    then:
      properties:
        reg:
          maxItems: 5
        interrupts:
          maxItems: 3
  - if:
      properties:
        compatible:
          contains:
            const: apple,t6020-pcie
    then:
      properties:
        reg-names:
          minItems: 10
  - if:
      properties:
        compatible:
          contains:
            enum:
              - apple,t8103-pciec
              - apple,t6000-pciec
              - apple,t6040-pciec
              - apple,t6050-pciec
    then:
      properties:
        reg:
          minItems: 5
          maxItems: 9
        reg-names:
          oneOf:
            - items:
                - const: config
                - const: rc
                - const: port0
                - const: fabric
                - const: debug
            - items:
                - const: config
                - const: rc
                - const: port0
                - const: fabric
                - const: debug
                - const: ltssm
                - enum: [intr2axi, oe-fabric]
            - items:
                - const: config
                - const: rc
                - const: port0
                - const: fabric
                - const: debug
                - const: ioa
                - const: ltssm
                - const: intr2axi
                - const: oe-fabric
            - items:
                - const: config
                - const: rc
                - const: port0
                - const: fabric
                - const: debug
                - const: ioa
                - const: ltssm
                - const: intr2axi
        interrupts:
          maxItems: 6
        ranges:
          minItems: 3
          maxItems: 3
      allOf:
        - if:
            properties:
              compatible:
                contains:
                  const: apple,t6040-pciec
          then:
            properties:
              reg:
                minItems: 8
                maxItems: 8
              interrupts:
                minItems: 6
                maxItems: 6
              interrupt-names:
                items:
                  - const: port
                  - const: intx-a
                  - const: intx-b
                  - const: intx-c
                  - const: intx-d
                  - const: parity
            required:
              - interrupt-names
          else:
            properties:
              interrupts:
                maxItems: 1
              interrupt-names: false
    else:
      properties:
        resets: false
        apple,pciec-kernel-init: false
        apple,tunable-rc: false
        apple,tunable-fabric: false
        apple,tunable-debug: false
        apple,tunable-oe-fabric: false
        ranges:
          maxItems: 2
      allOf:
        - if:
            properties:
              compatible:
                contains:
                  const: apple,t8140-pcie
          then:
            properties:
              reg:
                minItems: 8
                maxItems: 13
              reg-names:
                minItems: 8
                items:
                  - const: config
                  - const: rc
                  - const: port0
                  - const: port1
                  - const: port2
                  - const: phy0
                  - const: phy1
                  - const: phy2
                  - const: axi2af
                  - const: cio3pll
                  - const: clkgen
                  - const: phy-block
                  - const: phy-ip
              interrupts:
                maxItems: 3
          else:
            if:
              properties:
                compatible:
                  contains:
                    const: apple,t6050-pcie
            then:
              properties:
                reg:
                  minItems: 5
                  maxItems: 20
                reg-names:
                  minItems: 5
                  maxItems: 20
                  items:
                    enum: [config, rc, port0, phy0, intr2axi0, port1, phy1,
                           intr2axi1, port2, phy2, intr2axi2, port3, phy3,
                           intr2axi3, phy-shared, phy-common, axi2af,
                           pcieclkgen, phy-window, phy-ip]
                interrupts:
                  maxItems: 4
            else:
              if:
                properties:
                  compatible:
                    contains:
                      const: apple,t8152-pcie
              then:
                properties:
                  reg:
                    minItems: 4
                    maxItems: 8
                  reg-names:
                    minItems: 4
                    maxItems: 8
                    items:
                      enum: [config, rc, port0, phy0, port1, phy1, port2, phy2]
                  interrupts:
                    maxItems: 3
              else:
                if:
                  properties:
                    compatible:
                      contains:
                        const: apple,t8132-pcie
                then:
                  properties:
                    reg:
                      minItems: 4
                      maxItems: 9
                    reg-names:
                      oneOf:
                        - minItems: 4
                          items:
                            - const: config
                            - const: rc
                            - const: port0
                            - const: phy0
                            - const: axi2af
                            - const: cio3pll
                            - const: clkgen
                            - const: phy-block
                            - const: phy-ip
                        # A board that uses the third port lists it instead.
                        - items:
                            - const: config
                            - const: rc
                            - const: port0
                            - const: phy0
                            - const: port2
                            - const: phy2
                    interrupts:
                      maxItems: 3
                else:
                  properties:
                    reg:
                      maxItems: 10
                    reg-names:
                      minItems: 3
                      items:
                        - const: config
                        - const: rc
                        - const: port0
                        - const: port1
                        - const: port2
                        - const: port3
                        - const: phy0
                        - const: phy1
                        - const: phy2
                        - const: phy3
      patternProperties:
        "^pci@":
          properties:
            apple,tunable: false
          if:
            not:
              required:
                - apple,link-trained-by-bootloader
          then:
            required:
              - reset-gpios

examples:
  - |
    #include <dt-bindings/interrupt-controller/apple-aic.h>

    soc {
      #address-cells = <2>;
      #size-cells = <2>;

      pcie0: pcie@690000000 {
        compatible = "apple,t8103-pcie", "apple,pcie";
        device_type = "pci";

        reg = <0x6 0x90000000 0x0 0x1000000>,
              <0x6 0x80000000 0x0 0x100000>,
              <0x6 0x81000000 0x0 0x4000>,
              <0x6 0x82000000 0x0 0x4000>,
              <0x6 0x83000000 0x0 0x4000>;
        reg-names = "config", "rc", "port0", "port1", "port2";

        interrupt-parent = <&aic>;
        interrupts = <AIC_IRQ 695 IRQ_TYPE_LEVEL_HIGH>,
                     <AIC_IRQ 698 IRQ_TYPE_LEVEL_HIGH>,
                     <AIC_IRQ 701 IRQ_TYPE_LEVEL_HIGH>;

        msi-controller;
        msi-parent = <&pcie0>;
        msi-ranges = <&aic AIC_IRQ 704 IRQ_TYPE_EDGE_RISING 32>;

        iommu-map = <0x100 &dart0 1 1>,
                    <0x200 &dart1 1 1>,
                    <0x300 &dart2 1 1>;
        iommu-map-mask = <0xff00>;

        bus-range = <0 3>;
        #address-cells = <3>;
        #size-cells = <2>;
        ranges = <0x43000000 0x6 0xa0000000 0x6 0xa0000000 0x0 0x20000000>,
                 <0x02000000 0x0 0xc0000000 0x6 0xc0000000 0x0 0x40000000>;

        power-domains = <&ps_apcie_gp>;
        pinctrl-0 = <&pcie_pins>;
        pinctrl-names = "default";

        port00: pci@0,0 {
          device_type = "pci";
          reg = <0x0 0x0 0x0 0x0 0x0>;
          reset-gpios = <&pinctrl_ap 152 0>;

          #address-cells = <3>;
          #size-cells = <2>;
          ranges;

          interrupt-controller;
          #interrupt-cells = <1>;
          interrupt-map-mask = <0 0 0 7>;
          interrupt-map = <0 0 0 1 &port00 0 0 0 0>,
                          <0 0 0 2 &port00 0 0 0 1>,
                          <0 0 0 3 &port00 0 0 0 2>,
                          <0 0 0 4 &port00 0 0 0 3>;
        };

        port01: pci@1,0 {
          device_type = "pci";
          reg = <0x800 0x0 0x0 0x0 0x0>;
          reset-gpios = <&pinctrl_ap 153 0>;

          #address-cells = <3>;
          #size-cells = <2>;
          ranges;

          interrupt-controller;
          #interrupt-cells = <1>;
          interrupt-map-mask = <0 0 0 7>;
          interrupt-map = <0 0 0 1 &port01 0 0 0 0>,
                          <0 0 0 2 &port01 0 0 0 1>,
                          <0 0 0 3 &port01 0 0 0 2>,
                          <0 0 0 4 &port01 0 0 0 3>;
        };

        port02: pci@2,0 {
          device_type = "pci";
          reg = <0x1000 0x0 0x0 0x0 0x0>;
          reset-gpios = <&pinctrl_ap 33 0>;

          #address-cells = <3>;
          #size-cells = <2>;
          ranges;

          interrupt-controller;
          #interrupt-cells = <1>;
          interrupt-map-mask = <0 0 0 7>;
          interrupt-map = <0 0 0 1 &port02 0 0 0 0>,
                          <0 0 0 2 &port02 0 0 0 1>,
                          <0 0 0 3 &port02 0 0 0 2>,
                          <0 0 0 4 &port02 0 0 0 3>;
        };
      };
    };
```
