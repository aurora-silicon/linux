## Documentation/devicetree/bindings/npu/apple,ane.yaml
```yaml
# SPDX-License-Identifier: (GPL-2.0-only OR BSD-2-Clause)
%YAML 1.2
---
$id: http://devicetree.org/schemas/npu/apple,ane.yaml#
$schema: http://devicetree.org/meta-schemas/core.yaml#

title: Apple Neural Engine

maintainers:
  - Joshua Warren <816217+joshuaswarren@users.noreply.github.com>

description:
  The Apple Neural Engine (ANE) is the neural network accelerator of Apple
  SoCs. It accesses memory through three DARTs. On T8103 and T6000 the host
  drives the engine through its register window. On T602x and T8112 a
  coprocessor runs the ANE firmware and the host talks to it through an ASC
  mailbox. T8140 has two interrupts and one system power domain; its
  coprocessor is exclave-assigned and cannot be used directly without a
  Linux ownership provider. T6041 has one interrupt and preloaded firmware;
  its CPU, MPM and task domains depend on the ANE system domain, and its
  base domain depends on the task domain. Interrupt roles on T6041 and
  T8140 are not yet established.

properties:
  compatible:
    enum:
      - apple,t8103-ane
      - apple,t6000-ane
      - apple,t6020-ane
      - apple,t6021-ane
      - apple,t6022-ane
      - apple,t6041-ane
      - apple,t8112-ane
      - apple,t8140-ane

  reg:
    minItems: 1
    items:
      - description: Engine registers, including the coprocessor on firmware
          managed generations
      - description: Power manager (PMGR) registers of the ANE
      - description: Power state registers or first auxiliary window
      - description: Revision registers or second auxiliary window
      - description: Third auxiliary window
      - description: Fourth auxiliary window
      - description: Fifth auxiliary window

  reg-names:
    minItems: 1
    maxItems: 7

  apple,performance-controller:
    $ref: /schemas/types.yaml#/definitions/phandle
    description:
      PMP report provider that owns the ANE clock-level request interface.
      Only supported on T6000. The ANE and report SRAM must remain powered
      while the driver holds a request.

  interconnects:
    maxItems: 1

  interconnect-names:
    const: memory
    description: DRAM/fabric path; bandwidth requests come from the level OPP.

  operating-points-v2: true

  interrupts:
    minItems: 1
    maxItems: 2

  interrupt-names:
    items:
      - const: ane

  iommus:
    description:
      Stream 0 of each of the three DARTs. On T6041 the ANE's MPM also uses
      stream 11 of each DART; the firmware drives that stream itself and it
      is not described here.
    minItems: 3
    maxItems: 3

  power-domains:
    description:
      The power states the engine needs, five on T8103, six on T6000 with
      ANE level control (including PMP report SRAM), eight on
      T602x, seven on T8112 and one system domain on T8140. T6041 may add
      a sixth, "perf", a performance floor (such as the SoC rail floor)
      that the driver holds only while requests are in flight.
    minItems: 1
    maxItems: 8

  power-domain-names:
    minItems: 1
    maxItems: 8

  resets:
    maxItems: 1
    description: Reset of the ANE coprocessor

  mboxes:
    maxItems: 1
    description: Mailbox of the ANE coprocessor

  memory-region:
    minItems: 1
    maxItems: 2
    description:
      On T602x, the IOVA-only reservation of the firmware entry alias.
      On T6041 and T8140, bootloader-provided physical TEXT and DATA preload
      reservations in that order. Each reservation must have no-map, must
      not be reusable, and must remain reserved until reboot. Physical
      addresses vary per boot and must not be hard-coded in a board DTS.

  memory-region-names:
    items:
      - const: firmware-text
      - const: firmware-data

  apple,firmware-iovas:
    $ref: /schemas/types.yaml#/definitions/uint64-array
    items:
      - const: 0x10000000000
      - const: 0x100000c0000
    description:
      Device addresses of the preloaded TEXT and DATA segments. Their sizes
      are 0xc0000 and 0x2ac000 bytes respectively. The bootloader supplies
      the physical reservations. The device addresses are fixed by the
      firmware layout and may be described statically.

  apple,dapf-ranges:
    $ref: /schemas/types.yaml#/definitions/uint64-matrix
    minItems: 4
    maxItems: 4
    items:
      items:
        - description: Physical start address, inclusive
        - description: Physical end address, inclusive
    description:
      Four DART address protection filter (DAPF) ranges, in hardware record
      order. Each pair contains inclusive 64-bit physical bounds, not a
      base and length. The same records apply to all three ANE DARTs.
      Firmware accesses these registers through identity mappings of the
      containing 16 KiB pages in its private domain. These are MMIO ranges,
      not allocatable DMA memory or additional preload segments.

  apple,dapf-ranges:
    $ref: /schemas/types.yaml#/definitions/uint64-array
    minItems: 8
    maxItems: 8
    description: Four inclusive SID0 physical MMIO start/end pairs

  apple,preload-data-sha256:
    $ref: /schemas/types.yaml#/definitions/uint8-array
    minItems: 32
    maxItems: 32
    description:
      Bootloader-produced digest of the live reserved DATA including all
      personalized parameter bytes. This establishes preservation of that
      boot's DATA, not a cross-build firmware identity. TEXT has a driver pin.

  apple,ane-type:
    $ref: /schemas/types.yaml#/definitions/uint32
    enum: [0x110, 0x200]
    description: Firmware generation identifier supplied by the bootloader

  apple,firmware-preloaded:
    type: boolean
    description:
      Firmware has been personalized and preloaded by iBoot. The driver
      must preserve its runtime patches and must not stage a disk image.

  apple,exclave-assigned:
    type: boolean
    description:
      The ANE belongs to an exclave. Direct access requires a separate
      Linux ownership provider to acquire a quiesced device and isolate
      the exclave DART contexts. Absence does not prove a handoff on T8140.

required:
  - compatible
  - reg
  - reg-names
  - interrupts
  - iommus
  - power-domains

allOf:
  - if:
      required:
        - interconnects
    then:
      required:
        - interconnect-names
        - operating-points-v2
  - if:
      required:
        - apple,performance-controller
    then:
      properties:
        compatible:
          const: apple,t6000-ane
        power-domains:
          minItems: 6
          maxItems: 6

  - if:
      properties:
        compatible:
          const: apple,t8140-ane
    then:
      properties:
        interrupts:
          minItems: 2
        power-domains:
          maxItems: 1
        apple,ane-type:
          const: 0x200
  - if:
      properties:
        compatible:
          const: apple,t8140-ane
    then:
      properties:
        reg:
          minItems: 3
          maxItems: 3
        reg-names:
          items:
            - const: engine
            - const: pmgr
            - const: pwgate
      required:
        - apple,dapf-ranges
  - if:
      required:
        - apple,preload-data-sha256
    then:
      properties:
        memory-region:
          minItems: 2
      required:
        - memory-region
        - memory-region-names
        - apple,firmware-preloaded
  - if:
      properties:
        compatible:
          enum:
            - apple,t6041-ane
            - apple,t8140-ane
      required:
        - memory-region
    then:
      required:
        - memory-region-names
        - apple,firmware-iovas
  - if:
      required:
        - memory-region-names
    then:
      required:
        - apple,firmware-iovas
  - if:
      properties:
        compatible:
          const: apple,t6041-ane
    then:
      properties:
        interrupts:
          maxItems: 1
        reg:
          minItems: 7
        reg-names:
          items:
            - const: engine
            - const: pmgr
            - const: aux-0
            - const: aux-1
            - const: aux-2
            - const: aux-3
            - const: aux-4
        power-domains:
          minItems: 5
          maxItems: 6
        power-domain-names:
          minItems: 5
          items:
            - const: sys
            - const: cpu
            - const: mpm
            - const: td
            - const: base
            - const: perf
        apple,ane-type:
          const: 0x110
      required:
        - apple,ane-type
        - apple,firmware-preloaded
        - apple,dapf-ranges
  - if:
      properties:
        compatible:
          contains:
            enum:
              - apple,t8140-ane
              - apple,t6041-ane
    then:
      properties:
        interrupt-names: false
        iommus:
          minItems: 3
        resets: false
        mboxes: false
    else:
      properties:
        interrupts:
          maxItems: 1
        power-domains:
          minItems: 5
        reg:
          maxItems: 4
        reg-names:
          minItems: 1
          items:
            - const: engine
            - const: pmgr
            - const: set
            - const: fuse
        memory-region:
          maxItems: 1
        memory-region-names: false
        apple,firmware-iovas: false
        apple,ane-type: false
        apple,firmware-preloaded: false
        apple,exclave-assigned: false
        apple,dapf-ranges: false
      required:
        - interrupt-names

  - if:
      properties:
        compatible:
          contains:
            enum:
              - apple,t8103-ane
              - apple,t6000-ane
    then:
      properties:
        reg:
          maxItems: 1
        reg-names:
          maxItems: 1
        power-domains:
          maxItems: 6
        resets: false
        mboxes: false
        memory-region: false

  - if:
      properties:
        compatible:
          contains:
            enum:
              - apple,t6020-ane
              - apple,t6021-ane
              - apple,t6022-ane
    then:
      properties:
        reg:
          minItems: 3
          maxItems: 3
        reg-names:
          minItems: 3
          maxItems: 3
        power-domains:
          minItems: 8
      required:
        - resets
        - mboxes
        - memory-region

  - if:
      properties:
        compatible:
          contains:
            const: apple,t8112-ane
    then:
      properties:
        reg:
          minItems: 4
        reg-names:
          minItems: 4
        power-domains:
          minItems: 7
          maxItems: 7
        resets: false
        memory-region: false
      required:
        - mboxes

additionalProperties: false

examples:
  - |
    #include <dt-bindings/interrupt-controller/apple-aic.h>
    #include <dt-bindings/interrupt-controller/irq.h>

    soc {
        #address-cells = <2>;
        #size-cells = <2>;

        ane@400000000 {
            compatible = "apple,t8140-ane";
            reg = <0x4 0x0 0x0 0x2000000>,
                  <0x3 0x00700000 0x0 0x18000>,
                  <0x3 0x00726680 0x0 0x34>;
            reg-names = "engine", "pmgr", "pwgate";
            interrupt-parent = <&aic>;
            interrupts = <AIC_IRQ 655 IRQ_TYPE_LEVEL_HIGH>,
                         <AIC_IRQ 668 IRQ_TYPE_LEVEL_HIGH>;
            iommus = <&ane_dart0 0>, <&ane_dart1 0>, <&ane_dart2 0>;
            power-domains = <&ps_ane_sys>;
            apple,dapf-ranges = /bits/ 64 <0x321668000 0x321668003
                                         0x30070c000 0x30070c013
                                         0x300700290 0x300700293
                                         0x482668000 0x482668003>;
            status = "disabled";
        };
    };

  - |
    #include <dt-bindings/interrupt-controller/apple-aic.h>
    #include <dt-bindings/interrupt-controller/irq.h>

    soc {
        #address-cells = <2>;
        #size-cells = <2>;

        ane@26bc04000 {
            compatible = "apple,t8103-ane";
            reg = <0x2 0x6bc04000 0x0 0x24000>;
            reg-names = "engine";
            interrupt-parent = <&aic>;
            interrupts = <AIC_IRQ 416 IRQ_TYPE_LEVEL_HIGH>;
            interrupt-names = "ane";
            iommus = <&ane_dart0 0>, <&ane_dart1 0>, <&ane_dart2 0>;
            power-domains = <&ps_ane_set1>, <&ps_ane_set2>,
                            <&ps_ane_set3>, <&ps_ane_set4>, <&ps_ane_set5>;
        };
    };

  - |
    #include <dt-bindings/interrupt-controller/apple-aic.h>
    #include <dt-bindings/interrupt-controller/irq.h>

    soc {
        #address-cells = <2>;
        #size-cells = <2>;

        ane@284000000 {
            compatible = "apple,t6021-ane";
            reg = <0x2 0x84000000 0x0 0x2000000>,
                  <0x2 0x8e080000 0x0 0x4034>,
                  <0x2 0x8e08c000 0x0 0x4000>;
            reg-names = "engine", "pmgr", "set";
            interrupt-parent = <&aic>;
            interrupts = <AIC_IRQ 0 884 IRQ_TYPE_LEVEL_HIGH>;
            interrupt-names = "ane";
            iommus = <&ane_dart0 0>, <&ane_dart1 0>, <&ane_dart2 0>;
            power-domains = <&ps_ane_sys_mpm>, <&ps_ane_td>,
                            <&ps_ane_base>, <&ps_ane_set1>, <&ps_ane_set2>,
                            <&ps_ane_set3>, <&ps_ane_set4>, <&ps_ane_cpu>;
            resets = <&ps_ane_cpu>;
            mboxes = <&ane_mbox>;
            memory-region = <&ane_alias_iova>;
        };
    };

  - |
    #include <dt-bindings/interrupt-controller/apple-aic.h>
    #include <dt-bindings/interrupt-controller/irq.h>

    soc {
        #address-cells = <2>;
        #size-cells = <2>;

        ane@484000000 {
            compatible = "apple,t6041-ane";
            reg = <0x4 0x84000000 0x0 0x2000000>,
                  <0x5 0x02280000 0x0 0x18000>,
                  <0x5 0x022a0000 0x0 0x4000>,
                  <0x5 0x003c0000 0x0 0x30000>,
                  <0x2 0x12000000 0x0 0xff4000>,
                  <0x5 0x22000000 0x0 0x2000000>,
                  <0x5 0x08374000 0x0 0x4000>;
            reg-names = "engine", "pmgr", "aux-0", "aux-1", "aux-2",
                        "aux-3", "aux-4";
            interrupt-parent = <&aic>;
            interrupts = <AIC_IRQ 1054 IRQ_TYPE_LEVEL_HIGH>;
            iommus = <&ane_dart0 0>, <&ane_dart1 0>, <&ane_dart2 0>;
            power-domains = <&ps_ane_sys>, <&ps_ane_cpu>, <&ps_ane_mpm>,
                            <&ps_ane_td>, <&ps_ane_base>;
            apple,ane-type = <0x110>;
            apple,firmware-preloaded;
            apple,dapf-ranges = /bits/ 64 <0x5022803c0 0x5022803c3>,
                                /bits/ 64 <0x50228c000 0x50228c01b>,
                                /bits/ 64 <0x581668000 0x581668003>,
                                /bits/ 64 <0x28a668000 0x28a668003>;
            memory-region = <&ane_fw_text>, <&ane_fw_data>;
            memory-region-names = "firmware-text", "firmware-data";
            apple,firmware-iovas = /bits/ 64 <0x10000000000 0x100000c0000>;
            status = "disabled";
        };
    };
```
