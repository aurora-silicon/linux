## Documentation/devicetree/bindings/opp/operating-points-v2-apple-dram.yaml
```yaml
# SPDX-License-Identifier: (GPL-2.0-only OR BSD-2-Clause)
%YAML 1.2
---
$id: http://devicetree.org/schemas/opp/operating-points-v2-apple-dram.yaml#
$schema: http://devicetree.org/meta-schemas/core.yaml#

title: Apple firmware-managed DRAM performance states

maintainers:
  - Ryan Murray <ryan@aurorasilicon.org>

description: |
  DCS firmware state IDs are not clock rates. Describe every state with an
  explicit opp-level, independent of node order. Rates are optional except
  for the highest state. The maximum interface rate and data width are
  inferred from the interface topology and published bandwidth class.

  Lower-state rates derived from firmware bandwidth policy thresholds are
  inferences, not measured clocks. Those thresholds use Q16.16 decimal GB/s;
  they are not a frequency table. Leave lower-state rates absent until the
  inference is accepted or independently confirmed by a public decoder.

  opp-hz is CK-equivalent Hz, rounded upwards to the nearest integer, one
  half of the interface transfer rate. It does not claim a literal command
  clock or LPDDR5 WCK. These OPPs describe firmware states for reporting;
  they do not authorize Linux to change clocks, voltages, or firmware votes.

allOf:
  - $ref: opp-v2-base.yaml#

properties:
  compatible:
    const: operating-points-v2-apple-dram

  opp-shared: true

patternProperties:
  '^opp(-?[0-9]+)*$':
    type: object
    additionalProperties: false

    properties:
      opp-level:
        minimum: 0
        maximum: 31

      opp-hz:
        maxItems: 1

      apple,data-rate:
        $ref: /schemas/types.yaml#/definitions/uint64
        minimum: 1
        description: Interface transfers per second per data pin, rounded to an integer.

    required:
      - opp-level

    dependencies:
      apple,data-rate:
        - opp-hz
      opp-hz:
        - apple,data-rate

required:
  - compatible

additionalProperties: false

examples:
  - |
    opp-table-dram {
        compatible = "operating-points-v2-apple-dram";
        opp-shared;
        opp-0 {
            opp-level = <0>;
        };
        opp-1 {
            opp-level = <1>;
            opp-hz = /bits/ 64 <3200000000>;
            apple,data-rate = /bits/ 64 <6400000000>;
        };
    };
```

## Documentation/devicetree/bindings/pci/apple,apif-pcie.yaml
```yaml
# SPDX-License-Identifier: GPL-2.0-only
%YAML 1.2
---
$id: http://devicetree.org/schemas/pci/apple,apif-pcie.yaml#
$schema: http://devicetree.org/meta-schemas/core.yaml#

title: Preinitialized Apple PCIe host in an Aura guest
maintainers:
  - Dj <hey@djdev.me>

description: |
  The boot producer configures the controller, PHY, link, apertures and
  RID-to-SID routing before guest entry. It disables endpoint bus mastering
  and MSI before transferring ownership. Linux uses ECAM and allocates MSI
  from the native AIC range; it does not run raw cold-init register sequences.

allOf:
  - $ref: /schemas/pci/pci-host-bridge.yaml#
  - if:
      properties:
        compatible:
          contains:
            const: apple,t6050-pcie-apif
    then:
      required:
        - apple,rid-to-sid
        - max-link-speed
        - num-lanes
      properties:
        reg:
          minItems: 5
        reg-names:
          minItems: 5
    else:
      properties:
        reg:
          maxItems: 1
        reg-names:
          maxItems: 1
        apple,rid-to-sid: false

properties:
  compatible:
    oneOf:
      - const: apple,apif-pcie
      - items:
          - const: apple,t6050-pcie-apif
          - const: apple,apif-pcie
  reg:
    minItems: 1
    items:
      - description: ECAM configuration window
      - description: T6050 port-0 control registers, at least 32 KiB
      - description: T6050 port-0 PHY registers, at least 16 KiB
      - description: Active-low PERST pad register, at least four bytes
      - description: T6050 interrupt-to-AXI registers, at least 16 KiB
  reg-names:
    minItems: 1
    items:
      - const: ecam
      - const: port
      - const: phy
      - const: perst
      - const: intr2axi
  apple,preinitialized:
    type: boolean
    description: Controller is initialized and endpoint DMA/MSI is stopped
  apple,msi-address:
    $ref: /schemas/types.yaml#/definitions/uint64
    description: Native MSI doorbell; 4 KiB aligned for the T6050 layout
  msi-ranges:
    maxItems: 1
    description: One four-cell native AIC edge interrupt range and vector count
  apple,rid-to-sid:
    $ref: /schemas/types.yaml#/definitions/uint32-matrix
    minItems: 1
    maxItems: 15
    items:
      items:
        - description: Hardware routing slot
          minimum: 1
          maximum: 15
        - description: Requester ID
          maximum: 65535
        - description: Firmware-assigned DART stream ID
          maximum: 255
    description: Restore existing routing after the optional preboot port cycle
  iommu-map: true
  iommu-map-mask: true
  max-link-speed:
    const: 3
  num-lanes:
    const: 1
  dma-coherent: true

patternProperties:
  '^apple,(apcie-config|pcie-rc|pcie-rc-gen[345]-shadow)-tunables$':
    $ref: /schemas/types.yaml#/definitions/uint32-matrix
    maxItems: 16
    items:
      items:
        - description: Register offset
        - const: 4
        - description: Clear mask
        - description: Set mask
    description: Boot-producer register tuples for the matched layout

required:
  - compatible
  - reg
  - reg-names
  - ranges
  - bus-range
  - apple,preinitialized
  - apple,msi-address
  - msi-ranges
  - iommu-map

unevaluatedProperties: false
```
