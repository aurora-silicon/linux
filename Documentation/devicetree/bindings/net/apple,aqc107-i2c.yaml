## Documentation/devicetree/bindings/net/apple,aqc107-i2c.yaml
```yaml
# SPDX-License-Identifier: (GPL-2.0-only OR BSD-2-Clause)
%YAML 1.2
---
$id: http://devicetree.org/schemas/net/apple,aqc107-i2c.yaml#
$schema: http://devicetree.org/meta-schemas/core.yaml#

title: Apple Aquantia Ethernet I2C sideband

maintainers:
  - Ryan Murray <81541646+RyanTheTide@users.noreply.github.com>

description: |
  The Ethernet controller exposes an I2C control interface in addition to
  its PCIe host interface. This node identifies the addressed sideband,
  not a second PCIe Ethernet controller.

properties:
  compatible:
    items:
      - enum:
          - apple,t8103-aqc107-i2c
          - apple,t6000-aqc107-i2c
      - const: apple,aqc107-i2c

  reg:
    maxItems: 1

required:
  - compatible
  - reg

additionalProperties: false
```

## Documentation/devicetree/bindings/net/bluetooth/apple,centauri.yaml
```yaml
# SPDX-License-Identifier: GPL-2.0-only
%YAML 1.2
---
$id: http://devicetree.org/schemas/net/bluetooth/apple,centauri.yaml#
$schema: http://devicetree.org/meta-schemas/core.yaml#

title: Apple N1 Centauri Beta Bluetooth PCI function

maintainers:
  - Dj <hey@djdev.me>

description: |
  PCI function two is the Beta Bluetooth HCI/ACL transport. It depends on
  the Control function in the same PCI slot, which boots the shared N1
  firmware using the protocol profile described on its own DT node.
  The factory address is supplied in network byte order for the firmware
  address-provisioning command; HCI returns the standard Bluetooth order.

properties:
  compatible:
    const: pci106b,1903

  reg:
    maxItems: 1
    description: Standard five-cell PCI function address

  local-bd-address:
    $ref: /schemas/types.yaml#/definitions/uint8-array
    minItems: 6
    maxItems: 6
    description: Factory Bluetooth public address, least significant byte
      first (the standard Bluetooth property a boot loader fills)

  local-mac-address:
    $ref: /schemas/types.yaml#/definitions/uint8-array
    minItems: 6
    maxItems: 6
    description: Factory Bluetooth public address in network byte order

oneOf:
  - required: [local-bd-address]
  - required: [local-mac-address]

required:
  - compatible
  - reg

additionalProperties: false
```

## Documentation/devicetree/bindings/net/nfc/apple,spmi-nfc.yaml
```yaml
# SPDX-License-Identifier: (GPL-2.0-only OR BSD-2-Clause)
%YAML 1.2
---
$id: http://devicetree.org/schemas/net/nfc/apple,spmi-nfc.yaml#
$schema: http://devicetree.org/meta-schemas/core.yaml#

title: Apple SPMI NFC peripheral

maintainers:
  - Ryan Murray <81541646+RyanTheTide@users.noreply.github.com>

description: |
  SPMI NFC peripheral resources. The address is a unique slave identifier on
  its parent bus. Register access and protocol support are separate from
  describing the peripheral and its interrupt resources.

select:
  properties:
    compatible:
      contains:
        enum:
          - apple,t6020-spmi-nfc
          - apple,t6021-spmi-nfc
          - apple,t6022-spmi-nfc
          - apple,t8112-spmi-nfc
  required:
    - compatible

properties:
  compatible:
    items:
      - enum:
          - apple,t6020-spmi-nfc
          - apple,t6021-spmi-nfc
          - apple,t6022-spmi-nfc
          - apple,t8112-spmi-nfc
      - const: apple,spmi-nfc

  reg:
    maxItems: 1

  interrupts:
    maxItems: 7

required:
  - compatible
  - reg

additionalProperties: false
```

## Documentation/devicetree/bindings/net/nfc/apple,stockholm-nci.yaml
```yaml
# SPDX-License-Identifier: (GPL-2.0-only OR BSD-2-Clause)
%YAML 1.2
---
$id: http://devicetree.org/schemas/net/nfc/apple,stockholm-nci.yaml#
$schema: http://devicetree.org/meta-schemas/core.yaml#

title: Apple Stockholm NFC controller and Secure Element over SPMI

maintainers:
  - Ryan Murray <81541646+RyanTheTide@users.noreply.github.com>

description: |
  Stockholm is an NCI NFC controller with an embedded Secure Element,
  connected to the SoC as a follower on a dedicated SPMI bus. NCI packets
  are written to and read from non-incrementing FIFO registers of the
  follower. The follower raises host-wake, data-ready and error interrupts
  through the SPMI controller, and an enable line (VEN) selects between
  operation and the controller's deepest power state.

properties:
  compatible:
    const: apple,stockholm-nci

  reg:
    maxItems: 1

  interrupts:
    items:
      - description: host wake request from the controller
      - description: NCI packet ready in the receive FIFO
      - description: transport error

  interrupt-names:
    items:
      - const: host-wake
      - const: data-ready
      - const: error

  enable-gpios:
    maxItems: 1
    description: VEN, the controller's enable line; low is its deepest power state.

required:
  - compatible
  - reg
  - interrupts
  - interrupt-names
  - enable-gpios

additionalProperties: false

examples:
  - |
    #include <dt-bindings/gpio/gpio.h>
    #include <dt-bindings/interrupt-controller/irq.h>
    #include <dt-bindings/spmi/spmi.h>

    spmi {
        #address-cells = <2>;
        #size-cells = <0>;

        nfc@9 {
            compatible = "apple,stockholm-nci";
            reg = <9 SPMI_USID>;
            interrupts = <229 IRQ_TYPE_EDGE_RISING>,
                         <230 IRQ_TYPE_EDGE_RISING>,
                         <227 IRQ_TYPE_EDGE_RISING>;
            interrupt-names = "host-wake", "data-ready", "error";
            enable-gpios = <&smc_gpio 14 GPIO_ACTIVE_HIGH>;
        };
    };
```

## Documentation/devicetree/bindings/net/nfc/apple,stockholm-spmi-v1.yaml
```yaml
# SPDX-License-Identifier: (GPL-2.0-only OR BSD-2-Clause)
%YAML 1.2
---
$id: http://devicetree.org/schemas/net/nfc/apple,stockholm-spmi-v1.yaml#
$schema: http://devicetree.org/meta-schemas/core.yaml#

title: Apple first-generation Stockholm SPMI endpoint

maintainers:
  - Ryan Murray <81541646+RyanTheTide@users.noreply.github.com>

description: |
  The first-generation Stockholm endpoint occupies one SPMI slave address.
  It is distinct from the later model-96 transport. Firmware command
  sequences and an OS ownership handoff are not part of this description.

properties:
  compatible:
    oneOf:
      - items:
          - const: apple,t6000-stockholm-spmi-v1
          - const: apple,stockholm-spmi-v1

      - items:
          - const: apple,t8103-stockholm-spmi-v1
          - const: apple,stockholm-spmi-v1

  reg:
    maxItems: 1

required:
  - compatible
  - reg

additionalProperties: false
```

## Documentation/devicetree/bindings/net/nfc/apple,stockholm-spmi.yaml
```yaml
# SPDX-License-Identifier: (GPL-2.0-only OR BSD-2-Clause)
%YAML 1.2
---
$id: http://devicetree.org/schemas/net/nfc/apple,stockholm-spmi.yaml#
$schema: http://devicetree.org/meta-schemas/core.yaml#

title: Apple first-generation Stockholm SPMI endpoint

maintainers:
  - Ryan Murray <81541646+RyanTheTide@users.noreply.github.com>

description: |
  The endpoint occupies an SPMI follower address and exports seven event
  interrupts, of which three have a known role: the transport error, host
  wake and receive data ready. VEN enables the controller.

properties:
  compatible:
    items:
      - enum:
          - apple,t8103-stockholm-spmi
          - apple,t6000-stockholm-spmi
          - apple,t8112-stockholm-spmi
      - const: apple,stockholm-spmi

  reg:
    maxItems: 1

  interrupts:
    minItems: 7
    maxItems: 7

  interrupt-names:
    items:
      - const: event0
      - const: event1
      - const: event2
      - const: error
      - const: event4
      - const: host-wake
      - const: data-ready

  enable-gpios:
    maxItems: 1
    description: VEN, the controller enable line.

required:
  - compatible
  - reg
  - interrupts

additionalProperties: false
```

## Documentation/devicetree/bindings/net/nfc/apple,stockholm.yaml
```yaml
# SPDX-License-Identifier: (GPL-2.0-only OR BSD-2-Clause)
%YAML 1.2
---
$id: http://devicetree.org/schemas/net/nfc/apple,stockholm.yaml#
$schema: http://devicetree.org/meta-schemas/core.yaml#

title: Apple Stockholm NFC controller over SPMI

maintainers:
  - Ryan Murray <81541646+RyanTheTide@users.noreply.github.com>

description: |
  Stockholm is an NCI NFC controller and embedded Secure Element connected as
  an SPMI follower. NCI frames are transferred through a non-incrementing FIFO
  register. A separate enable GPIO controls the deepest power state.

properties:
  compatible:
    const: apple,stockholm-nci

  reg:
    maxItems: 1

  interrupts:
    minItems: 3
    maxItems: 3

  interrupt-names:
    items:
      - const: host-wake
      - const: data-ready
      - const: error

  enable-gpios:
    maxItems: 1
    description: VEN, the controller's enable line; low is its deepest power state.

  apple,transport-crc16:
    type: boolean
    description: NCI frames carry the standard big-endian CRC-CCITT trailer.

required:
  - compatible
  - reg
  - interrupts
  - interrupt-names
  - enable-gpios

additionalProperties: false

examples:
  - |
    #include <dt-bindings/gpio/gpio.h>
    #include <dt-bindings/interrupt-controller/irq.h>
    #include <dt-bindings/spmi/spmi.h>

    spmi {
        #address-cells = <2>;
        #size-cells = <0>;

        nfc@9 {
            compatible = "apple,stockholm-nci";
            reg = <9 SPMI_USID>;
            interrupts = <229 IRQ_TYPE_EDGE_RISING>,
                         <230 IRQ_TYPE_EDGE_RISING>,
                         <227 IRQ_TYPE_EDGE_RISING>;
            interrupt-names = "host-wake", "data-ready", "error";
            enable-gpios = <&smc_gpio 14 GPIO_ACTIVE_HIGH>;
        };
    };
```

## Documentation/devicetree/bindings/net/wireless/apple,centauri.yaml
```yaml
# SPDX-License-Identifier: GPL-2.0-only
%YAML 1.2
---
$id: http://devicetree.org/schemas/net/wireless/apple,centauri.yaml#
$schema: http://devicetree.org/meta-schemas/core.yaml#

title: Apple N1 Centauri Control PCI function

maintainers:
  - Dj <hey@djdev.me>

description: |
  PCI function zero owns the shared N1 firmware bootstrap. The boot producer
  supplies the personalized FTAB filename and packed firmware platform ID.
  The endpoint must be left in its stopped ROM personality with DMA and MSI
  quiesced. The host's root-port reset retrains the link after the ROM
  bootstrap. This binding does not authorize adopting an existing live
  firmware session or releasing another owner's retained DART streams.

  The T8142 native transport uses the same PCI function IDs but is a
  different firmware profile. Its SoC-specific compatible identifies this
  binding profile; the generic PCI compatible is retained as the fallback.
  Runtime driver selection continues to use the PCI ID and host SoC, and the
  native driver selects personalized firmware and transport data from its
  root-board match table rather than the T6050 wire-protocol properties.

properties:
  compatible:
    oneOf:
      - enum:
          - pci106b,1900
          - pci106b,1901
      - items:
          - const: apple,t8142-centauri-control
          - const: pci106b,1900

  reg:
    maxItems: 1
    description: Standard five-cell PCI function address

  firmware-name:
    $ref: /schemas/types.yaml#/definitions/string
    description: Personalized FTAB including the required per-device calibration

  apple,centauri-platform-id:
    $ref: /schemas/types.yaml#/definitions/uint32
    description: Firmware chip ID in bits 15..0 and board ID in bits 30..16

  apple,centauri-protocol:
    $ref: /schemas/types.yaml#/definitions/uint32
    const: 27
    description: Shared firmware wire protocol profile

allOf:
  - if:
      properties:
        compatible:
          contains:
            const: apple,t8142-centauri-control
    then:
      properties:
        firmware-name: false
        apple,centauri-platform-id: false
        apple,centauri-protocol: false
    else:
      required:
        - firmware-name
        - apple,centauri-platform-id
        - apple,centauri-protocol

required:
  - compatible
  - reg

additionalProperties: false
```
