## drivers/soc/apple/Kconfig
```kconfig
# SPDX-License-Identifier: GPL-2.0-only

if ARCH_APPLE || COMPILE_TEST

menu "Apple SoC drivers"

config APPLE_DBGVIEW
	tristate "Apple SoC read-only debug register views"
	depends on ARCH_APPLE || COMPILE_TEST
	depends on ARM64 && OF && DEBUG_FS
	help
	  Root-only debugfs views of Apple SoC debug register blocks: the
	  interrupt controller timebase, the debug dock connection
	  status and the unused DWI interface of T6000, T8112 and T8140.
	  The driver only reads registers, and only when a debugfs file is
	  read.

	  Say m here if you debug an Apple SoC.

config APPLE_DOCKCHANNEL
	tristate "Apple DockChannel FIFO"
	depends on ARCH_APPLE || COMPILE_TEST
	help
	  DockChannel is a simple FIFO used on Apple SoCs for debug and inter-processor
	  communications.

	  Say 'y' here if you have an Apple SoC.

config APPLE_MAILBOX
	tristate "Apple SoC mailboxes"
	depends on PM
	depends on ARCH_APPLE || (64BIT && COMPILE_TEST)
	help
	  Apple SoCs have various co-processors required for certain
	  peripherals to work (NVMe, display controller, etc.). This
	  driver adds support for the mailbox controller used to
	  communicate with those.

	  Say Y here if you have an Apple SoC.

config APPLE_MCC
	tristate "Apple T8140 and T6040 system level cache"
	depends on ARCH_APPLE || COMPILE_TEST
	depends on OF
	default ARCH_APPLE
	help
	  The boot firmware of the Apple T8140 and T6040 SoCs enables the
	  system level cache without letting it allocate. This driver allows
	  allocation once the devices that took over DMA from the bootloader
	  are bound.

	  Say 'y' or 'm' here if you have an Apple T8140 or T6040 SoC.

config APPLE_MCC_KUNIT_TEST
	bool "KUnit tests for Apple MCC allocation and unwind" if !KUNIT_ALL_TESTS
	depends on APPLE_MCC=y && KUNIT=y
	default KUNIT_ALL_TESTS
	help
	  Test allocation failure after a plane has been enabled, and cache
	  handoff on shutdown, using simulated registers. Verify that failure
	  also cleans up the plane whose state is uncertain. These tests do not
	  access physical hardware and are only useful for kernel developers.

config APPLE_PMGR_MISC
	tristate "Apple SoC PMGR miscellaneous support"
	depends on PM
	select INTERCONNECT
	help
	  The PMGR block in Apple SoCs provides high-level power state
	  controls for SoC devices. This driver manages miscellaneous
	  power controls.

	  Say 'y' here if you have a Pro/Max/Ultra Apple SoC.

config APPLE_PMGR_DCS_KUNIT_TEST
	bool "KUnit tests for Apple PMGR DCS voting" if !KUNIT_ALL_TESTS
	depends on KUNIT=y && APPLE_PMGR_MISC=y
	default KUNIT_ALL_TESTS
	help
	  Test bandwidth aggregation, explicit OPP selection, ownership gates,
	  register updates and timeout rollback with synthetic state data.
	  Also verify that boot constraints and concurrent endpoints retain
	  their votes, and that suspend restores the last confirmed request.

config APPLE_CLUSTER_PWRGATE
	bool "Apple SoC CPU cluster power gates"
	depends on OF
	default ARCH_APPLE
	help
	  Sets the power-gate enable of each CPU cluster the device tree
	  lists, early in boot. Without it, a core that the boot loader
	  started and PMGR never powered on, such as the boot CPU, only
	  clock-gates in WFI.

config APPLE_SLEEP_REGISTRY
	bool
	depends on ARM64

config APPLE_SOC_SLEEP
	bool "Apple SoC system sleep at EL2"
	default APPLE_T8140_SLEEP
	depends on ARM64 && (ARCH_APPLE || COMPILE_TEST)
	depends on HOTPLUG_CPU && SUSPEND
	select APPLE_SLEEP_REGISTRY
	select APPLE_TUNABLE
	help
	  Powers the secondary CPUs off and suspends the system to RAM on an
	  Apple SoC whose kernel runs directly at EL2, with no monitor to ask.
	  It does nothing unless the boot object asks for it through
	  /chosen/aurora,s2r-mailbox.

	  Only SoCs whose sleep has been measured and tested are supported,
	  each by its match data: today T8140. On every other SoC the driver
	  doesn't bind, and s2idle stays the only system sleep.

config APPLE_SOC_SLEEP_KUNIT_TEST
	bool "KUnit tests for the Apple SoC sleep match data" if !KUNIT_ALL_TESTS
	depends on APPLE_SOC_SLEEP && KUNIT=y
	default KUNIT_ALL_TESTS
	help
	  Checks each matched SoC's sleep data: that only tested SoCs are
	  matched, that every list names only words of the SoC's full lists,
	  with no duplicates, and that the lists fit the driver's books. The
	  tests touch no hardware.

	  If unsure, say N.

config APPLE_T6040_SLEEP
	bool "Apple T6040 system sleep (refusal-first)"
	depends on ARM64 && (ARCH_APPLE || COMPILE_TEST)
	depends on HOTPLUG_CPU && SUSPEND
	depends on MFD_MACSMC=y
	select APPLE_SLEEP_REGISTRY
	select MFD_SYSCON
	select APPLE_TUNABLE
	help
	  The T6040 (M4 Pro) suspend-to-RAM controller, still a separate
	  driver next to APPLE_SOC_SLEEP until the T6040 becomes match data
	  there. It registers a suspend handler that enumerates every
	  blocker in the live state (EL2, the boot object's return path, the
	  CPUs that can park, the display power states macOS checks before it
	  sleeps). Unless t6040_sleep.allow_entry=1 is given and no blocker
	  remains, a suspend request prints the blockers and enters nothing.
	  With it the SoC is powered down to suspend-to-RAM and comes back
	  through the boot object; the AON watchdog is the net over the
	  whole cycle (t6040_sleep.sleep_wd_secs at the power-down itself).

	  It keeps the coprocessor and enclave registry for the T6040, so
	  the drivers that leave their last stop to the sleep's commit (ANS,
	  the PMP, the SEP) can register, and offers dry runs: with
	  t6040_sleep.dry_run=1 every driver's firmware-driven sleep step that
	  can be taken back runs, the CPUs park and are held, and the sleep is
	  refused at the commit point and resumed warm.

	  It shares the registry with APPLE_SOC_SLEEP, and both can be built
	  into one kernel: each binds only to its own SoC.

config APPLE_RTKIT
	tristate "Apple RTKit co-processor IPC protocol"
	depends on APPLE_MAILBOX
	depends on ARCH_APPLE || COMPILE_TEST
	help
	  Apple SoCs such as the M1 come with various co-processors running
	  their proprietary RTKit operating system. This option enables support
	  for the protocol library used to communicate with those. It is used
	  by various client drivers.

	  Say 'y' here if you have an Apple SoC.

config APPLE_RTKIT_HELPER
	tristate "Apple Generic RTKit helper co-processor"
	depends on APPLE_RTKIT
	depends on ARCH_APPLE || COMPILE_TEST
	help
	  Apple SoCs such as the M1 come with various co-processors running
	  their proprietary RTKit operating system. This option enables support
	  for a generic co-processor that does not implement any additional
	  in-band communications. It can be used for testing purposes, or for
	  coprocessors such as MTP that communicate over a different interface.

	  Say 'y' here if you have an Apple SoC.

config APPLE_SART
	tristate "Apple SART DMA address filter"
	depends on ARCH_APPLE || COMPILE_TEST
	help
	  Apple SART is a simple DMA address filter used on Apple SoCs such
	  as the M1. It is usually required for the NVMe coprocessor which does
	  not use a proper IOMMU.

	  Say 'y' here if you have an Apple SoC.

config APPLE_TUNABLE
	tristate
	depends on ARCH_APPLE || COMPILE_TEST

config RUST_APPLE_MAILBOX
	bool
	depends on PM
	depends on RUST
	select APPLE_MAILBOX

config RUST_APPLE_RTKIT
	bool
	depends on PM
	depends on RUST
	select APPLE_RTKIT
	select RUST_APPLE_MAILBOX

config APPLE_AOP
	tristate "Apple \"Always-on\" Processor"
	depends on ARCH_APPLE || COMPILE_TEST
	depends on PM
	depends on RUST
	select RUST_APPLE_RTKIT
	select RUST_APPLE_MAILBOX
	select RUST_FW_LOADER_ABSTRACTIONS
	help
	  A co-processor persent on certain Apple SoCs controlling accelerometers,
	  gyros, ambient light sensors and microphones. Is not actually always on.

	  Say 'y' here if you have an Apple laptop.

config APPLE_SEP_FV_INTERFACE
	bool

config APPLE_SEP
	tristate "Apple SEP (Secure Enclave Processor)"
	default m if ARCH_APPLE
	depends on ARCH_APPLE
	depends on PM
	depends on RUST
	depends on DMA_SHARED_BUFFER
	depends on OF_DYNAMIC
	depends on SPI
	depends on RUST_APPLE_MAILBOX
	depends on HW_RANDOM
	depends on TRUSTED_KEYS
	depends on CRYPTO
	depends on MFD_MACSMC || !MFD_MACSMC
	# apple_pmp_cold_restarts(): a resume from disk on a cold boot.
	depends on APPLE_PMP || !APPLE_PMP
	select CRYPTO_HMAC
	select CRYPTO_SHA256
	select CRYPTO_AES
	select CRYPTO_GCM
	select CRYPTO_ECDH
	select APPLE_SEP_FV_INTERFACE
	select RUST_FW_LOADER_ABSTRACTIONS
	help
	  Driver for the Apple SEP (Secure Enclave Processor) on Apple silicon.
	  It drives the Touch ID fingerprint sensor over a /dev/sep-bio character
	  device (enrol and match), exposes the SEP hardware RNG, and registers a
	  SEP-backed trusted key source so keyctl can seal keys to the enclave.

	  The driver reads the existing machine-wide xART gigalocker directly from
	  the iBoot system container, locating its .gl extent through read-only,
	  checksum-validated APFS metadata. It validates the complete store and
	  both root records before registering with SEP.
	  xART writes are enabled by default, but accepted only when the driver
	  validates the physical extent ownership invariants. Unsupported APFS
	  layouts fail closed. A Linux identity keybag is created automatically
	  when none exists; existing identities and reference keys are retained.
	  Set xart_writes=0 provision_keybag=0 for read-only operation.
	  With writes off the driver still attaches, but refuses Touch ID enrol
	  and verify: the enclave saves anti-replay state after every match.

	  Say Y here if you have an Apple silicon Mac.

config APPLE_SEP_KUNIT_TEST
	bool "KUnit tests for the Apple SEP driver" if !KUNIT_ALL_TESTS
	depends on APPLE_SEP && KUNIT
	default KUNIT_ALL_TESTS
	help
	  Build KUnit tests for the pure logic of the Apple SEP driver: the
	  mailbox message encoding and decoding, the shared-memory registration
	  limits, the rules that keep a keybag's lookup identity apart from
	  the identity the enclave reports, the format and validation of the
	  Linux host-state store, the xART guard's decisions and its list
	  of Linux's records, and how the fingerprint sensor is put to sleep.
	  The tests touch no hardware.

	  If unsure, say N.

config APPLE_SEP_KEY_RESEARCH
	bool "Apple SEP: /dev/sep-key context-reuse measurements (research only)"
	depends on APPLE_SEP
	help
	  Build the SEP_KEY_SELFTEST modes that run a second key operation in
	  a credential context a Touch ID match has satisfied (modes 20 and
	  21). They measure what the enclave allows; a production kernel never
	  issues more than one operation per match, and without this option
	  the code that could do so is not built at all. The modes still need
	  root and the key_selftest module parameter.

	  Say N unless you are measuring the enclave on a lab machine.

config APPLE_PMP
	tristate "Apple Power Management Processor"
	depends on ARCH_APPLE || COMPILE_TEST
	depends on RUST
	select APPLE_PMP_REPORT
	select RUST_APPLE_RTKIT
	default y if ARCH_APPLE
	help
	  A co-processor present on Apple SoCs, controlling power states of
	  fabric and other uncore components.

	  Say 'y' here if you have an Apple SoC.

config APPLE_T8132_PLATFORM_HANDOFF
	bool "Apple T8132 legacy platform description compatibility"
	depends on ARCH_APPLE || COMPILE_TEST
	depends on OF_DYNAMIC && OF_FLATTREE
	default y if APPLE_PMP
	help
	  Supply missing cache and PMC descriptions, and the J713 board's PMGR
	  availability/ownership policy, for the original loader tree before devices
	  are populated. Native memory-controller descriptions take precedence.
	  Required for that legacy tree to keep inaccessible PMGR domains from
	  probing; kernels using the complete J713 DT do not require this adapter.

config APPLE_T8132_PLATFORM_KUNIT_TEST
	tristate "KUnit tests for T8132 platform descriptions" if !KUNIT_ALL_TESTS
	depends on KUNIT && APPLE_T8132_PLATFORM_HANDOFF
	default KUNIT_ALL_TESTS
	help
	  Check live OF descriptions after the compatibility initcall runs.
	  Tests require a J713 description; a QEMU fixture can supply a legacy
	  tree without enabling any Apple hardware drivers. These tests only
	  read metadata and never access the described MMIO resources.

config APPLE_REGVIEW
	tristate "Apple SoC read-only register views"
	depends on ARCH_APPLE || COMPILE_TEST
	depends on OF && DEBUG_FS
	help
	  Exposes fixed lists of registers of Apple SoC blocks that have no
	  functional driver, such as the memory cache controller, as
	  read-only files under /sys/kernel/debug/apple-regview. The driver never writes to these
	  blocks. Only registers known to be safe to read are listed.

	  This is a development aid. If unsure, say 'n'.

config APPLE_CLPC
	tristate "Apple host performance controller floors"
	depends on ARCH_APPLE || COMPILE_TEST
	depends on APPLE_PMC && CPU_FREQ
	depends on MFD_MACSMC || !MFD_MACSMC
	select ACPI_PLATFORM_PROFILE if ACPI
	default ARCH_APPLE
	help
	  Raises the DRAM controller and SoC fabric performance floors of the
	  host's PMC voter agent while CPU clusters are busy, and releases
	  them at idle. On SoCs with power modes it also offers them as
	  platform profiles.

	  Say 'y' or 'm' here if you have an Apple SoC with a PMC.

config APPLE_AURA_HIBERNATE
	bool "Hibernation under an aura boot object"
	depends on ARCH_APPLE && HIBERNATION && OF_EARLY_FLATTREE
	default y
	help
	  Under aura, the boot loader and the firmware keep memory alive
	  below Linux's allocations, and on Apple M4 Pro boots the boot
	  firmware places it at a different address every time. With aura's fixed layout
	  (/chosen/aura,hibernate-layout) this keeps every reserved range out
	  of the hibernation image; without it, hibernation and resume are
	  refused instead of overwriting the running boot loader.

config APPLE_DISPLAY_GATE
	bool "Apple internal display enable gate"
	depends on ARCH_APPLE && OF_DYNAMIC && OF_OVERLAY
	default ARCH_APPLE
	help
	  The T6030 device tree keeps the internal display nodes disabled so
	  the display stays on the boot framebuffer until the boot loader has
	  validated the display handoff. This option enables those nodes
	  before devices are created once the boot loader has marked the
	  handoff as validated, and adds the power management processor
	  from a built-in overlay, with the values the boot loader passes
	  for this Mac (or, on a J516S whose boot loader passes none,
	  built-in ones). Without them it does nothing.
	  apple_t6030_display.enable=0 keeps the boot framebuffer.

	  The same gate serves T8122 (M3) device trees with
	  apple,t8122-handoff. There it adds no overlay: it completes the PMP,
	  report and requests the device tree describes, with the values the
	  boot loader passes, and the PMP report driver starts the PMP. It
	  enables the T8122 external display processor only when the boot
	  loader has marked it apple,t8122-dcpext-firmware-ready, and not with
	  nomodeset.

	  It also serves T6031 (M3 Max) device trees with apple,t6031-handoff,
	  in the same way and only with the PMP values the boot loader passes.
	  There the native display is on by default on the J516C, unless
	  apple_t6031_display.enable=0; the other T6031 boards need
	  apple_t6031_display.enable=1 on the kernel command line. The T6031
	  GPU driver starts its firmware only after this native display is
	  up, so apple_t6031_display.enable=0, or a native display that does
	  not come up, also keeps the GPU off for that boot. It is not a
	  display-only switch.

	  On T6041 (M4 Pro) device trees it enables the internal display nodes
	  only when the boot loader has handed the running display coprocessor
	  over (apple,t6041-handoff, 26.6.2 display firmware), and powers up
	  the J616s external display chain (HDMI, Type-C DisplayPort) once the
	  boot loader has given the external display processors their
	  firmware memory. Without these, or with nomodeset, it does nothing.
	  The external chain waits for the power management processor for as
	  long as its driver takes to bind, so that one loaded from an
	  encrypted root after the passphrase still brings the external
	  displays up. The Type-C ports work as USB ports after 20 seconds
	  meanwhile, and take the display routes once the chain is up.

	  Say 'y' if you want the native display on M3 Pro, M3 Max, M3 and
	  M4 Pro Macs.

config APPLE_T6030_GPU_PMP_LINK
	bool
	depends on APPLE_DISPLAY_GATE
	default n
	help
	  Link an opted-in T6030 GPU to the PMP admitted by the display gate.
	  GPU power commands wait for that supplier's acknowledged display
	  request through the existing PMP report startup and removal rules.

config APPLE_DISPLAY_GATE_KUNIT_TEST
	bool "KUnit tests for the Apple display gate" if !KUNIT_ALL_TESTS
	depends on KUNIT=y && APPLE_DISPLAY_GATE
	default KUNIT_ALL_TESTS
	help
	  Runs the display gate on test device trees with the T6030, T6031
	  and T8122 display nodes, without Apple hardware. On T6031: on by
	  default only on the default board (the J516C), otherwise only with
	  apple_t6031_display.enable=1, off with apple_t6031_display.enable=0,
	  only with the boot loader's handoff marker and this Mac's PMP values,
	  and with nothing changed when a check fails. On T6030: on by default, as
	  before, whatever the T6031 option says. On T8122: on by default,
	  and nothing changed when the handoff or the device tree's own PMP
	  topology does not check out. On T6041: a power management processor
	  that binds late still powers the external displays up. On the
	  J616c: each external display chain is enabled without a PMP once
	  its processor has firmware memory, and the display subsystem's
	  status is never written.

config APPLE_AURORA_BOOT_SECURITY
	tristate "Report how the boot chain verified this boot"
	depends on OF
	default y if ARCH_APPLE
	help
	  aura (Stage 1 and Stage 2) and U-Boot leave a record of what
	  each stage measured and verified in /chosen/aurora,boot-security,
	  together with what iBoot reports about the LocalPolicy that
	  admitted Stage 1. This driver logs the chain state at boot and
	  exposes it in /sys/firmware/aurora/boot_security/.

	  The record is the firmware's account, not a proof: it is only
	  called verified when an enforcing Stage 1 verified Stage 2.

config APPLE_AURORA_BOOT_SECURITY_LOCKDOWN
	bool "Lock the kernel down (integrity) on a verified boot"
	depends on APPLE_AURORA_BOOT_SECURITY=y && SECURITY_LOCKDOWN_LSM && EFI
	default y
	help
	  Raise lockdown to integrity when the firmware says this boot is
	  on the secure path: UEFI Secure Boot is enforcing (the SecureBoot
	  variable, or U-Boot's entry in the boot record), or the record's
	  chain is verified from an enforcing Stage 1 on. This is the
	  equivalent of locking down under UEFI Secure Boot on other
	  platforms. Unsigned modules, unsigned kexec, /dev/mem and similar
	  interfaces are then refused. A boot in audit or off mode is not
	  locked down by this option; lockdown= on the command line still
	  applies.

endmenu

endif

config APPLE_T8140_SLEEP
	bool
	transitional
	help
	  Transitional config for APPLE_T8140_SLEEP to APPLE_SOC_SLEEP migration.
```
