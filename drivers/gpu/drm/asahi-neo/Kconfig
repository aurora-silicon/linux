## drivers/gpu/drm/asahi-neo/Kconfig
```kconfig
# SPDX-License-Identifier: GPL-2.0
config DRM_ASAHI_NEO
	tristate "Asahi Neo (Apple T8140 G17 GPU)"
	depends on RUST && DRM=y
	depends on ARM64 && ARCH_APPLE && MMU && IOMMU_SUPPORT
	depends on PAGE_SIZE_16KB
	select RUST_DRM_SCHED
	select RUST_DRM_GEM_SHMEM_HELPER
	select RUST_DRM_GPUVM
	select RUST_APPLE_RTKIT
	select WANT_DEV_COREDUMP
	help
	  Native graphics support for the T8140 G17P GPU in the MacBook Neo.
	  Uses an independent command interface from the M1/M2/M3 driver.
```

## drivers/gpu/drm/asahi/Kconfig
```kconfig
# SPDX-License-Identifier: GPL-2.0

config RUST_DRM_SCHED
	bool
	select DRM_SCHED

config RUST_DRM_GPUVM
	bool
	select DRM_GPUVM

config DRM_ASAHI
	tristate "Aurora (DRM support for Apple AGX GPUs)"
	depends on RUST
	depends on DRM=y
	depends on (ARM64 && ARCH_APPLE) || (COMPILE_TEST && !GENERIC_ATOMIC64)
	depends on MMU
	depends on IOMMU_SUPPORT
	depends on PAGE_SIZE_16KB
	select APPLE_PMP_REPORT
	select RUST_DRM_SCHED
	select RUST_DRM_GEM_SHMEM_HELPER
	select RUST_DRM_GPUVM
	select RUST_APPLE_RTKIT
	select CRYPTO_LIB_SHA256
	help
	  DRM driver for Apple AGX GPUs, from the M1 family onwards.

	  To compile this driver as a module, choose M here: the module will
	  be called aurora. It keeps "asahi" as a module alias.

config DRM_ASAHI_G16
	bool "Apple M4 (G16G) support"
	depends on DRM_ASAHI && ARM64
	depends on DRM_APPLE=y || (DRM_APPLE=m && DRM_ASAHI=m)
	depends on DRM_APPLE_DCP_T8132
	depends on APPLE_PMP=y || APPLE_PMP=DRM_ASAHI
	depends on APPLE_CLPC=y || APPLE_CLPC=DRM_ASAHI || APPLE_CLPC=n
	depends on THERMAL_OF
	default y
	help
	  Backend for the M4 (T8132) GPU running the 25G83 firmware of
	  macOS 26.6.2, which the boot loader leaves loaded. The driver
	  binds when the GPU node appears and starts the firmware once the
	  PMP supplier, and a native display the boot loader handed over,
	  are up. The firmware session is retained until reboot and stays
	  running across suspend-to-idle.
	  A rendering VM pins about 0.7 GiB. An aborted receipt disables
	  that command class until reboot.

config DRM_ASAHI_G18
	bool "Apple M6 (G18G, T8152) support (experimental)"
	depends on DRM_ASAHI && ARM64
	select WANT_DEV_COREDUMP
	help
	  Backend for the Mac mini M6 (J873) GPU and its 26A428 firmware.
	  The GPU is started only when the boot loader reports the matching
	  firmware images and enables both GFX coprocessor mailboxes; the
	  firmware session and its memory are then retained until reboot.
	  Submission is synchronous: every command retires before the next
	  one starts. The module parameters prefixed g18_ select the bring-up
	  stage and the admitted command envelope.
config DRM_ASAHI_M5
	bool "Apple M5 (G17G, T8142) support (experimental)"
	depends on DRM_ASAHI && ARM64
	help
	  Backend for the M5 GPU (J813 MacBook Air) running the 25G76
	  firmware (RTKit-3255.160.4), as loaded and published by the aura
	  boot loader (/chosen/aurora,m5-gpu-firmware-profile).

config DRM_ASAHI_DEBUG_ALLOCATOR
	bool "Use debug allocator"
	depends on DRM_ASAHI
	help
	  Use an alternate, simpler allocator which significantly reduces
	  performance, but can help find firmware- or GPU-side memory safety
	  issues. However, it can also trigger firmware bugs more easily,
	  so expect GPU crashes.

	  Say N unless you are debugging firmware structures or porting to a
	  new firmware version.

config DRM_ASAHI_M3_T8122
	bool "M3 MacBook Air GPU runtime (T8122, 14.8.3 firmware)"
	depends on DRM_ASAHI
	# The runtime adopts the firmware's UAT through the G15 backend's handoff helpers.
	depends on DRM_ASAHI_G15
	select CRYPTO_LIB_SHA256
	default n
	help
	  Build the M3 runtime that starts the GPU of the M3 MacBook Air
	  (J613, J615) on the 14.8.3 GPU firmware the boot loader leaves
	  loaded. On the listed Air boards it starts after the boot loader
	  handed the GPU over and resource/firmware identity checks pass.
	  asahi.t8122_start=0 keeps startup disabled for recovery. Unknown
	  boards and firmware do not gain automatic admission. Other GPUs
	  are not affected.

config DRM_ASAHI_G15
	bool "Apple M3 Pro/Max (G15) support"
	depends on DRM_ASAHI
	depends on DRM_APPLE=y || (DRM_APPLE=m && DRM_ASAHI=m)
	select APPLE_T6030_GPU_PMP_LINK
	select CRYPTO_LIB_SHA256
	default y
	help
	  Backend for the M3 Pro (T6030) and M3 Max (T6031) GPUs on the
	  boards and firmware it admits. The driver binds when the boot
	  loader enables the GPU node and starts the firmware once the
	  native display is up. The firmware session is retained until
	  reboot. Other GPUs keep the maintained backend.
	  The native display driver must be built in, or both drivers must
	  be modules, so a modular display provider finishes initialization
	  before the GPU module can probe through its direct helper import.
```

## drivers/hid/dockchannel-hid/Kconfig
```kconfig
# SPDX-License-Identifier: GPL-2.0-only OR MIT
menu "DockChannel HID support"
	depends on APPLE_DOCKCHANNEL

config HID_DOCKCHANNEL
	tristate "HID over DockChannel transport layer for Apple Silicon SoCs"
	depends on APPLE_DOCKCHANNEL && APPLE_RTKIT_HELPER && INPUT && OF && HID
	depends on MFD_MACSMC || !MFD_MACSMC
	help
	  Say Y here if you use an M2 or later Apple Silicon based laptop.
	  The keyboard and touchpad are HID based devices connected via the
	  proprietary DockChannel interface.

	  The MTP coprocessor announces the keyboard and touchpad only when
	  it boots, so the driver cannot be unbound and rebound, or built as
	  a module and reloaded, without losing both until the next boot.

config HID_DOCKCHANNEL_KUNIT_TEST
	tristate "KUnit tests for the DockChannel HID protocol helpers" if !KUNIT_ALL_TESTS
	depends on KUNIT && HID_DOCKCHANNEL
	default KUNIT_ALL_TESTS
	help
	  Build the KUnit tests for the DockChannel HID protocol helpers,
	  which check the encoding of the MTP power commands. They need no
	  Apple hardware. For more information on KUnit and unit tests in
	  general, refer to Documentation/dev-tools/kunit/.

	  If unsure, say N.

config HID_DOCKCHANNEL_PARSER_KUNIT_TEST
	bool "KUnit tests for DockChannel HID message parsing" if !KUNIT_ALL_TESTS
	depends on HID_DOCKCHANNEL && KUNIT=y
	default KUNIT_ALL_TESTS
	help
	  Build tests that pass malformed MTP frames to the initialization,
	  input-report, firmware-container and acknowledgment handlers. Cover
	  short headers, oversized lengths, interface indices, raw touchscreen
	  reports and acknowledgment identity. The tests run without a
	  DockChannel or HID device.

endmenu
```

## drivers/hid/spi-hid/Kconfig
```kconfig
# SPDX-License-Identifier: GPL-2.0-only
menu "SPI HID support"
	depends on SPI

config SPI_HID_APPLE_OF
	tristate "HID over SPI transport layer for Apple Silicon SoCs"
	depends on INPUT && OF
	select SPI_HID_APPLE_CORE
	help
	  Say Y here if you use Apple Silicon based laptop. The keyboard and
	  touchpad are HID based devices connected via SPI.

	  If unsure, say N.

	  This support is also available as a module.  If so, the module
	  will be called spi-hid-apple-of. It will also build/depend on the
	  module spi-hid-apple.

endmenu

config SPI_HID_APPLE_CORE
	tristate
	select HID
	select CRC16

config SPI_HID_APPLE_KUNIT_TEST
	bool "KUnit tests for the Apple SPI HID transport" if !KUNIT_ALL_TESTS
	depends on KUNIT=y && SPI && INPUT
	select SPI_HID_APPLE_CORE
	default KUNIT_ALL_TESTS
	help
	  Test get-report recovery with a fake SPI controller, including bad
	  status, dropped and stale replies, and bounded reply copies.
	  The tests use synthetic reports and do not access any hardware.
	  Run them with tools/testing/kunit/kunit.py and the .kunitconfig
	  in drivers/hid/spi-hid.
```

## drivers/iio/common/aop_sensors/Kconfig
```kconfig
# SPDX-License-Identifier: GPL-2.0-only OR MIT

config IIO_AOP_SENSOR_LAS
	tristate "AOP Lid angle sensor"
	depends on ARCH_APPLE || COMPILE_TEST
	depends on RUST
	depends on SYSFS
	select APPLE_AOP
	help
	  Module to handle the lid angle sensor attached to the AOP
	  coprocessor on Apple laptops.

config IIO_AOP_SENSOR_ALS
	tristate "AOP Ambient light sensor"
	depends on ARCH_APPLE || COMPILE_TEST
	depends on RUST
	depends on SYSFS
	select APPLE_AOP
	select RUST_FW_LOADER_ABSTRACTIONS
	help
	  Module to handle the ambient light sensor attached to the AOP
	  coprocessor on Apple laptops.

config IIO_AOP_SENSOR_MOTION
	tristate "AOP accelerometer and gyroscope"
	depends on ARCH_APPLE || COMPILE_TEST
	depends on RUST
	depends on SYSFS
	select APPLE_AOP
	select IIO_BUFFER
	select IIO_TRIGGERED_BUFFER
	help
	  Module to handle the accelerometer and gyroscope that the AOP
	  coprocessor of Apple laptops reads. Each sensor is an IIO device
	  with X, Y and Z channels, readable directly or through a buffer.
	  The bootloader has to pass the machine's sensor calibration in
	  the device tree.

config IIO_AOP_SENSOR_DEVMOTION
	tristate "AOP device-motion fusion"
	depends on ARCH_APPLE || COMPILE_TEST
	depends on RUST
	depends on SYSFS
	select APPLE_AOP
	select IIO_BUFFER
	select IIO_KFIFO_BUF
	help
	  Module to expose the orientation quaternion produced by the Apple
	  Always-On Processor's device-motion fusion service. The quaternion is
	  an IIO rotation channel readable directly or through a buffer.

config IIO_AOP_SENSOR_TEMP
	tristate "AOP board temperature sensor"
	depends on ARCH_APPLE || COMPILE_TEST
	depends on RUST
	depends on SYSFS
	select APPLE_AOP
	select IIO_BUFFER
	select IIO_KFIFO_BUF
	help
	  Module to expose the board-temperature sensor announced by the Apple
	  Always-On Processor as an IIO temperature device. Calibration data can
	  be supplied by the bootloader in the device tree.
```

## drivers/media/platform/apple/avd/Kconfig
```kconfig
# SPDX-License-Identifier: GPL-2.0-only

config VIDEO_APPLE_AVD
	tristate "Apple Silicon Video Decoding driver"
	depends on VIDEO_DEV
	depends on MEDIA_CONTROLLER
	depends on ARCH_APPLE || (COMPILE_TEST && 64BIT)
	depends on OF_ADDRESS
	depends on V4L_PLATFORM_DRIVERS
	select V4L2_MEM2MEM_DEV
	select VIDEOBUF2_DMA_CONTIG
	select V4L2_H264
	select V4L2_VP9
	help
	  Support the Apple Silicon stateless video decoder.

	  Build the decoder firmware from https://github.com/aurora-silicon/avd-fw
	  and install it under /lib/firmware/apple/. J700/T8140 uses the
	  avd-fw-v5-t0.bin image. Firmware is supplied separately from this driver.

config VIDEO_APPLE_AVD_KUNIT_TEST
	tristate "KUnit tests for the Apple video decoder" if !KUNIT_ALL_TESTS
	depends on VIDEO_APPLE_AVD && KUNIT
	default KUNIT_ALL_TESTS
	help
	  Build KUnit tests for the Apple video decoder. They exercise the
	  checks that the H.264 path makes on the slices that userspace
	  queues, such as finding the slice data after the slice header,
	  at the limits and one past them. Request ownership tests also cover
	  submission-time IRQs, VP routing, duplicate completions and watchdog
	  races, without accessing decoder hardware.

	  If unsure, say N.
```

## drivers/media/platform/apple/ave/Kconfig
```kconfig
# SPDX-License-Identifier: GPL-2.0-only

config VIDEO_APPLE_AVE
	tristate "Apple AVE video encoder"
	depends on ARCH_APPLE || COMPILE_TEST
	depends on VIDEO_DEV && IOMMU_DMA && PM_GENERIC_DOMAINS
	select CRC32
	select V4L2_MEM2MEM_DEV
	select VIDEOBUF2_DMA_CONTIG
	help
	  V4L2 memory-to-memory driver for the AVE H.264/HEVC encoder in
	  Apple T8140 (A18 Pro) SoCs, as in the MacBook Neo.
	  T6000 (M1 Pro), T6041 (M4 Pro) and T8112 (M2) have probe-only
	  support; encoding
	  requires qualified firmware command constants.

	  The encoder firmware is loaded by the bootloader; the driver builds
	  every command itself. See Documentation/admin-guide/media/apple-ave.rst.

	  To compile this driver as a module, choose M here: the module
	  will be called apple-ave.

config VIDEO_APPLE_AVE_KUNIT_TEST
	tristate "KUnit tests for Apple AVE buffer sizing and recovery" if !KUNIT_ALL_TESTS
	depends on KUNIT
	default KUNIT_ALL_TESTS
	help
	  Test the exact LFS reference descriptor sizes for pre-M4 and T8140
	  encoders, including picture alignment boundaries and the reference
	  1920x1080 AVC and HEVC sizes. The tests do not need an encoder or
	  any firmware and can run independently of the AVE driver.
	  Also test the firmware recovery sliding window and jiffies wrap.
```

## drivers/media/platform/apple/isp/Kconfig
```kconfig
# SPDX-License-Identifier: GPL-2.0-only

config VIDEO_APPLE_ISP
	tristate "Apple Silicon Image Signal Processor driver"
	select VIDEOBUF2_CORE
	select VIDEOBUF2_V4L2
	select VIDEOBUF2_DMA_SG
	select APPLE_PMP_REPORT
	depends on ARCH_APPLE || COMPILE_TEST
	depends on OF_ADDRESS
	depends on V4L_PLATFORM_DRIVERS
	depends on VIDEO_DEV
	help
	  Driver for the image signal processor that runs the built-in
	  camera of Apple silicon machines. The ISP firmware is loaded by
	  the bootloader. When a stream starts, the driver loads the
	  calibration file for the detected camera module,
	  apple/isp_<module>_<revision>XX.dat, from the firmware search
	  path; if it is missing, the stream runs without calibration.
```

## drivers/media/platform/apple/jpeg/Kconfig
```kconfig
# SPDX-License-Identifier: GPL-2.0-only

config VIDEO_APPLE_JPEG
	tristate "Apple Silicon JPEG encoder"
	depends on VIDEO_DEV
	depends on ARCH_APPLE || (COMPILE_TEST && 64BIT)
	depends on OF_ADDRESS && IOMMU_API && PM
	select V4L2_MEM2MEM_DEV
	select VIDEOBUF2_DMA_CONTIG
	help
	  V4L2 memory-to-memory baseline JPEG encoder for the JPEG engine
	  in M1 Pro/Max/Ultra, M2 and later Apple SoCs and the A18 Pro.
	  It takes full-range NV12 (4:2:0) or NV16 (4:2:2) frames. The
	  device compatible selects the register layout and address width;
	  unrecognized revisions are refused.

	  To compile this driver as a module, choose M here: the module
	  will be called apple-jpeg.

config VIDEO_APPLE_JPEG_KUNIT_TEST
	tristate "KUnit tests for the Apple JPEG encoder" if !KUNIT_ALL_TESTS
	depends on KUNIT && VIDEO_APPLE_JPEG
	default KUNIT_ALL_TESTS
	help
	  Check engine identification, the quantisation tables and every
	  register write of 4:2:0 and 4:2:2 encode jobs. No hardware is
	  needed.
```

## drivers/media/platform/apple/prores/Kconfig
```kconfig
# SPDX-License-Identifier: GPL-2.0-only

config VIDEO_APPLE_PRORES
	tristate "Apple Silicon ProRes encoder"
	depends on VIDEO_DEV
	depends on ARCH_APPLE || (COMPILE_TEST && 64BIT)
	depends on OF && IOMMU_API && PM
	select V4L2_MEM2MEM_DEV
	select VIDEOBUF2_DMA_CONTIG
	help
	  V4L2 memory-to-memory driver for the ProRes encoder engine (APR)
	  in Apple M1 Pro (T6000), M4 Pro (T6041), and A18 Pro (T8140)
	  SoCs. On T6041 a per-machine apple/prores-t6041-init.bin
	  replaces the built-in initialization rows; T6041 has no built-in
	  rows yet, so it needs the file to bind. It encodes 8
	  and 16 bit 4:2:2 and 4:4:4 frames to ProRes 422 Proxy, LT, 422, HQ,
	  4444 and 4444 XQ.

	  To compile this driver as a module, choose M here: the module
	  will be called apple-prores.

config VIDEO_APPLE_PRORES_KUNIT_TEST
	tristate "KUnit tests for the Apple ProRes encoder" if !KUNIT_ALL_TESTS
	depends on KUNIT && VIDEO_APPLE_PRORES
	default KUNIT_ALL_TESTS
	help
	  Check the APRI firmware parser, quantisation tables, DC scale table,
	  and job descriptors. APRI fixtures are wholly synthetic and contain
	  no vendor initialization values. The parser cases cover the complete
	  container shape and every row constraint. No hardware is needed.
```
