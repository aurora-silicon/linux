## drivers/media/platform/apple/scaler/Kconfig
```kconfig
# SPDX-License-Identifier: GPL-2.0-only

config VIDEO_APPLE_SCALER
	tristate "Apple Silicon scaler and colour-space converter"
	depends on VIDEO_DEV
	depends on ARCH_APPLE || (COMPILE_TEST && 64BIT)
	depends on OF_ADDRESS && IOMMU_API && PM
	select V4L2_MEM2MEM_DEV
	select VIDEOBUF2_DMA_CONTIG
	help
	  V4L2 memory-to-memory driver for the image scaler and
	  colour-space converter (MSR) in Apple silicon SoCs (M1 to M4
	  generations and A18 Pro). It converts between Y'CbCr (NV12,
	  P010) and 32-bit RGB at the same size; scaling follows.

	  To compile this driver as a module, choose M here: the module
	  will be called apple-scaler.

config VIDEO_APPLE_SCALER_KUNIT_TEST
	tristate "KUnit tests for the Apple scaler" if !KUNIT_ALL_TESTS
	depends on KUNIT && VIDEO_APPLE_SCALER
	default KUNIT_ALL_TESTS
	help
	  Check the colour-conversion matrices, offsets, scale ratios and
	  format encodings the scaler driver programs. No hardware is
	  needed.
```

## drivers/net/wireless/apple/Kconfig
```kconfig
# SPDX-License-Identifier: GPL-2.0-only
config WLAN_VENDOR_APPLE
	bool "Apple wireless devices"
	default y
	help
	  Support for Apple's wireless network devices.

if WLAN_VENDOR_APPLE
config APPLE_CENTAURI
	tristate "Apple N1 Centauri experimental J813 Wi-Fi"
	depends on ARCH_APPLE || COMPILE_TEST
	depends on PCI && CFG80211 && DEBUG_FS
	select FW_LOADER
	help
	  Experimental Apple N1 PCIe and ACIPC Wi-Fi support for the J813
	  MacBook Air. Firmware boot, ring setup and connection setup currently
	  use debugfs and the tools/aurora/j813 workbench. The tested single-link
	  WPA2 setup completes DHCP and bidirectional traffic. Suspend/resume,
	  roaming and automatic startup are not yet qualified.

	  The firmware and per-device calibration are private external inputs.
	  This driver does not include Bluetooth HCI support.

	  To build as a module, choose M; the module is apple_centauri.

config APPLE_CENTAURI_T6050
	tristate "Apple N1 Centauri T6050 firmware and IPC transport"
	depends on ARCH_APPLE || COMPILE_TEST
	depends on PCI && CFG80211 && PCIE_APPLE
	select FW_LOADER
	help
	  Boot the N1 firmware on a T6050 host that provides root-port reset.
	  The transport starts automatically from its device-tree firmware,
	  platform and protocol properties. It binds only behind a T6050 host;
	  the J813/J873 transport remains available independently.

config APPLE_CENTAURI_T6050_WIFI
	bool "T6050 N1 Centauri cfg80211 station interface"
	depends on APPLE_CENTAURI_T6050
	default y
	help
	  Add scanning and station connections for the T6050 protocol profile.

endif
```

## drivers/net/wireless/mediatek/mt7932/Kconfig
```kconfig
# SPDX-License-Identifier: GPL-2.0-only
config MT7932_FULLMAC
	tristate "Experimental J700 MT7932 fullmac wireless support"
	depends on PCI && OF && ARM64 && IOMMU_DMA
	depends on CFG80211
	select FW_LOADER
	help
	  Native support for the built-in J700 Wi-Fi endpoint: managed
	  WPA2-CCMP station operation on 2.4 GHz and on the 5 GHz UNII-1, -2,
	  -2e and -3 channels that the regulatory domain permits. Radar (DFS)
	  channels are scanned passively but not joined.
	  Requires original firmware, own calibration and original-derived
	  country policy packages in addition to the cfg80211 regulatory database.
	  The device is probed before the root filesystem is mounted, so say M
	  unless those files are in the initramfs.
	  Requires a trained retained PCI link and a translated SID1 DMA domain.
	  Firmware, runtime DMA and calibration negotiation start automatically;
	  cfg80211 and userspace select the country and network. No test boot
	  parameters are required for ordinary station operation.
	  Module removal stops host users and performs a checked PCI function
	  reset before releasing DMA storage. A failed reset blocks removal,
	  retaining resources until an explicit retry succeeds or system reset.
	  Other MediaTek devices and other machines are not matched.
```

## drivers/nfc/Kconfig
```kconfig
# SPDX-License-Identifier: GPL-2.0-only
#
# Near Field Communication (NFC) devices
#

menu "Near Field Communication (NFC) devices"
	depends on NFC

config NFC_TRF7970A
	tristate "Texas Instruments TRF7970a NFC driver"
	depends on SPI && NFC_DIGITAL && GPIOLIB
	help
	  This option enables the NFC driver for Texas Instruments' TRF7970a
	  device. Such device supports 5 different protocols: ISO14443A,
	  ISO14443B, FeLiCa, ISO15693 and ISO18000-3.

	  Say Y here to compile support for TRF7970a into the kernel or
	  say M  to compile it as a module. The module will be called
	  trf7970a.ko.

config NFC_MEI_PHY
	tristate "MEI bus NFC device support"
	depends on INTEL_MEI && NFC_HCI
	help
	  This adds support to use an mei bus nfc device. Select this if you
	  will use an HCI NFC driver for an NFC chip connected behind an
	  Intel's Management Engine chip.

	  If unsure, say N.

config NFC_SIM
	tristate "NFC hardware simulator driver"
	depends on NFC_DIGITAL
	help
	  This driver declares two virtual NFC devices supporting NFC-DEP
	  protocol. An LLCP connection can be established between them and
	  all packets sent from one device is sent back to the other, acting as
	  loopback devices.

	  If unsure, say N.

config NFC_PORT100
	tristate "Sony NFC Port-100 Series USB device support"
	depends on USB
	depends on NFC_DIGITAL
	help
	  This adds support for Sony Port-100 chip based USB devices such as the
	  RC-S380 dongle.

	  If unsure, say N.

config NFC_VIRTUAL_NCI
	tristate "NCI device simulator driver"
	depends on NFC_NCI
	help
	  NCI virtual device simulates a NCI device to the user.
	  It can be used to validate the NCI module and applications.
	  This driver supports communication between the virtual NCI device and
	  module.

	  If unsure, say N.

config NFC_APPLE_STOCKHOLM
	tristate "Apple Stockholm NFC controller and Secure Element"
	depends on SPMI && GPIOLIB && OF
	depends on ARCH_APPLE || COMPILE_TEST
	help
	  This enables the driver for the Apple Stockholm NFC controller with
	  embedded Secure Element found on Apple silicon Macs, connected over
	  SPMI. The Mac parts have no NFC radio interfaces, so no NFC device
	  is registered: the driver reads the controller identity once and
	  keeps the controller powered off.

	  Say M here to compile this driver as a module named apple-stockholm.

config NFC_APPLE_STOCKHOLM_KUNIT_TEST
	bool "KUnit tests for the Apple Stockholm driver" if !KUNIT_ALL_TESTS
	depends on NFC_APPLE_STOCKHOLM && KUNIT
	depends on KUNIT=y || NFC_APPLE_STOCKHOLM=m
	default KUNIT_ALL_TESTS
	help
	  Tests for the parsing of the NCI identity responses, built into the
	  apple-stockholm driver.

	  If unsure, say N.

source "drivers/nfc/fdp/Kconfig"
source "drivers/nfc/pn544/Kconfig"
source "drivers/nfc/pn533/Kconfig"
source "drivers/nfc/microread/Kconfig"
source "drivers/nfc/nfcmrvl/Kconfig"
source "drivers/nfc/st21nfca/Kconfig"
source "drivers/nfc/st-nci/Kconfig"
source "drivers/nfc/nxp-nci/Kconfig"
source "drivers/nfc/s3fwrn5/Kconfig"
source "drivers/nfc/st95hf/Kconfig"
endmenu
```

## drivers/phy/apple/Kconfig
```kconfig
# SPDX-License-Identifier: GPL-2.0 OR BSD-2-Clause
config PHY_APPLE_ATC
	tristate "Apple Type-C PHY"
	depends on (ARM64 && ARCH_APPLE) || (COMPILE_TEST && !GENERIC_ATOMIC64)
	depends on TYPEC
	depends on USB || !USB
	select GENERIC_PHY
	select APPLE_TUNABLE
	help
	  Enable this to add support for the Apple Type-C PHY found in
	  Apple Silicon M-series SoCs. This PHY supports USB2,
	  USB3, USB4, Thunderbolt, and DisplayPort.

	  If M is selected the module will be called 'phy-apple-atc'.

config PHY_APPLE_ATC_KUNIT_TEST
	bool "KUnit tests for the Apple Type-C PHY" if !KUNIT_ALL_TESTS
	depends on PHY_APPLE_ATC && KUNIT
	depends on PHY_APPLE_ATC=m || KUNIT=y
	default KUNIT_ALL_TESTS
	help
	  Build the KUnit tests for the Type-C mux decisions of the Apple
	  Type-C PHY driver into the driver. They check how Type-C states
	  map to PHY modes, which mux updates may skip the lane and PIPE
	  work, and that a port behind a fixed hub has the controller's
	  SuperSpeed port off while its PIPE moves. The tests need no
	  hardware and run when the driver is loaded.

	  Also check tunnel qualification, T8122 link rates, drive presets
	  and lane mapping using fixtures without PHY hardware.

	  If unsure, say N.

config PHY_APPLE_T6040_USB2
	tristate "Apple T6040 Type-C PHY (USB2/USB3 host, DisplayPort)"
	depends on ARM64 && ARCH_APPLE
	depends on TYPEC
	depends on APPLE_RTKIT
	select GENERIC_PHY
	select APPLE_TUNABLE
	help
	  Build the PHY provider for the T6040 generation's Type-C ports and
	  fixed DisplayPort PHYs. It implements the USB2 host sequence and the
	  USB3 host attach decoded from the paired AppleT6040TypeCPhy driver,
	  including the start of the PHY coprocessor, and the DisplayPort mode
	  (all four lanes, RBR to HBR3) a Type-C controller selects through the
	  PHY's mode switch or that an HDMI converter's PHY runs permanently.
	  It provides no device mode, DisplayPort pin assignment D, USB4,
	  Thunderbolt or retimer support.

	  This driver performs no ATC-register writes at probe time. Enabling a
	  matching device-tree node causes MMIO writes when a USB2, USB3 or
	  DisplayPort consumer powers on the PHY and therefore requires
	  platform-specific safety review.

config PHY_APPLE_DPTX
	tristate "Apple DPTX PHY"
	depends on ARCH_APPLE || COMPILE_TEST
	select GENERIC_PHY
	help
	  Enable this to add support for the Apple DPTX PHY found on Apple SoCs
	  such as the M2.
	  This driver provides support for DisplayPort and is used on the
	  Mac mini (M2 and M2 Pro, 2023).
```

## drivers/pmdomain/apple/Kconfig
```kconfig
# SPDX-License-Identifier: GPL-2.0-only

if ARCH_APPLE || COMPILE_TEST

config APPLE_PMGR_PWRSTATE
	bool "Apple SoC PMGR power state control"
	depends on PM
	select REGMAP
	select MFD_SYSCON
	select PM_GENERIC_DOMAINS
	select RESET_CONTROLLER
	help
	  The PMGR block in Apple SoCs provides high-level power state
	  controls for SoC devices. This driver manages them through the
	  generic power domain framework, and also provides reset support.

config APPLE_PMP_REPORT
	bool "Apple PMP report control"
	depends on OF
	depends on PM
	select PM_GENERIC_DOMAINS

endif

config APPLE_PMP_REPORT_KUNIT_TEST
	tristate "Apple PMP report validation tests" if !KUNIT_ALL_TESTS
	depends on KUNIT && PM
	select PM_GENERIC_DOMAINS
	default KUNIT_ALL_TESTS
	help
	  Tests the PMP report layout, request acknowledgment flags and boot
	  argument validation without accessing hardware.
	  Includes malformed tables, address arithmetic and device ordering.
	  The PMP report driver does not need to be enabled to run this suite.

config APPLE_PMC
	bool "Apple PMC voter interface"
	depends on OF
	depends on PM
	select PM_GENERIC_DOMAINS
	default ARCH_APPLE
	help
	  The PMC in some Apple SoCs arbitrates the performance states of
	  shared rails, such as the DRAM controller and the SoC fabric,
	  between voter agents. This driver enables the static agents and
	  provides power domains that enable a dynamic agent, such as the
	  GPU, while its device is powered on. It can also limit the DRAM
	  controller rail as a thermal cooling device.


config APPLE_PMP_REPORT_NEO
	bool "Apple T8140 PMP report and fast die-temperature limits"
	depends on ARCH_APPLE && OF && PM
	select PM_GENERIC_DOMAINS
	default ARCH_APPLE
```
